AUTOSAR XML (schema 4-0-3)
package /DaVinci_Project
  module config Rte
    14 x RteBswModuleInstance:
      BswM
        BswM_MainFunctionTimingEvent0 (RteBswEventToTaskMapping): RteBswUsedOsEventRef=Rte_Ev_Cyclic2_SchM_Core0_0_10ms, RteBswUsedOsAlarmRef=Os/Rte_Al_TE2_SchM_Core0_0_10ms
      Can
        3 x RteBswEventToTaskMapping, all with RteBswUsedOsEventRef=Rte_Ev_Cyclic2_SchM_Core0_0_10ms, RteBswUsedOsAlarmRef=Os/Rte_Al_TE2_SchM_Core0_0_10ms:
          Can_MainFunction_BusOffTimingEvent0
          Can_MainFunction_ModeTimingEvent0
          Can_MainFunction_WakeupTimingEvent0
      CanIf
      CanSM
        CanSM_MainFunctionTimingEvent0 (RteBswEventToTaskMapping): RteBswUsedOsEventRef=Rte_Ev_Cyclic2_SchM_Core0_0_10ms, RteBswUsedOsAlarmRef=Os/Rte_Al_TE2_SchM_Core0_0_10ms
      Com
        Com_MainFunctionRxTimingEvent0 (RteBswEventToTaskMapping): RteBswUsedOsEventRef=Rte_Ev_Cyclic2_SchM_Core0_0_10ms, RteBswUsedOsAlarmRef=Os/Rte_Al_TE2_SchM_Core0_0_10ms
        Com_MainFunctionTxTimingEvent0 (RteBswEventToTaskMapping): RteBswUsedOsEventRef=Rte_Ev_Cyclic2_SchM_Core0_0_1ms, RteBswUsedOsAlarmRef=Os/Rte_Al_TE2_SchM_Core0_0_1ms
      ComM
        ComM_MainFunction_0TimingEvent0 (RteBswEventToTaskMapping): RteBswUsedOsEventRef=Rte_Ev_Cyclic2_SchM_Core0_0_20ms, RteBswUsedOsAlarmRef=Os/Rte_Al_TE2_SchM_Core0_0_20ms
      Det
      Dio
      EcuM
        6 x RteBswEventToTaskMapping:
          EcuM_MainFunctionTimingEvent0: RteBswUsedOsAlarmRef=Os/Rte_Al_TE1_EcuM_EcuM_MainFunction
          EcuM_MainFunctionTimingEvent1: RteBswUsedOsAlarmRef=Os/Rte_Al_TE2_EcuM_EcuM_MainFunction
          EcuM_MainFunctionTimingEvent2: RteBswUsedOsAlarmRef=Os/Rte_Al_TE3_EcuM_EcuM_MainFunction
          EcuM_MainFunctionTimingEvent3: RteBswUsedOsAlarmRef=Os/Rte_Al_TE4_EcuM_EcuM_MainFunction
          EcuM_MainFunctionTimingEvent4: RteBswUsedOsEventRef=Rte_Ev_Cyclic2_SchM_Core0_0_10ms, RteBswUsedOsAlarmRef=Os/Rte_Al_TE2_SchM_Core0_0_10ms
          EcuM_MainFunctionTimingEvent5: RteBswUsedOsAlarmRef=Os/Rte_Al_TE6_EcuM_EcuM_MainFunction
      McalLib
      Mcu
      PduR
      Port
      Xcp
        CanXcp_MainFunctionTimingEvent0 (RteBswEventToTaskMapping): RteBswUsedOsEventRef=Rte_Ev_Cyclic2_SchM_Core0_0_5ms, RteBswUsedOsAlarmRef=Os/Rte_Al_TE2_SchM_Core0_0_5ms
        Xcp_MainFunctionTimingEvent0 (RteBswEventToTaskMapping): RteBswUsedOsEventRef=Rte_Ev_Cyclic2_SchM_Core0_0_5ms, RteBswUsedOsAlarmRef=Os/Rte_Al_TE2_SchM_Core0_0_5ms
    16 x RteSwComponentInstance:
      BswM_EcuSwComposition
        Timer_BswM_MainFunction (RteEventToTaskMapping): RteUsedOsEventRef=Rte_Ev_Cyclic2_SchM_Core0_0_10ms, RteUsedOsAlarmRef=Os/Rte_Al_TE2_SchM_Core0_0_10ms
      ComM_EcuSwComposition
        Timer_ComM_MainFunction_0 (RteEventToTaskMapping): RteUsedOsEventRef=Rte_Ev_Cyclic2_SchM_Core0_0_20ms, RteUsedOsAlarmRef=Os/Rte_Al_TE2_SchM_Core0_0_20ms
      Core0Swc_EcuSwComposition
        TMT_Core0Runnable (RteEventToTaskMapping): RteUsedOsAlarmRef=Os/Rte_Al_TE_Core0Swc_Core0Runnable
      Core1Swc_EcuSwComposition
        TMT_Core1Runnable (RteEventToTaskMapping): RteUsedOsAlarmRef=Os/Rte_Al_TE_Core1Swc_Core1Runnable
      Core2Swc_EcuSwComposition
        TMT_Core2Runnable (RteEventToTaskMapping): RteUsedOsAlarmRef=Os/Rte_Al_TE_Core2Swc_Core2Runnable
      Core3Swc_EcuSwComposition
        TMT_Core3Runnable (RteEventToTaskMapping): RteUsedOsAlarmRef=Os/Rte_Al_TE_Core3Swc_Core3Runnable
      Core4Swc_EcuSwComposition
        TMT_Core4Runnable (RteEventToTaskMapping): RteUsedOsAlarmRef=Os/Rte_Al_TE_Core4Swc_Core4Runnable
      Core5Swc_EcuSwComposition
        TMT_Core5Runnable (RteEventToTaskMapping): RteUsedOsAlarmRef=Os/Rte_Al_TE_Core5Swc_Core5Runnable
      Det_EcuSwComposition
      EcuM_EcuSwComposition
        Timer_EcuM_MainFunction (RteEventToTaskMapping): RteUsedOsEventRef=Rte_Ev_Cyclic2_SchM_Core0_0_10ms, RteUsedOsAlarmRef=Os/Rte_Al_TE2_SchM_Core0_0_10ms
      Os_OsCore{0..5}_swc_EcuSwComposition
    RteOsInteraction
      15 x RteUsedOsActivation, all with RteExpectedActivationOffset=0:
        Rte_Al_TE_Core{0..5}Swc_Core{0..5}Runnable: RteActivationOsAlarmRef=Os/Rte_Al_TE_Core{0..5}Swc_Core{0..5}Runnable, RteActivationOsTaskRef=APP_Task_Core{0..5}
        Rte_Al_TE2_SchM_Core0_0_10ms: RteActivationOsAlarmRef=Os/Rte_Al_TE2_SchM_Core0_0_10ms, RteActivationOsTaskRef=SchM_Core0
        Rte_Al_TE2_SchM_Core0_0_1ms: RteActivationOsAlarmRef=Os/Rte_Al_TE2_SchM_Core0_0_1ms, RteActivationOsTaskRef=SchM_Core0
        Rte_Al_TE2_SchM_Core0_0_20ms: RteActivationOsAlarmRef=Os/Rte_Al_TE2_SchM_Core0_0_20ms, RteActivationOsTaskRef=SchM_Core0
        Rte_Al_TE2_SchM_Core0_0_5ms: RteActivationOsAlarmRef=Os/Rte_Al_TE2_SchM_Core0_0_5ms, RteActivationOsTaskRef=SchM_Core0
        Rte_Al_TE{1..4}_EcuM_EcuM_MainFunction: RteActivationOsAlarmRef=Os/Rte_Al_TE{1..4}_EcuM_EcuM_MainFunction, RteActivationOsTaskRef=SchM_Core{1..4}
        Rte_Al_TE6_EcuM_EcuM_MainFunction: RteActivationOsAlarmRef=Os/Rte_Al_TE6_EcuM_EcuM_MainFunction, RteActivationOsTaskRef=SchM_Core5
  module config NvM
  module config Os
    APP_Task_Core0 (OsTask):
      OsTaskActivation = 1
      OsTaskPriority = 50
      OsTaskSchedule = FULL
      OsTaskAccessingApplication = SystemApplication_OsCore{1..5}
    Rte_Al_TE_Core0Swc_Core0Runnable (OsAlarm):
      OsAlarmCounterRef = SystemTimer0
      OsAlarmAccessingApplication = SystemApplication_OsCore{1..5}
      OsAlarmAction
        OsAlarmActivateTask: OsAlarmActivateTaskRef=APP_Task_Core0
    APP_Task_Core1 (OsTask):
      OsTaskActivation = 1
      OsTaskPriority = 50
      OsTaskSchedule = FULL
      OsTaskAccessingApplication = SystemApplication_OsCore0
      OsTaskAccessingApplication = SystemApplication_OsCore{2..5}
    Rte_Al_TE_Core1Swc_Core1Runnable (OsAlarm):
      OsAlarmCounterRef = SystemTimer1
      OsAlarmAccessingApplication = SystemApplication_OsCore0
      OsAlarmAccessingApplication = SystemApplication_OsCore{2..5}
      OsAlarmAction
        OsAlarmActivateTask: OsAlarmActivateTaskRef=APP_Task_Core1
    APP_Task_Core2 (OsTask):
      OsTaskActivation = 1
      OsTaskPriority = 50
      OsTaskSchedule = FULL
      OsTaskAccessingApplication = SystemApplication_OsCore0
      OsTaskAccessingApplication = SystemApplication_OsCore1
      OsTaskAccessingApplication = SystemApplication_OsCore{3..5}
    Rte_Al_TE_Core2Swc_Core2Runnable (OsAlarm):
      OsAlarmCounterRef = SystemTimer2
      OsAlarmAccessingApplication = SystemApplication_OsCore0
      OsAlarmAccessingApplication = SystemApplication_OsCore1
      OsAlarmAccessingApplication = SystemApplication_OsCore{3..5}
      OsAlarmAction
        OsAlarmActivateTask: OsAlarmActivateTaskRef=APP_Task_Core2
    APP_Task_Core3 (OsTask):
      OsTaskActivation = 1
      OsTaskPriority = 50
      OsTaskSchedule = FULL
      OsTaskAccessingApplication = SystemApplication_OsCore{0..2}
      OsTaskAccessingApplication = SystemApplication_OsCore4
      OsTaskAccessingApplication = SystemApplication_OsCore5
    Rte_Al_TE_Core3Swc_Core3Runnable (OsAlarm):
      OsAlarmCounterRef = SystemTimer3
      OsAlarmAccessingApplication = SystemApplication_OsCore{0..2}
      OsAlarmAccessingApplication = SystemApplication_OsCore4
      OsAlarmAccessingApplication = SystemApplication_OsCore5
      OsAlarmAction
        OsAlarmActivateTask: OsAlarmActivateTaskRef=APP_Task_Core3
    APP_Task_Core4 (OsTask):
      OsTaskActivation = 1
      OsTaskPriority = 50
      OsTaskSchedule = FULL
      OsTaskAccessingApplication = SystemApplication_OsCore{0..3}
      OsTaskAccessingApplication = SystemApplication_OsCore5
    Rte_Al_TE_Core4Swc_Core4Runnable (OsAlarm):
      OsAlarmCounterRef = SystemTimer4
      OsAlarmAccessingApplication = SystemApplication_OsCore{0..3}
      OsAlarmAccessingApplication = SystemApplication_OsCore5
      OsAlarmAction
        OsAlarmActivateTask: OsAlarmActivateTaskRef=APP_Task_Core4
    APP_Task_Core5 (OsTask):
      OsTaskActivation = 1
      OsTaskPriority = 50
      OsTaskSchedule = FULL
      OsTaskAccessingApplication = SystemApplication_OsCore{0..4}
    Rte_Al_TE_Core5Swc_Core5Runnable (OsAlarm):
      OsAlarmCounterRef = SystemTimer5
      OsAlarmAccessingApplication = SystemApplication_OsCore{0..4}
      OsAlarmAction
        OsAlarmActivateTask: OsAlarmActivateTaskRef=APP_Task_Core5
    SchM_Core0 (OsTask):
      OsTaskActivation = 1
      OsTaskPriority = 20
      OsTaskSchedule = FULL
      OsTaskEventRef = Rte_Ev_Cyclic2_SchM_Core0_0_10ms
      OsTaskEventRef = Rte_Ev_Cyclic2_SchM_Core0_0_1ms
      OsTaskEventRef = Rte_Ev_Cyclic2_SchM_Core0_0_20ms
      OsTaskEventRef = Rte_Ev_Cyclic2_SchM_Core0_0_5ms
      OsTaskAccessingApplication = SystemApplication_OsCore{1..5}
    4 x OsAlarm, all with OsAlarmCounterRef=SystemTimer0, OsAlarmAccessingApplication=SystemApplication_OsCore1, OsAlarmAccessingApplication=SystemApplication_OsCore2, OsAlarmAccessingApplication=SystemApplication_OsCore3, OsAlarmAccessingApplication=SystemApplication_OsCore4, OsAlarmAccessingApplication=SystemApplication_OsCore5:
      Rte_Al_TE2_SchM_Core0_0_10ms
        OsAlarmAction
          OsAlarmSetEvent: OsAlarmSetEventRef=Rte_Ev_Cyclic2_SchM_Core0_0_10ms, OsAlarmSetEventTaskRef=SchM_Core0
      Rte_Al_TE2_SchM_Core0_0_1ms
        OsAlarmAction
          OsAlarmSetEvent: OsAlarmSetEventRef=Rte_Ev_Cyclic2_SchM_Core0_0_1ms, OsAlarmSetEventTaskRef=SchM_Core0
      Rte_Al_TE2_SchM_Core0_0_20ms
        OsAlarmAction
          OsAlarmSetEvent: OsAlarmSetEventRef=Rte_Ev_Cyclic2_SchM_Core0_0_20ms, OsAlarmSetEventTaskRef=SchM_Core0
      Rte_Al_TE2_SchM_Core0_0_5ms
        OsAlarmAction
          OsAlarmSetEvent: OsAlarmSetEventRef=Rte_Ev_Cyclic2_SchM_Core0_0_5ms, OsAlarmSetEventTaskRef=SchM_Core0
    SchM_Core1 (OsTask):
      OsTaskActivation = 1
      OsTaskPriority = 20
      OsTaskSchedule = FULL
      OsTaskAccessingApplication = SystemApplication_OsCore0
      OsTaskAccessingApplication = SystemApplication_OsCore{2..5}
    Rte_Al_TE1_EcuM_EcuM_MainFunction (OsAlarm):
      OsAlarmCounterRef = SystemTimer1
      OsAlarmAccessingApplication = SystemApplication_OsCore0
      OsAlarmAccessingApplication = SystemApplication_OsCore{2..5}
      OsAlarmAction
        OsAlarmActivateTask: OsAlarmActivateTaskRef=SchM_Core1
    SchM_Core2 (OsTask):
      OsTaskActivation = 1
      OsTaskPriority = 20
      OsTaskSchedule = FULL
      OsTaskAccessingApplication = SystemApplication_OsCore0
      OsTaskAccessingApplication = SystemApplication_OsCore1
      OsTaskAccessingApplication = SystemApplication_OsCore{3..5}
    Rte_Al_TE2_EcuM_EcuM_MainFunction (OsAlarm):
      OsAlarmCounterRef = SystemTimer2
      OsAlarmAccessingApplication = SystemApplication_OsCore0
      OsAlarmAccessingApplication = SystemApplication_OsCore1
      OsAlarmAccessingApplication = SystemApplication_OsCore{3..5}
      OsAlarmAction
        OsAlarmActivateTask: OsAlarmActivateTaskRef=SchM_Core2
    SchM_Core3 (OsTask):
      OsTaskActivation = 1
      OsTaskPriority = 20
      OsTaskSchedule = FULL
      OsTaskAccessingApplication = SystemApplication_OsCore{0..2}
      OsTaskAccessingApplication = SystemApplication_OsCore4
      OsTaskAccessingApplication = SystemApplication_OsCore5
    Rte_Al_TE3_EcuM_EcuM_MainFunction (OsAlarm):
      OsAlarmCounterRef = SystemTimer3
      OsAlarmAccessingApplication = SystemApplication_OsCore{0..2}
      OsAlarmAccessingApplication = SystemApplication_OsCore4
      OsAlarmAccessingApplication = SystemApplication_OsCore5
      OsAlarmAction
        OsAlarmActivateTask: OsAlarmActivateTaskRef=SchM_Core3
    SchM_Core4 (OsTask):
      OsTaskActivation = 1
      OsTaskPriority = 20
      OsTaskSchedule = FULL
      OsTaskAccessingApplication = SystemApplication_OsCore{0..3}
      OsTaskAccessingApplication = SystemApplication_OsCore5
    Rte_Al_TE4_EcuM_EcuM_MainFunction (OsAlarm):
      OsAlarmCounterRef = SystemTimer4
      OsAlarmAccessingApplication = SystemApplication_OsCore{0..3}
      OsAlarmAccessingApplication = SystemApplication_OsCore5
      OsAlarmAction
        OsAlarmActivateTask: OsAlarmActivateTaskRef=SchM_Core4
    SchM_Core5 (OsTask):
      OsTaskActivation = 1
      OsTaskPriority = 20
      OsTaskSchedule = FULL
      OsTaskAccessingApplication = SystemApplication_OsCore{0..4}
    Rte_Al_TE6_EcuM_EcuM_MainFunction (OsAlarm):
      OsAlarmCounterRef = SystemTimer5
      OsAlarmAccessingApplication = SystemApplication_OsCore{0..4}
      OsAlarmAction
        OsAlarmActivateTask: OsAlarmActivateTaskRef=SchM_Core5
    4 x OsEvent:
      Rte_Ev_Cyclic2_SchM_Core0_0_10ms
      Rte_Ev_Cyclic2_SchM_Core0_0_1ms
      Rte_Ev_Cyclic2_SchM_Core0_0_20ms
      Rte_Ev_Cyclic2_SchM_Core0_0_5ms
    6 x OsApplication, all with OsTrusted=true:
      SystemApplication_OsCore0: OsAppTaskRef=APP_Task_Core0, OsAppAlarmRef=Os/Rte_Al_TE_Core0Swc_Core0Runnable, OsAppTaskRef=SchM_Core0, OsAppAlarmRef=Os/Rte_Al_TE2_SchM_Core0_0_10ms, OsAppAlarmRef=Os/Rte_Al_TE2_SchM_Core0_0_1ms, OsAppAlarmRef=Os/Rte_Al_TE2_SchM_Core0_0_20ms, OsAppAlarmRef=Os/Rte_Al_TE2_SchM_Core0_0_5ms
      SystemApplication_OsCore{1..4}: OsAppTaskRef=APP_Task_Core{1..4}, OsAppAlarmRef=Os/Rte_Al_TE_Core{1..4}Swc_Core{1..4}Runnable, OsAppTaskRef=SchM_Core{1..4}, OsAppAlarmRef=Os/Rte_Al_TE{1..4}_EcuM_EcuM_MainFunction
      SystemApplication_OsCore5: OsAppTaskRef=APP_Task_Core5, OsAppAlarmRef=Os/Rte_Al_TE_Core5Swc_Core5Runnable, OsAppTaskRef=SchM_Core5, OsAppAlarmRef=Os/Rte_Al_TE6_EcuM_EcuM_MainFunction
  module config EcuC
  ecuc value collection DaVinci_Project: ecuc-values=[Com, Rte, Os, EcuC, NvM]
