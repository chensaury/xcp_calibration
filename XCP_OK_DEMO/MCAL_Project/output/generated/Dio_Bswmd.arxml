AUTOSAR XML (schema 4-2-2)
# Copyright (C) Infineon Technologies (2018)
# All rights reserved.
package /AUTOSAR_Dio/BswModuleDescriptions
  bsw module description Dio: category=BSW_MODULE, module-id=120, provided-entrys=[Dio_ReadChannel, Dio_WriteChannel, Dio_ReadPort, Dio_WritePort, Dio_ReadChannelGroup, Dio_WriteChannelGroup]  # DIO Driver
    bsw module dependency DetDependency: category=BSW_MODULE, target-module-id=15, required-entrys=Det_ReportError
    bsw module dependency McalLibDependency: target-module-id=255, required-entrys=Mcal_SetBitAtomic
    bsw module dependency McalSafetyErrorDependency: target-module-id=255, required-entrys=Mcal_ReportSafetyError
    bsw internal behavior DioBehavior
      6 x bsw called entity, all with reentrancy-level=MULTICORE-REENTRANT:
        Dio_ReadChannel: implemented-entry=Dio_ReadChannel
        Dio_WriteChannel: implemented-entry=Dio_WriteChannel
        Dio_ReadPort: implemented-entry=Dio_ReadPort
        Dio_WritePort: implemented-entry=Dio_WritePort
        Dio_ReadChannelGroup: implemented-entry=Dio_ReadChannelGroup
        Dio_WriteChannelGroup: implemented-entry=Dio_WriteChannelGroup
package /AUTOSAR_Dio/BswModuleEntrys
  6 x bsw module entry, all with is-reentrant=true, is-synchronous=true, call-type=REGULAR, execution-context=TASK, sw-service-impl-policy=STANDARD:
    Dio_ReadChannel: service-id=0
      return type Return: implementation-data-type=Dio_LevelType
      sw service arg ChannelId: implementation-data-type=Dio_ChannelType
    Dio_WriteChannel: service-id=1
      sw service arg ChannelId: implementation-data-type=Dio_ChannelType
      sw service arg Level: implementation-data-type=Dio_LevelType
    Dio_ReadPort: service-id=2
      return type Return: implementation-data-type=Dio_PortLevelType
      sw service arg PortId: implementation-data-type=Dio_PortType
    Dio_WritePort: service-id=3
      sw service arg PortId: implementation-data-type=Dio_PortType
      sw service arg Level: implementation-data-type=Dio_PortLevelType
    Dio_ReadChannelGroup: service-id=4
      return type Return: implementation-data-type=Dio_PortLevelType
      sw service arg ChannelGroupIdPtr: category=DATA_REFERENCE, sw-pointer-target-props={target-category=TYPE_REFERENCE, implementation-data-type=Dio_ChannelGroupType}
    Dio_WriteChannelGroup: service-id=5
      sw service arg ChannelGroupIdPtr: category=DATA_REFERENCE, sw-pointer-target-props={target-category=TYPE_REFERENCE, implementation-data-type=Dio_ChannelGroupType}
      sw service arg Level: implementation-data-type=Dio_PortLevelType
package /AUTOSAR_Dio/Implementations
  bsw implementation Dio: programming-language=C, sw-version=3.0.0, vendor-id=17, ar-release-version=4.2.2, behavior=DioBehavior, vendor-specific-module-def=Dio
    code-descriptors:
      code Files: artifact-descriptors=[{short-label=ssc::src::Dio.c, category=SWSRC}, {short-label=ssc::inc::Dio.h, category=SWHDR}]
    4 x compiler:
      TASKING_COMPILE: name=TASKING, options="--core=tc1.6.2 --iso=99 -O2 --eabi-compliant -AGKpvX --switch=auto --integer-enumeration --default-near-size=0 --fp-model=1", vendor=Altium, version=V6.2r2
      GNU_COMPILE: name=GNU, options="-DGNU -Wall -std=c99 -c -O2 -mtc162 -meabi -fno-short-enums -ffunction-sections -fdata-sections -fstrict-volatile-bitfields", vendor=Hightec, version=V4.9.2.0
      DIAB_COMPILE: name=DIAB, options="-tTC162NF:simple -O -XO -Xsection-split=1 -Xkeep-assembly-file=2 -g3 -Xinline=0 -Xdialect-c99 -ei5388,2273,5387 -ei1824 -Xsmall-data=0 -Xsmall-const=0", vendor=Windriver, version=V5.9.6.4
      GHS_COMPILE: name=GHS, options="-cpu=tc1v162 --no_commons --gnu_asm --no_short_enum -c99 -Ospeed -Onounroll -g -c -dwarf2", vendor=GreenHills, version=V2017.5.5
    generated-artifacts:
      4 x dependency on artifact:
        Dio_Cfg_h: artifact-descriptor={short-label=generate::template::inc::Dio_Cfg.h, category=SWTEMPLATE}, usages=COMPILE
        Dio_Lcfg_c: artifact-descriptor={short-label=generate::template::src::Dio_Lcfg.c, category=SWTEMPLATE}, usages=LINK
        Dio_xdm: artifact-descriptor={short-label=config::Dio.xdm, category=SWTOOL}, usages=CODEGENERATION
        Dio_bmd: artifact-descriptor={short-label=autosar::TC39x::TC397x::Dio.bmd, category=SWTOOL}, usages=CODEGENERATION
    4 x linker:
      TASKING_LINK: name=TASKING, options="--map-file -OtcXYL --core=mpe:vtc", vendor=Altium, version=V6.2r2
      GNU_LINK: name=GNU, options="-Wl,--mcpu=tc162 -Wl,--gc-sections -nostartfiles -n", vendor=Hightec, version=V4.9.2.0
      DIAB_LINK: name=DIAB, options="-tTC162NF:simple -m6 -Xremove-unused-sections", vendor=Windriver, version=V5.9.6.4
      GHS_LINK: name=GHS, options="-cpu=tc1v162 -ignore_debug_references", vendor=GreenHills, version=V2017.5.5
    resource consumption ResourceConsumption
      4 x memory section:
        CONST_ASIL_B_GLOBAL_16: alignment=16, sw-addrmethod=CONST
        CONST_ASIL_B_GLOBAL_32: alignment=32, sw-addrmethod=CONST
        CONFIG_DATA_ASIL_B_GLOBAL_UNSPECIFIED: alignment=UNSPECIFIED, sw-addrmethod=CONFIG_DATA
        CODE_ASIL_B_GLOBAL: alignment=UNSPECIFIED, sw-addrmethod=CODE
      section name prefix DIO
package /AUTOSAR_Dio/ImplementationDataTypes
  5 x impl type:
    Dio_ChannelGroupType: category=STRUCTURE
      element Mask: implementation-data-type=uint16
      element Offset: implementation-data-type=uint8
      element Port: implementation-data-type=Dio_PortType
    Dio_ChannelType: implementation-data-type=uint16, type-emitter=BSW
    Dio_LevelType: implementation-data-type=uint8, type-emitter=BSW
    Dio_PortType: implementation-data-type=uint8, type-emitter=BSW
    Dio_PortLevelType: implementation-data-type=uint16, type-emitter=BSW
