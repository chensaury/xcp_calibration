AUTOSAR XML (schema 4-2-1)
package /ActiveEcuC
  ecuc value collection ActiveEcuC: ecu-extract=SYSTEM, ecuc-values=[Com, Rte, EcuM, Os, PduR, CanSM, Can, CanIf, Det, ComM, EcuC, BswM, vSet, ResourceM, Dio, McalLib, Mcu, Port, Xcp]
