AUTOSAR XML (schema 4-2-1)
package /ActiveEcuC
  module config Xcp: implementation-config-variant=VARIANT-PRE-COMPILE, module-description=Xcp_Impl
    XcpCmdConfig: XcpOpenCommandInterface=false
      XcpStandard:
        XcpBlockUpload = false
        XcpCommunicationModeInfo = false
        XcpGetIdGeneric = false
        XcpMemoryReadProtection = false
        XcpSeedKey = false
        XcpUserDefinedCommand = false
        XcpCRC: XcpAUTOSARCRCModuleSupport=false, XcpCRCBlockSize=1024, XcpCRCCalculationMethod=ADD_14, XcpCustomCRC=false
      XcpAsynchMessage: XcpEventCodes=false, XcpServiceRequestMessage=false
      XcpCalibration: XcpBlockDownload=true, XcpMIN_STForBlockDownload=1, XcpModifyBits=true, XcpShortDownload=true
      XcpDaqAndStim:
        XcpFixedTimestamp = false
        XcpGetDAQEventInfo = true
        XcpMaxNumberOfOdtDaq = 123
        XcpMaxNumberOfOdtEntries = 300
        XcpMaxNumberOfOdtStim = 1
        XcpOverrunIndication = true
        XcpResolutionInfo = false
        XcpResumeMode = false
        XcpSynchronousDataStimulation = false
        XcpWriteDAQMultiple = false
        XcpDAQMessageHeader = ODT
      XcpPageSwitching: XcpCopyPage=true, XcpFreezeMode=false, XcpGeneralPagingInfo=false
    XcpGeneral:
      XcpDevErrorDetect = true
      XcpMainFunctionPeriod = 0.005
      XcpMaxEventChannel = 255
      XcpOnCanEnabled = true
      XcpOnCddEnabled = false
      XcpOnEthernetEnabled = false
      XcpOnFlexRayEnabled = false
      XcpPrescalerSupported = false
      XcpVersionInfoApi = false
      XcpBootloaderDownload = false
      XcpControl = false
      XcpMultiClientSupport = false
      XcpRuntimeMeasurementSupport = false
      XcpSafeBswChecks = false
      XcpSessionStatusAPI = false
      XcpTypeSafeCopy = false
      XcpDAQMemAccessByApplication = false
      XcpDaqConfigType = DAQ_DYNAMIC
      XcpTimestampUnit = TIMESTAMP_UNIT_1US
      XcpCounterRef = SystemTimer0
      XcpA2L: XcpTimeoutT1=2000, XcpTimeoutT2=10000, XcpTimeoutT3=2000, XcpTimeoutT4=2000, XcpTimeoutT5=2000, XcpTimeoutT6=2000, XcpTimeoutT7=0
    XcpConfig
      XcpEventChannel50ms (XcpEventChannel):
        XcpEventChannelMaxDaqList = 255
        XcpEventChannelNumber = 0
        XcpEventChannelTimeCycle = 50
        XcpEventChannelTimeUnit = TIMESTAMP_UNIT_1MS
        XcpEventChannelType = DAQ
        XcpEventChannelCoreRef = XcpCoreDefinition
      XcpEventChannel100ms (XcpEventChannel):
        XcpEventChannelMaxDaqList = 255
        XcpEventChannelNumber = 2
        XcpEventChannelTimeCycle = 100
        XcpEventChannelTimeUnit = TIMESTAMP_UNIT_1MS
        XcpEventChannelType = DAQ
        XcpEventChannelCoreRef = XcpCoreDefinition
      XCP_S_oCAN00_aa3b84ab_Rx (XcpPdu)
        XCP_S_oCAN00_aa3b84ab_Rx (XcpRxPdu): XcpRxPduId=0, XcpRxPduRef=XCP_S_oCAN00_aa3b84ab_Rx, XcpTxPduContRef=XCP_R_oCAN00_31486e7f_Tx/XCP_R_oCAN00_31486e7f_Tx
      XCP_R_oCAN00_31486e7f_Tx (XcpPdu)
        XCP_R_oCAN00_31486e7f_Tx (XcpTxPdu): XcpTxPduId=0, XcpTxPduRef=XCP_R_oCAN00_31486e7f_Tx
      XcpTransportLayer
        XcpOnCan: XcpOnCanMaxCto=8, XcpOnCanMaxDto=8, XcpOnCanConfirmationTimeout=10, XcpOnCanMultiConnectionProtection=false, XcpOnCanVariableDlc=false
      XcpEventChannel10ms (XcpEventChannel):
        XcpEventChannelMaxDaqList = 255
        XcpEventChannelNumber = 1
        XcpEventChannelTimeCycle = 10
        XcpEventChannelTimeUnit = TIMESTAMP_UNIT_1MS
        XcpEventChannelType = DAQ
        XcpEventChannelCoreRef = XcpCoreDefinition
      XcpCoreDefinition: XcpSendQueueSize=256, XcpEcuCCoreDefinitionRef=EcucCoreDefinition
