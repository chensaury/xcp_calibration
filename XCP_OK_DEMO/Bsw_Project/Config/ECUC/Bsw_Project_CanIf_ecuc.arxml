AUTOSAR XML (schema 4-2-1)
package /ActiveEcuC
  module config CanIf: implementation-config-variant=VARIANT-PRE-COMPILE, module-description=CanIf_Impl
    CanIfCtrlDrvCfg_7d254554 (CanIfCtrlDrvCfg): CanIfCtrlDrvTxCancellation=false, CanIfCtrlDrvInitHohConfigRef=CanIfInitHohCfg, CanIfCtrlDrvNameRef=CanGeneral
      CT_CAN00_617059cf (CanIfCtrlCfg): CanIfCtrlId=0, CanIfCtrlWakeupSupport=false, CanIfCtrlJ1939DynAddrSupport=DISABLED, CanIfCtrlCanCtrlRef=CT_CAN00_617059cf
    CanIfDispatchCfg:
      CanIfDispatchUserCtrlBusOffName = CanSM_ControllerBusOff
      CanIfDispatchUserCtrlBusOffUL = CAN_SM
      CanIfDispatchUserCtrlModeIndicationName = CanSM_ControllerModeIndication
      CanIfDispatchUserCtrlModeIndicationUL = CAN_SM
    CanIfInitCfg
      3 x CanIfRxPduCfg, all with CanIfRxPduCanIdType=STANDARD_CAN, CanIfRxPduDlc=8, CanIfRxPduUserRxIndicationName=PduR_CanIfRxIndication, CanIfRxPduUserRxIndicationUL=PDUR, CanIfRxPduReadData=false, CanIfRxPduReadNotifyStatus=false, CanIfRxPduDlcCheck=true, CanIfRxPduHrhIdRef=CN_CAN00_e847a2b9_Rx:
        ACP_327_oCAN00_721e8970_Rx: CanIfRxPduCanId=807, CanIfRxPduId=3, CanIfRxPduRef=ACP_327_oCAN00_296526c1_Rx
        ACP_32E_oCAN00_cb06c350_Rx: CanIfRxPduCanId=814, CanIfRxPduId=2, CanIfRxPduRef=ACP_32E_oCAN00_c2ae66cc_Rx
        B_RLS_oCAN00_c4f7769e_Rx: CanIfRxPduCanId=998, CanIfRxPduId=1, CanIfRxPduRef=B_RLS_oCAN00_8929dfa4_Rx
      CHNL_0fb271d2 (CanIfBufferCfg):
        CanIfBufferSize = 2
        CanIfTxBufferHandlingType = PRIO_BY_CANID
        CanIfTxBufferMappedTxPdus = 2
        CanIfTxBufferMaxPduLength = 8
        CanIfBufferHthRef = CN_CAN00_a2de9a4f_Tx
      CanIfInitHohCfg: CanIfInitRefCfgSet=CanConfigSet
        CN_CAN00_e847a2b9_Rx (CanIfHrhCfg): CanIfHrhSoftwareFilter=true, CanIfHrhCanCtrlIdRef=CT_CAN00_617059cf, CanIfHrhIdSymRef=CN_CAN00_e847a2b9_Rx
        CN_CAN00_a2de9a4f_Tx (CanIfHthCfg): CanIfHthCanCtrlIdRef=CT_CAN00_617059cf, CanIfHthIdSymRef=CN_CAN00_a2de9a4f_Tx
      ITMS_350_oCAN00_9748bb1c_Tx (CanIfTxPduCfg):
        CanIfTxPduCanId = 848
        CanIfTxPduCanIdType = STANDARD_CAN
        CanIfTxPduDlc = 8
        CanIfTxPduUserTxConfirmationName = PduR_CanIfTxConfirmation
        CanIfTxPduUserTxConfirmationUL = PDUR
        CanIfTxPduId = 1
        CanIfTxPduReadNotifyStatus = false
        CanIfTxPduType = STATIC
        CanIfTxPduBufferRef = CHNL_0fb271d2
        CanIfTxPduRef = ITMS_350_oCAN00_93beae7b_Tx
      XCP_R_oCAN00_267e057e_Tx (CanIfTxPduCfg):
        CanIfTxPduCanId = 1790
        CanIfTxPduCanIdType = STANDARD_CAN
        CanIfTxPduDlc = 8
        CanIfTxPduUserTxConfirmationName = Xcp_CanIfTxConfirmation
        CanIfTxPduUserTxConfirmationUL = XCP
        CanIfTxPduId = 0
        CanIfTxPduReadNotifyStatus = false
        CanIfTxPduType = STATIC
        CanIfTxPduBufferRef = CHNL_0fb271d2
        CanIfTxPduRef = XCP_R_oCAN00_31486e7f_Tx
      XCP_S_oCAN00_d18922f7_Rx (CanIfRxPduCfg):
        CanIfRxPduCanId = 1791
        CanIfRxPduCanIdType = STANDARD_CAN
        CanIfRxPduDlc = 8
        CanIfRxPduUserRxIndicationName = Xcp_CanIfRxIndication
        CanIfRxPduUserRxIndicationUL = XCP
        CanIfRxPduId = 0
        CanIfRxPduReadData = false
        CanIfRxPduReadNotifyStatus = false
        CanIfRxPduDlcCheck = true
        CanIfRxPduHrhIdRef = CN_CAN00_e847a2b9_Rx
        CanIfRxPduRef = XCP_S_oCAN00_aa3b84ab_Rx
    CanIfPrivateCfg:
      CanIfPrivateSoftwareFilterType = LINEAR
      CanIfPrivateDlcCheck = true
      CanIfSupportTTCAN = false
      CanIfTransceiverMapping = false
      CanIfTransceiverHandling = false
      CanIfSupportExtendedIds = false
      CanIfSupportNmOsek = false
      CanIfTxBufferType = BYTE_QUEUE
      CanIfOptimizeOneController = true
      CanIfWakeupSupport = false
      CanIfStaticFdTxBufferSupport = false
      CanIfRxSearchConsiderMsgType = false
      CanIfMultipleBasicCANTxObjects = false
      CanIfTxBufferFifoSupport = false
      CanIfSetPduReceptionModeSupport = false
      CanIfDataChecksumRxSupport = false
      CanIfDataChecksumTxSupport = false
    CanIfPublicCfg:
      CanIfPublicPnSupport = false
      CanIfPublicCancelTransmitSupport = false
      CanIfPublicDevErrorDetect = false
      CanIfPublicHandleTypeEnum = UINT8
      CanIfPublicMultipleDrvSupport = false
      CanIfPublicNumberOfCanHwUnits = 1
      CanIfPublicReadRxPduDataApi = false
      CanIfPublicReadRxPduNotifyStatusApi = false
      CanIfPublicReadTxPduNotifyStatusApi = false
      CanIfPublicSetDynamicTxIdApi = false
      CanIfPublicTxBuffering = true
      CanIfPublicTxConfirmPollingSupport = false
      CanIfPublicVersionInfoApi = false
      CanIfPublicWakeupCheckValidSupport = false
      CanIfPnWakeupTxPduFilterSupport = false
      CanIfPnTrcvHandlingSupport = false
      CanIfJ1939DynAddrSupport = DISABLED
      CanIfSafeBswChecks = false
      CanIfSetBaudrateApi = false
