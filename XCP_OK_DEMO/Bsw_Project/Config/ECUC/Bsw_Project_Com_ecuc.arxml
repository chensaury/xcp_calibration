AUTOSAR XML (schema 4-2-1)
package /ActiveEcuC
  module config Com: implementation-config-variant=VARIANT-PRE-COMPILE, module-description=Com_Impl
    ComGeneration:
      ComOutOfBoundsWriteProtectionStrategy = NONE
      ComOutOfBoundsWriteSanitizer = false
      ComOutOfBoundsReadSanitizer = false
      ComReduceConstantData2Define = false
      ComBoolDataInArrayOfStructStrategy = BOOLEAN
      ComDeduplicateIndirectedData = true
      ComDataDeduplicationStrategy = WITH_CAST
      ComReduceBoolDataByNegationThreshold = 2
      ComReduceBoolDataByNumericalComparisonThreshold = 2
      ComReduceBoolDataByNumericalRelationThreshold = 2
      ComReduceBoolDataByNumericalOperandStrategy = WITH_ANY_VALUE
      ComReduceNumericalDataByOffsetThreshold = 2
      ComReduceNumericalDataByArraySubtractionThreshold = 2
      ComReduceDataByStreaming = false
      ComShortSymbols = false
      ComInterfacesForDeactivatedData = false
      ComReferringKeysInComments = false
    ComOptimization:
      ComTxCyclicProcessingISRLockThreshold = 1
      ComTxDeadlineMonitoringISRLockThreshold = 1
      ComTxProcessingISRLockThreshold = 1
      ComRxDeadlineMonitoringISRLockThreshold = 1
      ComRxDeferredProcessingISRLockThreshold = 1
      ComGatewayProcessingISRLockThreshold = 1
      ComGatewayDescriptionProcessingISRLockThreshold = 1
      ComIPduGroupISRLockThreshold = 1
    ComConfig: ComConfigurationId=0, ComRxDeferredNotificationCacheSize=0, ComRxImmediateNotificationCacheSize=0
      ComTimeBase: ComRxTimeBase=0.01, ComTxTimeBase=0.001, ComGwTimeBase=0.01
      AllowOperation_Flag_oITMS_350_oCAN00_009f228c_Tx (ComSignal):
        ComBitPosition = 24
        ComBitSize = 1
        ComSignalEndianness = BIG_ENDIAN
        ComSignalInitValue = 0
        ComSignalType = BOOLEAN
        ComTransferProperty = PENDING
        ComSignalAccess = ACCESS_UNCLEAR
        ComHandleId = 1
        ComSystemTemplateSystemSignalRef = AllowOperation_Flag
      Ecomp_Complpt_A_oACP_327_oCAN00_ea282991_Rx (ComSignal):
        ComBitPosition = 39
        ComBitSize = 16
        ComSignalEndianness = BIG_ENDIAN
        ComSignalInitValue = 0
        ComSignalType = UINT16
        ComTimeout = 0
        ComSignalAccess = ACCESS_UNCLEAR
        ComHandleId = 10
        ComSystemTemplateSystemSignalRef = Ecomp_Complpt_A
      ITMS_oCAN00_Rx_06702e0c (ComIPduGroup): ComIPduGroupHandleId=0
      TgtSpd_rpm_oITMS_350_oCAN00_b9dd7dcf_Tx (ComSignal):
        ComBitPosition = 55
        ComBitSize = 16
        ComSignalEndianness = BIG_ENDIAN
        ComSignalInitValue = 0
        ComSignalType = UINT16
        ComTransferProperty = PENDING
        ComSignalAccess = ACCESS_UNCLEAR
        ComHandleId = 2
        ComSystemTemplateSystemSignalRef = TgtSpd_rpm
      AC_max_perm_compressor_power_oITMS_350_oCAN00_ef8bdcbc_Tx (ComSignal):
        ComBitPosition = 7
        ComBitSize = 8
        ComSignalEndianness = BIG_ENDIAN
        ComSignalInitValue = 0
        ComSignalType = UINT8
        ComTransferProperty = PENDING
        ComSignalAccess = ACCESS_UNCLEAR
        ComHandleId = 0
        ComSystemTemplateSystemSignalRef = AC_max_perm_compressor_power
      ACP_32E_oCAN00_11d3b5e8_Rx (ComIPdu):
        ComIPduDirection = RECEIVE
        ComIPduType = NORMAL
        ComIPduHandleId = 0
        ComIPduSignalProcessing = DEFERRED
        ComIPduCancellationSupport = false
        ComIPduGroupRef = ITMS_oCAN00_Rx_06702e0c
        ComIPduSignalRef = Comp_error_code1_oACP_32E_oCAN00_b5915ac1_Rx
        ComIPduSignalRef = Comp_speed_of_compressor_oACP_32E_oCAN00_c033917a_Rx
        ComIPduSignalRef = Comp_work_status_oACP_32E_oCAN00_1667710c_Rx
        ComPduIdRef = ACP_32E_oCAN00_11d3b5e8_Rx
      ITMS_350_oCAN00_8869cfa0_Tx (ComIPdu):
        ComIPduDirection = SEND
        ComIPduType = NORMAL
        ComIPduHandleId = 0
        ComIPduSignalProcessing = DEFERRED
        ComIPduCancellationSupport = false
        ComIPduGroupRef = ITMS_oCAN00_Tx_502a898a
        ComIPduSignalRef = AC_max_perm_compressor_power_oITMS_350_oCAN00_ef8bdcbc_Tx
        ComIPduSignalRef = AllowOperation_Flag_oITMS_350_oCAN00_009f228c_Tx
        ComIPduSignalRef = TgtSpd_rpm_oITMS_350_oCAN00_b9dd7dcf_Tx
        ComPduIdRef = ITMS_350_oCAN00_8869cfa0_Tx
        ComTxIPdu: ComMinimumDelayTime=0.001, ComTxIPduUnusedAreasDefault=0
          ComTxModeTrue
            ComTxMode: ComTxModeMode=PERIODIC, ComTxModeTimeOffset=0, ComTxModeTimePeriod=0.1
          ComTxModeFalse
            ComTxMode: ComTxModeMode=PERIODIC, ComTxModeTimeOffset=0, ComTxModeTimePeriod=0.1
      3 x ComSignal, all with ComSignalEndianness=BIG_ENDIAN, ComTimeout=0, ComSignalAccess=ACCESS_UNCLEAR:
        Comp_error_code1_oACP_32E_oCAN00_b5915ac1_Rx: ComBitPosition=39, ComBitSize=8, ComSignalInitValue=0, ComSignalType=UINT8, ComHandleId=6, ComSystemTemplateSystemSignalRef=Comp_error_code1
        B_RLS_DewPoint_oB_RLS_oCAN00_421173c7_Rx: ComBitPosition=33, ComBitSize=10, ComSignalInitValue=396, ComSignalType=UINT16, ComHandleId=0, ComSystemTemplateSystemSignalRef=B_RLS_DewPoint
        B_RLS_Offline_Calibration_Result_oB_RLS_oCAN00_f4cfd300_Rx: ComBitPosition=49, ComBitSize=2, ComSignalInitValue=0, ComSignalType=UINT8, ComHandleId=1, ComSystemTemplateSystemSignalRef=B_RLS_Offline_Calibration_Result
      ITMS_oCAN00_Tx_502a898a (ComIPduGroup): ComIPduGroupHandleId=1
      3 x ComSignal, all with ComSignalEndianness=BIG_ENDIAN, ComTimeout=0, ComSignalAccess=ACCESS_UNCLEAR:
        Ecomp_CompIpt_V_oACP_327_oCAN00_c7006e5a_Rx: ComBitPosition=23, ComBitSize=16, ComSignalInitValue=0, ComSignalType=UINT16, ComHandleId=9, ComSystemTemplateSystemSignalRef=Ecomp_CompIpt_V
        Ecomp_InvSoftwareVer_oACP_327_oCAN00_4030e33b_Rx: ComBitPosition=7, ComBitSize=16, ComSignalInitValue=0, ComSignalType=UINT16, ComHandleId=11, ComSystemTemplateSystemSignalRef=Ecomp_InvSoftwareVer
        B_RLS_WindshieldTemp_oB_RLS_oCAN00_6dbe9061_Rx: ComBitPosition=31, ComBitSize=8, ComSignalInitValue=80, ComSignalType=UINT8, ComHandleId=4, ComSystemTemplateSystemSignalRef=B_RLS_WindshieldTemp
      ACP_327_oCAN00_ffa62305_Rx (ComIPdu):
        ComIPduDirection = RECEIVE
        ComIPduType = NORMAL
        ComIPduHandleId = 1
        ComIPduSignalProcessing = DEFERRED
        ComIPduCancellationSupport = false
        ComIPduGroupRef = ITMS_oCAN00_Rx_06702e0c
        ComIPduSignalRef = Ecomp_CompIpt_V_oACP_327_oCAN00_c7006e5a_Rx
        ComIPduSignalRef = Ecomp_Complpt_A_oACP_327_oCAN00_ea282991_Rx
        ComIPduSignalRef = Ecomp_InvSoftwareVer_oACP_327_oCAN00_4030e33b_Rx
        ComPduIdRef = ACP_327_oCAN00_ffa62305_Rx
      4 x ComSignal, all with ComSignalEndianness=BIG_ENDIAN, ComTimeout=0, ComSignalAccess=ACCESS_UNCLEAR:
        B_RLS_SolarLeft_oB_RLS_oCAN00_3b2a55ba_Rx: ComBitPosition=7, ComBitSize=8, ComSignalInitValue=0, ComSignalType=UINT8, ComHandleId=2, ComSystemTemplateSystemSignalRef=B_RLS_SolarLeft
        Comp_speed_of_compressor_oACP_32E_oCAN00_c033917a_Rx: ComBitPosition=7, ComBitSize=16, ComSignalInitValue=0, ComSignalType=UINT16, ComHandleId=7, ComSystemTemplateSystemSignalRef=Comp_speed_of_compressor
        B_RLS_SolarRight_oB_RLS_oCAN00_6bd7c4e8_Rx: ComBitPosition=15, ComBitSize=8, ComSignalInitValue=0, ComSignalType=UINT8, ComHandleId=3, ComSystemTemplateSystemSignalRef=B_RLS_SolarRight
        B_RLS_relativeHumidity_oB_RLS_oCAN00_e615f445_Rx: ComBitPosition=23, ComBitSize=8, ComSignalInitValue=1, ComSignalType=UINT8, ComHandleId=5, ComSystemTemplateSystemSignalRef=B_RLS_relativeHumidity
      B_RLS_oCAN00_6419d093_Rx (ComIPdu):
        ComIPduDirection = RECEIVE
        ComIPduType = NORMAL
        ComIPduHandleId = 2
        ComIPduSignalProcessing = DEFERRED
        ComIPduCancellationSupport = false
        ComIPduGroupRef = ITMS_oCAN00_Rx_06702e0c
        ComIPduSignalRef = B_RLS_DewPoint_oB_RLS_oCAN00_421173c7_Rx
        ComIPduSignalRef = B_RLS_Offline_Calibration_Result_oB_RLS_oCAN00_f4cfd300_Rx
        ComIPduSignalRef = B_RLS_SolarLeft_oB_RLS_oCAN00_3b2a55ba_Rx
        ComIPduSignalRef = B_RLS_SolarRight_oB_RLS_oCAN00_6bd7c4e8_Rx
        ComIPduSignalRef = B_RLS_WindshieldTemp_oB_RLS_oCAN00_6dbe9061_Rx
        ComIPduSignalRef = B_RLS_relativeHumidity_oB_RLS_oCAN00_e615f445_Rx
        ComPduIdRef = B_RLS_oCAN00_6419d093_Rx
      Comp_work_status_oACP_32E_oCAN00_1667710c_Rx (ComSignal):
        ComBitPosition = 31
        ComBitSize = 8
        ComSignalEndianness = BIG_ENDIAN
        ComSignalInitValue = 0
        ComSignalType = UINT8
        ComTimeout = 0
        ComSignalAccess = ACCESS_UNCLEAR
        ComHandleId = 8
        ComSystemTemplateSystemSignalRef = Comp_work_status
    ComGeneral:
      ComConfigurationUseDet = true
      ComEnableSignalGroupArrayApi = false
      ComRetryFailedTransmitRequests = false
      ComSupportedIPduGroups = 2
      ComVersionInfoApi = false
      ComAdvancedIPduCallouts = true
      ComOptimizedIPduGroupHandling = false
      ComMetaDataSupport = false
      ComReceiveSignalMacroAPI = false
      ComDeferredEventCacheSupport = false
      ComMainfunctionTimingDomainSupport = false
      ComDescriptionRoutingCodeGeneration = false
      ComSafeBswChecks = false
