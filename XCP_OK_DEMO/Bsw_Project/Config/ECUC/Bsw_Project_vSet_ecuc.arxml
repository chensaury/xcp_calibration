AUTOSAR XML (schema 4-2-1)
package /ActiveEcuC
  module config vSet: implementation-config-variant=VARIANT-PRE-COMPILE, module-description=vSet_Impl
    vSetCalibration
    vSetGeneral: vSetDummyStatementKind=None
    vSetPlatform:
      vSetSizeOfRAMPointer = Size32Bit
      vSetSizeOfROMPointer = Size32Bit
      vSetBitOrder = LSB_to_MSB
      vSetSizeOfEnum = Size32Bit
      vSetCPUType = CPU32Bit
      vSetSizeOfInt = Size32Bit
      vSetByteOrder = LITTLE_ENDIAN
