AUTOSAR XML (schema 4-2-1)
package /MICROSAR
  bsw implementation EcuM_Impl: programming-language=C, sw-version=10.00.00, used-code-generator=DaVinci Configurator, vendor-id=30, ar-release-version=4.00.03
package /MICROSAR/EcuM_ib_bswmd/BswModuleDescriptions
  bsw module description EcuM: provided-entrys=EcuM_MainFunction
    bsw internal behavior EcuMBehavior
      exclusive area ECUM_EXCLUSIVE_AREA_0  # This exclusive area shall disable all wake up interrupts to prevent overwriting of some global variables.
      exclusive area ECUM_EXCLUSIVE_AREA_1  # This exclusive area is only used in case of multi core and if the the EcuM is configured to handle also the slave cores. It must be configured as a spinlock to allow access to some variables simultaneously from multiple cores.
      exclusive area ECUM_EXCLUSIVE_AREA_2  # This exclusive area is used for accessing the clock variable. It shall disable GPT interrupts and task changes. Only necessary if 32 Bit access is not atomic and Alarm Clock is present.
      bsw schedulable entity EcuM_MainFunction: implemented-entry=EcuM_MainFunction
      6 x bsw timing event, all with starts-on-event=EcuM_MainFunction, period=0.01:
        EcuM_MainFunctionTimingEvent{0..5}
  bsw module entry EcuM_MainFunction: call-type=SCHEDULED, execution-context=TASK
