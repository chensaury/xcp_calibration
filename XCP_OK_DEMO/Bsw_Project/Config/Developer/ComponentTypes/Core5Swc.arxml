AUTOSAR XML (schema 00044)
package /ComponentTypes
  application sw component type Core5Swc
    behavior Core5Swc_InternalBehavior
      timing event TMT_Core5Runnable: start-on-event=Core5Runnable, period=5
      runnable Core5Runnable
  swc implementation Core5Swc_Implementation: behavior=Core5Swc_InternalBehavior
