AUTOSAR XML (schema 00044)
package /ComponentTypes
  application sw component type Core2Swc
    behavior Core2Swc_InternalBehavior
      timing event TMT_Core2Runnable: start-on-event=Core2Runnable, period=0.5
      runnable Core2Runnable
  swc implementation Core2Swc_Implementation: behavior=Core2Swc_InternalBehavior
