AUTOSAR XML (schema 00044)
package /ComponentTypes
  application sw component type Core1Swc
    behavior Core1Swc_InternalBehavior
      timing event TMT_Core1Runnable: start-on-event=Core1Runnable, period=0.2
      runnable Core1Runnable
  swc implementation Core1Swc_Implementation: behavior=Core1Swc_InternalBehavior
