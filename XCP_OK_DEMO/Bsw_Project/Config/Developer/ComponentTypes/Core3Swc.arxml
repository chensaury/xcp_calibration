AUTOSAR XML (schema 00044)
package /ComponentTypes
  application sw component type Core3Swc
    behavior Core3Swc_InternalBehavior
      timing event TMT_Core3Runnable: start-on-event=Core3Runnable, period=1
      runnable Core3Runnable
  swc implementation Core3Swc_Implementation: behavior=Core3Swc_InternalBehavior
