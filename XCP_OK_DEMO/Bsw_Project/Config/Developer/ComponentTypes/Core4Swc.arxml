AUTOSAR XML (schema 00044)
package /ComponentTypes
  application sw component type Core4Swc
    behavior Core4Swc_InternalBehavior
      timing event TMT_Core4Runnable: start-on-event=Core4Runnable, period=2
      runnable Core4Runnable
  swc implementation Core4Swc_Implementation: behavior=Core4Swc_InternalBehavior
