AUTOSAR XML (schema 4-2-2)
# Copyright (C) Infineon Technologies (2018)
# All rights reserved.
package /AUTOSAR_Mcu/BswModuleDescriptions
  bsw module description Mcu: category=BSW_MODULE, module-id=101  # Mcu Driver
    provided-entrys:
      Mcu_Init
      Mcu_InitRamSection
      Mcu_InitClock
      Mcu_DistributePllClock
      Mcu_GetPllStatus
      Mcu_GetResetReason
      Mcu_GetResetRawValue
      Mcu_PerformReset
      Mcu_SetMode
      Mcu_InitCheck
      Mcu_17_Gtm_TomChannelInit
      Mcu_17_Gtm_TomChannelShadowTransfer
      Mcu_17_Gtm_TomChannelDeInit
      Mcu_17_Gtm_AtomChannelInit
      Mcu_17_Gtm_AtomChannelShadowTransfer
      Mcu_17_Gtm_AtomChannelDeInit
      Mcu_17_Gtm_TimChannelInit
      Mcu_17_Gtm_TimChannelDeInit
      Mcu_17_Gtm_TomChannelEnable
      Mcu_17_Gtm_TomChannelDisable
      Mcu_17_Gtm_IsTomChannelEnabled
      Mcu_17_Gtm_AtomChannelEnable
      Mcu_17_Gtm_AtomChannelDisable
      Mcu_17_Gtm_IsAtomChannelEnabled
      Mcu_17_Gtm_TimChannelEnable
      Mcu_17_Gtm_TimChannelDisable
      Mcu_17_Gtm_IsTimChannelEnabled
      Mcu_17_Gtm_ConnectPortPinToTim
      Mcu_17_Gtm_ConnectTimerOutToPortPin
      Mcu_17_Gtm_TomTriggerRequest
      Mcu_17_Gtm_TomChInitCheck
      Mcu_17_Gtm_TomChUpdateEnDis
      Mcu_17_Gtm_TomChOutEnCtrlUpdate
      Mcu_17_Gtm_TomChOutEnStatUpdate
      Mcu_17_Gtm_TomChEndisCtrlUpdate
      Mcu_17_Gtm_TomChEndisStatUpdate
      Mcu_17_Gtm_AtomTriggerRequest
      Mcu_17_Gtm_AtomChInitCheck
      Mcu_17_Gtm_AtomChUpdateEnDis
      Mcu_17_Gtm_AtomChOutEnCtrlUpdate
      Mcu_17_Gtm_AtomChOutEnStatUpdate
      Mcu_17_Gtm_AtomChEndisCtrlUpdate
      Mcu_17_Gtm_AtomChEndisStatUpdate
      Mcu_17_Gtm_TomChannelIsr
      Mcu_17_Gtm_AtomChannelIsr
      Mcu_17_Gtm_TimChannelIsr
      Mcu_17_Ccu6_TimerInit
      Mcu_17_Ccu6_TimerDeInit
      Mcu_17_Ccu6_TimerStart
      Mcu_17_Ccu6_TimerStop
      Mcu_17_Ccu6_TimerShadowTransfer
      Mcu_17_Ccu6_TimerIntEnDis
      Mcu_17_Ccu6_ChannelIsr
      Mcu_17_Gpt12_TimerInit
      Mcu_17_Gpt12_TimerDeInit
      Mcu_17_Gpt12_TimerStart
      Mcu_17_Gpt12_TimerStop
      Mcu_17_Gpt12_TimerClockInit
      Mcu_17_Gpt12_ChannelIsr
      Mcu_17_Stm_SetupComparator
      Mcu_17_Stm_CheckComparator
      Mcu_17_Stm_ComparatorIntDisable
      Mcu_17_Stm_CompareMatchIsr
      Mcu_17_Eru_GatingIsr
      Mcu_17_Gtm_TimChInitCheck
      Mcu_17_Ccu6_TimerInitCheck
      Mcu_17_Gpt12_TimerInitCheck
    4 x bsw module dependency:
      DemDependency: target-module-id=54, required-entrys=Dem_ReportErrorStatus
      GptDependency: target-module-id=100, required-entrys=Gpt_Isr
      PwmDependency: target-module-id=121, required-entrys=Pwm_17_GtmCcu6_Isr
      IcuDependency: target-module-id=122, required-entrys=Icu_17_TimerIp_Timer_Isr
    bsw internal behavior McuBehavior
      exclusive area TomTgcReg
      exclusive area AtomAgcReg
      26 x bsw called entity:
        Mcu_Init: reentrancy-level=NON-REENTRANT, implemented-entry=Mcu_Init
        Mcu_InitClock: reentrancy-level=NON-REENTRANT, implemented-entry=Mcu_InitClock
        Mcu_InitRamSection: reentrancy-level=MULTICORE-REENTRANT, implemented-entry=Mcu_InitRamSection
        Mcu_PerformReset: reentrancy-level=MULTICORE-REENTRANT, implemented-entry=Mcu_PerformReset
        Mcu_SetMode: reentrancy-level=NON-REENTRANT, implemented-entry=Mcu_SetMode
        Mcu_DistributePllClock: reentrancy-level=NON-REENTRANT, implemented-entry=Mcu_DistributePllClock
        Mcu_GetPllStatus: reentrancy-level=MULTICORE-REENTRANT, implemented-entry=Mcu_GetPllStatus
        Mcu_GetResetRawValue: reentrancy-level=MULTICORE-REENTRANT, implemented-entry=Mcu_GetResetRawValue
        Mcu_GetResetReason: reentrancy-level=MULTICORE-REENTRANT, implemented-entry=Mcu_GetResetReason
        Mcu_17_Gtm_TomChannelInit: reentrancy-level=MULTICORE-REENTRANT, implemented-entry=Mcu_17_Gtm_TomChannelInit
        Mcu_17_Gtm_TomChannelShadowTransfer: can-enter-exclusive-area=TomTgcReg, reentrancy-level=NON-REENTRANT, implemented-entry=Mcu_17_Gtm_TomChannelShadowTransfer
        Mcu_17_Gtm_TomChannelDeInit: can-enter-exclusive-area=TomTgcReg, reentrancy-level=MULTICORE-REENTRANT, implemented-entry=Mcu_17_Gtm_TomChannelDeInit
        Mcu_17_Gtm_AtomChannelInit: reentrancy-level=MULTICORE-REENTRANT, implemented-entry=Mcu_17_Gtm_AtomChannelInit
        Mcu_17_Gtm_AtomChannelShadowTransfer: can-enter-exclusive-area=AtomAgcReg, reentrancy-level=NON-REENTRANT, implemented-entry=Mcu_17_Gtm_AtomChannelShadowTransfer
        Mcu_17_Gtm_AtomChannelDeInit: can-enter-exclusive-area=AtomAgcReg, reentrancy-level=MULTICORE-REENTRANT, implemented-entry=Mcu_17_Gtm_AtomChannelDeInit
        Mcu_17_Gtm_TimChannelInit: reentrancy-level=MULTICORE-REENTRANT, implemented-entry=Mcu_17_Gtm_TimChannelInit
        Mcu_17_Gtm_TimChannelDeInit: reentrancy-level=MULTICORE-REENTRANT, implemented-entry=Mcu_17_Gtm_TimChannelDeInit
        Mcu_17_Gtm_TomChannelEnable: can-enter-exclusive-area=TomTgcReg, reentrancy-level=MULTICORE-REENTRANT, implemented-entry=Mcu_17_Gtm_TomChannelEnable
        Mcu_17_Gtm_TomChannelDisable: can-enter-exclusive-area=TomTgcReg, reentrancy-level=MULTICORE-REENTRANT, implemented-entry=Mcu_17_Gtm_TomChannelDisable
        Mcu_17_Gtm_IsTomChannelEnabled: reentrancy-level=MULTICORE-REENTRANT, implemented-entry=Mcu_17_Gtm_IsTomChannelEnabled
        Mcu_17_Gtm_AtomChannelEnable: can-enter-exclusive-area=AtomAgcReg, reentrancy-level=MULTICORE-REENTRANT, implemented-entry=Mcu_17_Gtm_AtomChannelEnable
        Mcu_17_Gtm_AtomChannelDisable: can-enter-exclusive-area=AtomAgcReg, reentrancy-level=MULTICORE-REENTRANT, implemented-entry=Mcu_17_Gtm_AtomChannelDisable
        Mcu_17_Gtm_IsAtomChannelEnabled: reentrancy-level=MULTICORE-REENTRANT, implemented-entry=Mcu_17_Gtm_IsAtomChannelEnabled
        Mcu_17_Gtm_TimChannelEnable: reentrancy-level=MULTICORE-REENTRANT, implemented-entry=Mcu_17_Gtm_TimChannelEnable
        Mcu_17_Gtm_TimChannelDisable: reentrancy-level=MULTICORE-REENTRANT, implemented-entry=Mcu_17_Gtm_TimChannelDisable
        Mcu_17_Gtm_IsTimChannelEnabled: reentrancy-level=MULTICORE-REENTRANT, implemented-entry=Mcu_17_Gtm_IsTimChannelEnabled
      bsw interrupt entity Mcu_17_Gtm_TimChannelIsr: reentrancy-level=MULTICORE-REENTRANT, implemented-entry=Mcu_17_Gtm_TimChannelIsr
      bsw interrupt entity Mcu_17_Gtm_TomChannelIsr: reentrancy-level=MULTICORE-REENTRANT, implemented-entry=Mcu_17_Gtm_TomChannelIsr
      bsw interrupt entity Mcu_17_Gtm_AtomChannelIsr: reentrancy-level=MULTICORE-REENTRANT, implemented-entry=Mcu_17_Gtm_AtomChannelIsr
      23 x bsw called entity, all with reentrancy-level=MULTICORE-REENTRANT:
        Mcu_17_Gtm_ConnectPortPinToTim: implemented-entry=Mcu_17_Gtm_ConnectPortPinToTim
        Mcu_17_Gtm_ConnectTimerOutToPortPin: implemented-entry=Mcu_17_Gtm_ConnectTimerOutToPortPin
        Mcu_17_Gtm_TomTriggerRequest: can-enter-exclusive-area=TomTgcReg, implemented-entry=Mcu_17_Gtm_TomTriggerRequest
        Mcu_17_Gtm_TomChInitCheck: implemented-entry=Mcu_17_Gtm_TomChInitCheck
        Mcu_17_Gtm_TomChUpdateEnDis: can-enter-exclusive-area=TomTgcReg, implemented-entry=Mcu_17_Gtm_TomChUpdateEnDis
        Mcu_17_Gtm_TomChOutEnCtrlUpdate: can-enter-exclusive-area=TomTgcReg, implemented-entry=Mcu_17_Gtm_TomChOutEnCtrlUpdate
        Mcu_17_Gtm_TomChOutEnStatUpdate: can-enter-exclusive-area=TomTgcReg, implemented-entry=Mcu_17_Gtm_TomChOutEnStatUpdate
        Mcu_17_Gtm_TomChEndisCtrlUpdate: can-enter-exclusive-area=TomTgcReg, implemented-entry=Mcu_17_Gtm_TomChEndisCtrlUpdate
        Mcu_17_Gtm_TomChEndisStatUpdate: can-enter-exclusive-area=TomTgcReg, implemented-entry=Mcu_17_Gtm_TomChEndisStatUpdate
        Mcu_17_Gtm_AtomTriggerRequest: can-enter-exclusive-area=AtomAgcReg, implemented-entry=Mcu_17_Gtm_AtomTriggerRequest
        Mcu_17_Gtm_AtomChInitCheck: implemented-entry=Mcu_17_Gtm_AtomChInitCheck
        Mcu_17_Gtm_AtomChUpdateEnDis: can-enter-exclusive-area=AtomAgcReg, implemented-entry=Mcu_17_Gtm_AtomChUpdateEnDis
        Mcu_17_Gtm_AtomChOutEnCtrlUpdate: can-enter-exclusive-area=AtomAgcReg, implemented-entry=Mcu_17_Gtm_AtomChOutEnCtrlUpdate
        Mcu_17_Gtm_AtomChOutEnStatUpdate: can-enter-exclusive-area=AtomAgcReg, implemented-entry=Mcu_17_Gtm_AtomChOutEnStatUpdate
        Mcu_17_Gtm_AtomChEndisCtrlUpdate: can-enter-exclusive-area=AtomAgcReg, implemented-entry=Mcu_17_Gtm_AtomChEndisCtrlUpdate
        Mcu_17_Gtm_AtomChEndisStatUpdate: can-enter-exclusive-area=AtomAgcReg, implemented-entry=Mcu_17_Gtm_AtomChEndisStatUpdate
        Mcu_17_Gtm_TimChInitCheck: implemented-entry=Mcu_17_Gtm_TimChInitCheck
        Mcu_17_Ccu6_TimerInit: implemented-entry=Mcu_17_Ccu6_TimerInit
        Mcu_17_Ccu6_TimerStart: implemented-entry=Mcu_17_Ccu6_TimerStart
        Mcu_17_Ccu6_TimerStop: implemented-entry=Mcu_17_Ccu6_TimerStop
        Mcu_17_Ccu6_TimerShadowTransfer: implemented-entry=Mcu_17_Ccu6_TimerShadowTransfer
        Mcu_17_Ccu6_TimerIntEnDis: implemented-entry=Mcu_17_Ccu6_TimerIntEnDis
        Mcu_17_Ccu6_TimerDeInit: implemented-entry=Mcu_17_Ccu6_TimerDeInit
      bsw interrupt entity Mcu_17_Ccu6_ChannelIsr: reentrancy-level=MULTICORE-REENTRANT, implemented-entry=Mcu_17_Ccu6_ChannelIsr
      5 x bsw called entity, all with reentrancy-level=MULTICORE-REENTRANT:
        Mcu_17_Gpt12_TimerInit: implemented-entry=Mcu_17_Gpt12_TimerInit
        Mcu_17_Gpt12_TimerDeInit: implemented-entry=Mcu_17_Gpt12_TimerDeInit
        Mcu_17_Gpt12_TimerStart: implemented-entry=Mcu_17_Gpt12_TimerStart
        Mcu_17_Gpt12_TimerStop: implemented-entry=Mcu_17_Gpt12_TimerStop
        Mcu_17_Gpt12_TimerClockInit: implemented-entry=Mcu_17_Gpt12_TimerClockInit
      bsw interrupt entity Mcu_17_Gpt12_ChannelIsr: reentrancy-level=MULTICORE-REENTRANT, implemented-entry=Mcu_17_Gpt12_ChannelIsr
      bsw interrupt entity Mcu_17_Stm_CompareMatchIsr: reentrancy-level=MULTICORE-REENTRANT, implemented-entry=Mcu_17_Stm_CompareMatchIsr
      bsw interrupt entity Mcu_17_Eru_GatingIsr: reentrancy-level=MULTICORE-REENTRANT, implemented-entry=Mcu_17_Eru_GatingIsr
      6 x bsw called entity:
        Mcu_17_Stm_SetupComparator: reentrancy-level=MULTICORE-REENTRANT, implemented-entry=Mcu_17_Stm_SetupComparator
        Mcu_17_Stm_CheckComparator: reentrancy-level=MULTICORE-REENTRANT, implemented-entry=Mcu_17_Stm_CheckComparator
        Mcu_17_Stm_ComparatorIntDisable: reentrancy-level=MULTICORE-REENTRANT, implemented-entry=Mcu_17_Stm_ComparatorIntDisable
        Mcu_17_Ccu6_TimerInitCheck: reentrancy-level=MULTICORE-REENTRANT, implemented-entry=Mcu_17_Ccu6_TimerInitCheck
        Mcu_17_Gpt12_TimerInitCheck: reentrancy-level=MULTICORE-REENTRANT, implemented-entry=Mcu_17_Gpt12_TimerInitCheck
        Mcu_InitCheck: reentrancy-level=NON-REENTRANT, implemented-entry=Mcu_InitCheck
      service-needs:
        diagnostic event needs MCU_E_GTM_CLC_ENABLE_ERR
      service-needs:
        diagnostic event needs MCU_E_GTM_CLC_DISABLE_ERR
      service-needs:
        diagnostic event needs MCU_E_CCU6_CLC_DISABLE_ERR
      service-needs:
        diagnostic event needs MCU_E_OSC_FAILURE
      service-needs:
        diagnostic event needs MCU_E_SYSTEM_PLL_TIMEOUT_ERR
      service-needs:
        diagnostic event needs MCU_E_SYSTEM_PLL_LOCK_LOSS
      service-needs:
        diagnostic event needs MCU_E_PERIPHERAL_PLL_LOCK_LOSS
      service-needs:
        diagnostic event needs MCU_E_PERIPHERAL_PLL_TIMEOUT_ERR
      service-needs:
        diagnostic event needs MCU_E_CONVCTRL_CLC_ENABLE_ERR
      service-needs:
        diagnostic event needs MCU_E_CCUCON0_UPDATE_ERR
      service-needs:
        diagnostic event needs MCU_E_CCU6_CLC_ENABLE_ERR
      service-needs:
        diagnostic event needs MCU_E_CONVCTRL_CLC_DISABLE_ERR
      service-needs:
        diagnostic event needs MCU_E_GPT12_CLC_ENABLE_ERR
      service-needs:
        diagnostic event needs MCU_E_GPT12_CLC_DISABLE_ERR
      service-needs:
        diagnostic event needs MCU_E_PMSWCR_UPDATE_ERR
package /AUTOSAR_Mcu/BswModuleEntrys
  67 x bsw module entry, all with is-synchronous=true, sw-service-impl-policy=STANDARD:
    Mcu_Init: service-id=0, is-reentrant=false, call-type=REGULAR, execution-context=TASK
      sw service arg ConfigPtr: category=DATA_REFERENCE, sw-pointer-target-props={target-category=TYPE_REFERENCE, implementation-data-type=Mcu_ConfigType}
    Mcu_InitClock: service-id=2, is-reentrant=false, call-type=REGULAR, execution-context=TASK
      return type Return: implementation-data-type=Std_ReturnType
      sw service arg ClockSetting: implementation-data-type=Mcu_ClockType
    Mcu_InitRamSection: service-id=1, is-reentrant=true, call-type=REGULAR, execution-context=TASK
      return type Return: implementation-data-type=Std_ReturnType
      sw service arg RamSection: implementation-data-type=Mcu_RamSectionType
    Mcu_PerformReset: service-id=7, is-reentrant=true, call-type=REGULAR, execution-context=TASK
    Mcu_SetMode: service-id=8, is-reentrant=false, call-type=REGULAR, execution-context=TASK
      sw service arg McuMode: implementation-data-type=Mcu_ModeType
    Mcu_DistributePllClock: service-id=3, is-reentrant=false, call-type=REGULAR, execution-context=TASK
      return type Return: implementation-data-type=Std_ReturnType
    Mcu_GetPllStatus: service-id=4, is-reentrant=true, call-type=REGULAR, execution-context=TASK
      return type Return: implementation-data-type=Mcu_PllStatusType, additional-native-type-qualifier=enum
    Mcu_GetResetRawValue: service-id=6, is-reentrant=true, call-type=REGULAR, execution-context=TASK
      return type Return: implementation-data-type=Mcu_RawResetType
    Mcu_GetResetReason: service-id=5, is-reentrant=true, call-type=REGULAR, execution-context=TASK
      return type Return: implementation-data-type=Mcu_ResetType, additional-native-type-qualifier=enum
    Mcu_17_Gtm_TomChannelInit: service-id=96, is-reentrant=true, call-type=REGULAR, execution-context=TASK
      sw service arg ConfigPtr: category=DATA_REFERENCE, sw-pointer-target-props={target-category=TYPE_REFERENCE, implementation-data-type=Mcu_17_Gtm_TomAtomChConfigType}
    Mcu_17_Gtm_TomChannelShadowTransfer: service-id=97, is-reentrant=false, call-type=REGULAR, execution-context=TASK
      sw service arg Module: implementation-data-type=uint8
      sw service arg Channel: implementation-data-type=uint8
    Mcu_17_Gtm_TomChannelDeInit: service-id=99, is-reentrant=true, call-type=REGULAR, execution-context=TASK
      sw service arg Module: implementation-data-type=uint8
      sw service arg Channel: implementation-data-type=uint8
    Mcu_17_Gtm_TomChannelDisable: service-id=105, is-reentrant=true, call-type=REGULAR, execution-context=TASK
      sw service arg Module: implementation-data-type=uint8
      sw service arg Channel: implementation-data-type=uint8
    Mcu_17_Gtm_TomChannelEnable: service-id=104, is-reentrant=true, call-type=REGULAR, execution-context=TASK
      sw service arg Module: implementation-data-type=uint8
      sw service arg Channel: implementation-data-type=uint8
      sw service arg TimerOutputEn: implementation-data-type=Mcu_17_Gtm_TimerOutputEnableType
    Mcu_17_Gtm_IsTomChannelEnabled: service-id=110, is-reentrant=true, call-type=REGULAR, execution-context=TASK
      return type Return: implementation-data-type=Mcu_17_Gtm_TimerStatusType
      sw service arg Module: implementation-data-type=uint8
      sw service arg Channel: implementation-data-type=uint8
    Mcu_17_Gtm_IsAtomChannelEnabled: service-id=111, is-reentrant=true, call-type=REGULAR, execution-context=TASK
      return type Return: implementation-data-type=Mcu_17_Gtm_TimerStatusType
      sw service arg Module: implementation-data-type=uint8
      sw service arg Channel: implementation-data-type=uint8
    Mcu_17_Gtm_IsTimChannelEnabled: service-id=112, is-reentrant=true, call-type=REGULAR, execution-context=TASK
      return type Return: implementation-data-type=Mcu_17_Gtm_TimerStatusType
      sw service arg Module: implementation-data-type=uint8
      sw service arg Channel: implementation-data-type=uint8
    Mcu_17_Gtm_AtomChannelInit: service-id=100, is-reentrant=true, call-type=REGULAR, execution-context=TASK
      sw service arg ConfigPtr: category=DATA_REFERENCE, sw-pointer-target-props={target-category=TYPE_REFERENCE, implementation-data-type=Mcu_17_Gtm_TomAtomChConfigType}
    Mcu_17_Gtm_AtomChannelShadowTransfer: service-id=101, is-reentrant=false, call-type=REGULAR, execution-context=TASK
      sw service arg Module: implementation-data-type=uint8
      sw service arg Channel: implementation-data-type=uint8
    Mcu_17_Gtm_AtomChannelDeInit: service-id=102, is-reentrant=true, call-type=REGULAR, execution-context=TASK
      sw service arg Module: implementation-data-type=uint8
      sw service arg Channel: implementation-data-type=uint8
    Mcu_17_Gtm_AtomChannelEnable: service-id=106, is-reentrant=true, call-type=REGULAR, execution-context=TASK
      sw service arg Module: implementation-data-type=uint8
      sw service arg Channel: implementation-data-type=uint8
      sw service arg TimerOutputEn: implementation-data-type=Mcu_17_Gtm_TimerOutputEnableType
    Mcu_17_Gtm_AtomChannelDisable: service-id=107, is-reentrant=true, call-type=REGULAR, execution-context=TASK
      sw service arg Module: implementation-data-type=uint8
      sw service arg Channel: implementation-data-type=uint8
    Mcu_17_Gtm_TimChannelInit: service-id=98, is-reentrant=true, call-type=REGULAR, execution-context=TASK
      sw service arg ConfigPtr: category=DATA_REFERENCE, sw-pointer-target-props={target-category=TYPE_REFERENCE, implementation-data-type=Mcu_17_Gtm_TimChConfigType}
    Mcu_17_Gtm_TimChannelDeInit: service-id=103, is-reentrant=true, call-type=REGULAR, execution-context=TASK
      sw service arg Module: implementation-data-type=uint8
      sw service arg Channel: implementation-data-type=uint8
    Mcu_17_Gtm_TimChannelEnable: service-id=108, is-reentrant=true, call-type=REGULAR, execution-context=TASK
      sw service arg Module: implementation-data-type=uint8
      sw service arg Channel: implementation-data-type=uint8
    Mcu_17_Gtm_TimChannelDisable: service-id=109, is-reentrant=true, call-type=REGULAR, execution-context=TASK
      sw service arg Module: implementation-data-type=uint8
      sw service arg Channel: implementation-data-type=uint8
    Mcu_17_Gtm_TimChannelIsr: is-reentrant=true, call-type=INTERRUPT, execution-context=INTERRUPT-CAT-1
      sw service arg Module: implementation-data-type=uint8
      sw service arg Channel: implementation-data-type=uint8
    Mcu_17_Gtm_TomChannelIsr: is-reentrant=true, call-type=INTERRUPT, execution-context=INTERRUPT-CAT-1
      sw service arg Module: implementation-data-type=uint8
      sw service arg Channel: implementation-data-type=uint8
    Mcu_17_Gtm_AtomChannelIsr: is-reentrant=true, call-type=INTERRUPT, execution-context=INTERRUPT-CAT-1
      sw service arg Module: implementation-data-type=uint8
      sw service arg Channel: implementation-data-type=uint8
    Mcu_17_Gtm_ConnectPortPinToTim: service-id=114, is-reentrant=true, call-type=REGULAR, execution-context=TASK
      sw service arg Module: implementation-data-type=uint8
      sw service arg Channel: implementation-data-type=uint8
      sw service arg TimerChselValue: implementation-data-type=uint8
    Mcu_17_Gtm_ConnectTimerOutToPortPin: service-id=113, is-reentrant=true, call-type=REGULAR, execution-context=TASK
      sw service arg Tout_IndexNumber: implementation-data-type=uint16
      sw service arg TimerOutColumnSelect: implementation-data-type=Mcu_17_Gtm_MappedPortTimerOutType
    Mcu_17_Gtm_TomChInitCheck: service-id=116, is-reentrant=true, call-type=REGULAR, execution-context=TASK
      return type Return: implementation-data-type=Std_ReturnType
      sw service arg ConfigPtr: category=DATA_REFERENCE, sw-pointer-target-props={target-category=TYPE_REFERENCE, implementation-data-type=Mcu_17_Gtm_TomAtomChConfigType}
    Mcu_17_Gtm_AtomChInitCheck: service-id=123, is-reentrant=true, call-type=REGULAR, execution-context=TASK
      return type Return: implementation-data-type=Std_ReturnType
      sw service arg ConfigPtr: category=DATA_REFERENCE, sw-pointer-target-props={target-category=TYPE_REFERENCE, implementation-data-type=Mcu_17_Gtm_TomAtomChConfigType}
    Mcu_17_Gtm_TimChInitCheck: service-id=129, is-reentrant=true, call-type=REGULAR, execution-context=TASK
      return type Return: implementation-data-type=Std_ReturnType
      sw service arg ConfigPtr: category=DATA_REFERENCE, sw-pointer-target-props={target-category=TYPE_REFERENCE, implementation-data-type=Mcu_17_Gtm_TomAtomChConfigType}
    Mcu_17_Gtm_AtomChEndisCtrlUpdate: service-id=127, is-reentrant=true, call-type=REGULAR, execution-context=TASK
      sw service arg Module: implementation-data-type=uint8
      sw service arg Channel: implementation-data-type=uint8
      sw service arg TimerEnDis: implementation-data-type=Mcu_17_Gtm_TimerEnTriggerType
    Mcu_17_Gtm_AtomChEndisStatUpdate: service-id=128, is-reentrant=true, call-type=REGULAR, execution-context=TASK
      sw service arg Module: implementation-data-type=uint8
      sw service arg Channel: implementation-data-type=uint8
      sw service arg TimerEnDis: implementation-data-type=Mcu_17_Gtm_TimerEnableType
    Mcu_17_Gtm_TomChEndisStatUpdate: service-id=121, is-reentrant=true, call-type=REGULAR, execution-context=TASK
      sw service arg Module: implementation-data-type=uint8
      sw service arg Channel: implementation-data-type=uint8
      sw service arg TimerEnDis: implementation-data-type=Mcu_17_Gtm_TimerEnTriggerType
    Mcu_17_Gtm_TomChEndisCtrlUpdate: service-id=120, is-reentrant=true, call-type=REGULAR, execution-context=TASK
      sw service arg Module: implementation-data-type=uint8
      sw service arg Channel: implementation-data-type=uint8
      sw service arg TimerEnDis: implementation-data-type=Mcu_17_Gtm_TimerEnTriggerType
    Mcu_17_Gtm_AtomChOutEnStatUpdate: service-id=126, is-reentrant=true, call-type=REGULAR, execution-context=TASK
      sw service arg Module: implementation-data-type=uint8
      sw service arg Channel: implementation-data-type=uint8
      sw service arg TimerOutputEnDis: implementation-data-type=Mcu_17_Gtm_TimerOutputEnableType
    Mcu_17_Gtm_TomChOutEnStatUpdate: service-id=119, is-reentrant=true, call-type=REGULAR, execution-context=TASK
      sw service arg Module: implementation-data-type=uint8
      sw service arg Channel: implementation-data-type=uint8
      sw service arg TimerOutputEnDis: implementation-data-type=Mcu_17_Gtm_TimerOutputEnableType
    Mcu_17_Gtm_TomChOutEnCtrlUpdate: service-id=118, is-reentrant=true, call-type=REGULAR, execution-context=TASK
      sw service arg Module: implementation-data-type=uint8
      sw service arg Channel: implementation-data-type=uint8
      sw service arg TimerOutputEnDis: implementation-data-type=Mcu_17_Gtm_TimerOutputEnTriggerType
    Mcu_17_Gtm_TomChUpdateEnDis: service-id=117, is-reentrant=true, call-type=REGULAR, execution-context=TASK
      sw service arg Module: implementation-data-type=uint8
      sw service arg Channel: implementation-data-type=uint8
      sw service arg UpEnVal: implementation-data-type=Mcu_17_Gtm_TimerUpdateEnableType
    Mcu_17_Gtm_AtomChUpdateEnDis: service-id=124, is-reentrant=true, call-type=REGULAR, execution-context=TASK
      sw service arg Module: implementation-data-type=uint8
      sw service arg Channel: implementation-data-type=uint8
      sw service arg UpEnVal: implementation-data-type=Mcu_17_Gtm_TimerUpdateEnableType
    Mcu_17_Gtm_AtomChOutEnCtrlUpdate: service-id=125, is-reentrant=true, call-type=REGULAR, execution-context=TASK
      sw service arg Module: implementation-data-type=uint8
      sw service arg Channel: implementation-data-type=uint8
      sw service arg TimerOutputEnDis: implementation-data-type=Mcu_17_Gtm_TimerOutputEnTriggerType
    Mcu_17_Gtm_AtomTriggerRequest: service-id=122, is-reentrant=true, call-type=REGULAR, execution-context=TASK
      sw service arg Module: implementation-data-type=uint8
      sw service arg TriggerChannels: implementation-data-type=uint16
    Mcu_17_Gtm_TomTriggerRequest: service-id=115, is-reentrant=true, call-type=REGULAR, execution-context=TASK
      sw service arg Module: implementation-data-type=uint8
      sw service arg TomTgcIndex: implementation-data-type=uint8
      sw service arg TriggerChannels: implementation-data-type=uint16
    Mcu_17_Ccu6_TimerInit: service-id=130, is-reentrant=true, call-type=REGULAR, execution-context=TASK
      sw service arg ConfigPtr: category=DATA_REFERENCE, sw-pointer-target-props={target-category=TYPE_REFERENCE, implementation-data-type=Mcu_17_Ccu6_TimerConfigType}
    Mcu_17_Ccu6_TimerDeInit: service-id=131, is-reentrant=true, call-type=REGULAR, execution-context=TASK
      sw service arg TimerId: implementation-data-type=Mcu_17_Ccu6_TimerChIdentifierType
    Mcu_17_Ccu6_TimerStart: service-id=132, is-reentrant=true, call-type=REGULAR, execution-context=TASK
      sw service arg TimerId: implementation-data-type=Mcu_17_Ccu6_TimerChIdentifierType
    Mcu_17_Ccu6_TimerStop: service-id=133, is-reentrant=true, call-type=REGULAR, execution-context=TASK
      sw service arg TimerId: implementation-data-type=Mcu_17_Ccu6_TimerChIdentifierType
    Mcu_17_Ccu6_TimerShadowTransfer: service-id=134, is-reentrant=true, call-type=REGULAR, execution-context=TASK
      sw service arg TimerId: implementation-data-type=Mcu_17_Ccu6_TimerChIdentifierType
    Mcu_17_Ccu6_TimerIntEnDis: service-id=135, is-reentrant=true, call-type=REGULAR, execution-context=TASK
      sw service arg Ccu6IntConfig: category=DATA_REFERENCE, sw-pointer-target-props={target-category=TYPE_REFERENCE, implementation-data-type=Mcu_17_Ccu6_TimerChIntType}
    Mcu_17_Ccu6_ChannelIsr: is-reentrant=true, call-type=INTERRUPT, execution-context=INTERRUPT-CAT-1
      sw service arg Kernel: implementation-data-type=Mcu_17_Ccu6_KernelIdentifierType
      sw service arg Comparator: implementation-data-type=Mcu_17_Ccu6_ComparatorType
    Mcu_17_Gpt12_TimerInit: service-id=138, is-reentrant=true, call-type=REGULAR, execution-context=TASK
      sw service arg ConfigPtr: category=DATA_REFERENCE, sw-pointer-target-props={target-category=TYPE_REFERENCE, implementation-data-type=Mcu_17_Gpt12_TimerConfigType}
    Mcu_17_Gpt12_TimerDeInit: service-id=146, is-reentrant=true, call-type=REGULAR, execution-context=TASK
      sw service arg TimerId: implementation-data-type=Mcu_17_Gpt12_TimerChIdentifierType
    Mcu_17_Gpt12_TimerStart: service-id=147, is-reentrant=true, call-type=REGULAR, execution-context=TASK
      sw service arg TimerId: implementation-data-type=Mcu_17_Gpt12_TimerChIdentifierType
    Mcu_17_Gpt12_TimerStop: service-id=148, is-reentrant=true, call-type=REGULAR, execution-context=TASK
      sw service arg TimerId: implementation-data-type=Mcu_17_Gpt12_TimerChIdentifierType
    Mcu_17_Gpt12_TimerClockInit: service-id=149, is-reentrant=true, call-type=REGULAR, execution-context=TASK
      sw service arg BlockId: implementation-data-type=Mcu_17_Gpt12_TimerBlockType
      sw service arg ClockDiv: implementation-data-type=Mcu_17_Gpt12_ClkPrescalarType
    Mcu_17_Gpt12_ChannelIsr: is-reentrant=true, call-type=INTERRUPT, execution-context=INTERRUPT-CAT-1
      sw service arg Timer: implementation-data-type=Mcu_17_Gpt12_TimerChIdentifierType
    Mcu_InitCheck: service-id=90, is-reentrant=false, call-type=REGULAR, execution-context=TASK
      return type Return: implementation-data-type=Std_ReturnType
      sw service arg ConfigPtr: category=DATA_REFERENCE, sw-pointer-target-props={target-category=TYPE_REFERENCE, implementation-data-type=Mcu_ConfigType}
    Mcu_17_Ccu6_TimerInitCheck: service-id=137, is-reentrant=true, call-type=REGULAR, execution-context=TASK
      return type Return: implementation-data-type=Std_ReturnType
      sw service arg ConfigPtr: category=DATA_REFERENCE, sw-pointer-target-props={target-category=TYPE_REFERENCE, implementation-data-type=Mcu_17_Gtm_TomAtomChConfigType}
    Mcu_17_Gpt12_TimerInitCheck: service-id=139, is-reentrant=true, call-type=REGULAR, execution-context=TASK
      return type Return: implementation-data-type=Std_ReturnType
      sw service arg ConfigPtr: category=DATA_REFERENCE, sw-pointer-target-props={target-category=TYPE_REFERENCE, implementation-data-type=Mcu_17_Gtm_TomAtomChConfigType}
    Mcu_17_Stm_ComparatorIntDisable: service-id=136, is-reentrant=true, call-type=REGULAR, execution-context=TASK
      sw service arg StmTimerId: implementation-data-type=uint8
      sw service arg StmComparatorId: implementation-data-type=uint8
    Mcu_17_Stm_SetupComparator: service-id=144, is-reentrant=true, call-type=REGULAR, execution-context=TASK
      sw service arg ConfigPtr: category=DATA_REFERENCE, sw-pointer-target-props={target-category=TYPE_REFERENCE, implementation-data-type=Mcu_17_Stm_TimerConfigType}
    Mcu_17_Stm_CheckComparator: service-id=145, is-reentrant=true, call-type=REGULAR, execution-context=TASK
      return type Return: implementation-data-type=Std_ReturnType
      sw service arg ConfigPtr: category=DATA_REFERENCE, sw-pointer-target-props={target-category=TYPE_REFERENCE, implementation-data-type=Mcu_17_Stm_TimerConfigType}
    Mcu_17_Eru_GatingIsr: is-reentrant=true, call-type=INTERRUPT, execution-context=INTERRUPT-CAT-1
      sw service arg Timer: implementation-data-type=Mcu_17_Eru_SrcIdentifierType
    Mcu_17_Stm_CompareMatchIsr: is-reentrant=true, call-type=INTERRUPT, execution-context=INTERRUPT-CAT-1
      sw service arg StmTimerId: implementation-data-type=Mcu_17_Stm_StmIdentifierType
      sw service arg StmCmpId: implementation-data-type=Mcu_17_Stm_StmCmpIdentifierType
package /AUTOSAR_Mcu/Implementations
  bsw implementation Mcu: programming-language=C, sw-version=4.0.0, vendor-id=17, ar-release-version=4.2.2, behavior=McuBehavior, vendor-specific-module-def=Mcu
    code-descriptors:
      code Files: artifact-descriptors=[{short-label=ssc::src::Mcu.c, category=SWSRC}, {short-label=ssc::inc::Mcu.h, category=SWHDR}]
    4 x compiler:
      TASKING_COMPILE: name=TASKING, options="--core=tc1.6.2 --iso=99 -O2 --eabi-compliant -AGKpvX --switch=auto --integer-enumeration --default-near-size=0 --fp-model=1", vendor=Altium, version=V6.2r2
      GNU_COMPILE: name=GNU, options="-DGNU -Wall -std=c99 -c -O2 -mtc162 -meabi -fno-short-enums -ffunction-sections -fdata-sections -fstrict-volatile-bitfields", vendor=Hightec, version=V4.9.2.0
      DIAB_COMPILE: name=DIAB, options="-tTC162NF:simple -O -XO -Xsection-split=1 -Xkeep-assembly-file=2 -g3 -Xinline=0 -Xdialect-c99 -ei5388,2273,5387 -ei1824 -Xsmall-data=0 -Xsmall-const=0", vendor=Windriver, version=V5.9.6.4
      GHS_COMPILE: name=GHS, options="-cpu=tc1v162 --no_commons --gnu_asm --no_short_enum -c99 -Ospeed -Onounroll -g -c -dwarf2", vendor=GreenHills, version=V2017.5.5
    generated-artifacts:
      6 x dependency on artifact:
        Mcu_PBcfg_c: artifact-descriptor={short-label=generate::template::src::Mcu_PBcfg.c, category=SWTEMPLATE}, usages=EXECUTE
        Mcu_Cfg_h: artifact-descriptor={short-label=generate::template::inc::Mcu_Cfg.h, category=SWTEMPLATE}, usages=COMPILE
        Mcu_PBcfg_h: artifact-descriptor={short-label=generate::template::inc::Mcu_PBcfg.h, category=SWTEMPLATE}, usages=EXECUTE
        Mcu_xdm: artifact-descriptor={short-label=config::Mcu.xdm, category=SWTOOL}, usages=CODEGENERATION
        McuPreConfiguration_xdm: artifact-descriptor={short-label=config::McuPreConfiguration.xdm, category=SWTOOL}, usages=CODEGENERATION
        Mcu_bmd: artifact-descriptor={short-label=autosar::TC39x::TC397x::Mcu.bmd, category=SWTOOL}, usages=CODEGENERATION
    4 x linker:
      TASKING_LINK: name=TASKING, options="--map-file -OtcXYL --core=mpe:vtc", vendor=Altium, version=V6.2r2
      GNU_LINK: name=GNU, options="-Wl,--mcpu=tc162 -Wl,--gc-sections -nostartfiles -n", vendor=Hightec, version=V4.9.2.0
      DIAB_LINK: name=DIAB, options="-tTC162NF:simple -m6 -Xremove-unused-sections", vendor=Windriver, version=V5.9.6.4
      GHS_LINK: name=GHS, options="-cpu=tc1v162 -ignore_debug_references", vendor=GreenHills, version=V2017.5.5
    resource consumption ResourceConsumption
      memory section CONFIG_DATA_ASIL_B_GLOBAL_UNSPECIFIED: alignment=UNSPECIFIED, sw-addrmethod=CONST
      memory section VAR_CLEARED_ASIL_B_GLOBAL_32: alignment=32, sw-addrmethod=VAR
      memory section CODE_ASIL_B_GLOBAL: alignment=UNSPECIFIED, sw-addrmethod=CODE
      section name prefix MCU
  bsw implementation Mcu_17_TimerIp: programming-language=C, sw-version=4.0.0, vendor-id=17, ar-release-version=4.2.2, behavior=McuBehavior, vendor-specific-module-def=Mcu_17_TimerIp
    code-descriptors:
      code Files
        artifact-descriptors:
          short-label=ssc::src::Mcu_17_TimerIp.c, category=SWSRC
          short-label=ssc::inc::Mcu_17_TimerIp.h, category=SWHDR
    4 x compiler:
      TASKING_COMPILE: name=TASKING, options="--core=tc1.6.2 --iso=99 -O2 --eabi-compliant -AGKpvX --switch=auto --integer-enumeration --default-near-size=0 --fp-model=1", vendor=Altium, version=V6.2r2
      GNU_COMPILE: name=GNU, options="-DGNU -Wall -std=c99 -c -O2 -mtc162 -meabi -fno-short-enums -ffunction-sections -fdata-sections -fstrict-volatile-bitfields", vendor=Hightec, version=V4.9.2.0
      DIAB_COMPILE: name=DIAB, options="-tTC162NF:simple -O -XO -Xsection-split=1 -Xkeep-assembly-file=2 -g3 -Xinline=0 -Xdialect-c99 -ei5388,2273,5387 -ei1824 -Xsmall-data=0 -Xsmall-const=0", vendor=Windriver, version=V5.9.6.4
      GHS_COMPILE: name=GHS, options="-cpu=tc1v162 --no_commons --gnu_asm --no_short_enum -c99 -Ospeed -Onounroll -g -c -dwarf2", vendor=GreenHills, version=V2017.5.5
    generated-artifacts:
      dependency on artifact Mcu_17_TimerIp_Cfg_c: artifact-descriptor={short-label=generate::template::src::Mcu_17_TimerIp_Cfg.c, category=SWTEMPLATE}, usages=COMPILE
      dependency on artifact Mcu_17_TimerIp_Cfg_h: artifact-descriptor={short-label=generate::template::inc::Mcu_17_TimerIp_Cfg.h, category=SWTEMPLATE}, usages=COMPILE
    4 x linker:
      TASKING_LINK: name=TASKING, options="--map-file -OtcXYL --core=mpe:vtc", vendor=Altium, version=V6.2r2
      GNU_LINK: name=GNU, options="-Wl,--mcpu=tc162 -Wl,--gc-sections -nostartfiles -n", vendor=Hightec, version=V4.9.2.0
      DIAB_LINK: name=DIAB, options="-tTC162NF:simple -m6 -Xremove-unused-sections", vendor=Windriver, version=V5.9.6.4
      GHS_LINK: name=GHS, options="-cpu=tc1v162 -ignore_debug_references", vendor=GreenHills, version=V2017.5.5
    resource consumption ResourceConsumption
      9 x memory section:
        VAR_CLEARED_ASIL_B_GLOBAL_32: alignment=32, sw-addrmethod=VAR
        CONFIG_DATA_ASIL_B_GLOBAL_8: alignment=8, sw-addrmethod=CONST
        CONST_ASIL_B_GLOBAL_UNSPECIFIED: alignment=UNSPECIFIED, sw-addrmethod=CONST
        CONFIG_DATA_ASIL_B_GLOBAL_16: alignment=16, sw-addrmethod=CONST
        VAR_INIT_ASIL_B_GLOBAL_32: alignment=32, sw-addrmethod=VAR
        VAR_INIT_ASIL_B_GLOBAL_UNSPECIFIED: alignment=UNSPECIFIED, sw-addrmethod=VAR
        CODE_ASIL_B_GLOBAL: alignment=UNSPECIFIED, sw-addrmethod=CODE
        CODE_FAST_ASIL_B_GLOBAL: alignment=UNSPECIFIED, sw-addrmethod=CODE
        CONFIG_DATA_ASIL_B_GLOBAL_32: alignment=32, sw-addrmethod=CONST
      section name prefix MCU_17_TIMERIP
package /AUTOSAR_Mcu/ImplementationDataTypes
  49 x impl type:
    Mcu_17_Ccu6_TimerChIntType: category=STRUCTURE
      4 x element, all with category=TYPE_REFERENCE:
        TimerId: implementation-data-type=Mcu_17_Ccu6_TimerChIdentifierType
        IEnBitPos: implementation-data-type=uint8
        IEnLen: implementation-data-type=uint8
        RegVal: implementation-data-type=uint8
    Mcu_17_Eru_SrcIdentifierType: implementation-data-type=uint8, type-emitter=BSW
    Mcu_17_Gpt12_ClkPrescalarType: implementation-data-type=uint8, type-emitter=BSW
    Mcu_17_Gpt12_TimerBlockType: implementation-data-type=uint8, type-emitter=BSW
    Mcu_17_Gtm_MappedPortTimerOutType:
      compu {0-MCU_OUT_TIMER_MAPPED_COL_A, 1-MCU_OUT_TIMER_MAPPED_COL_B, 2-MCU_OUT_TIMER_MAPPED_COL_C, 3-MCU_OUT_TIMER_MAPPED_COL_D, 4-MCU_OUT_TIMER_MAPPED_COL_E, 5-MCU_OUT_TIMER_MAPPED_COL_F, 6-MCU_OUT_TIMER_MAPPED_COL_G, 7-MCU_OUT_TIMER_MAPPED_COL_H, 8-MCU_OUT_TIMER_MAPPED_COL_I, 9-MCU_OUT_TIMER_MAPPED_COL_J, 10-MCU_OUT_TIMER_MAPPED_COL_K, 11-MCU_OUT_TIMER_MAPPED_COL_L}
      implementation-data-type=uint32
      additional-native-type-qualifier=enum
      type-emitter=BSW
    Mcu_17_Gtm_TimerEnableType: implementation-data-type=uint8, type-emitter=BSW
    Mcu_17_Gtm_TimerEnTriggerType: compu {0-MCU_NOCHANGE_ON_TRIGGER, 1-MCU_DISABLE_ON_TRIGGER, 2-MCU_ENABLE_ON_TRIGGER}, implementation-data-type=uint32, additional-native-type-qualifier=enum, type-emitter=BSW
    Mcu_17_Gtm_TimerOutputEnableType: compu {0-MCU_GTM_TIMER_OUT_DISABLE, 1-MCU_GTM_TIMER_OUT_ENABLE}, implementation-data-type=uint32, additional-native-type-qualifier=enum, type-emitter=BSW
    Mcu_17_Gtm_TimerOutputEnTriggerType: compu {0-MCU_NOCHANGE_OUT_ON_TRIGGER, 1-MCU_DISABLE_OUT_ON_TRIGGER, 2-MCU_ENABLE_OUT_ON_TRIGGER}, implementation-data-type=uint32, additional-native-type-qualifier=enum, type-emitter=BSW
    Mcu_17_Gtm_TimerUpdateEnableType: implementation-data-type=uint8, type-emitter=BSW
    Mcu_17_Stm_StmCmpIdentifierType: implementation-data-type=uint8, type-emitter=BSW
    Mcu_17_Stm_StmIdentifierType: implementation-data-type=uint8, type-emitter=BSW
    Mcu_17_Stm_TimerConfigType: category=STRUCTURE
      5 x element, all with category=TYPE_REFERENCE:
        StmTimerId: sw-bit-representation=number-of-bits=8, implementation-data-type=uint8
        CMPRegId: sw-bit-representation=number-of-bits=8, implementation-data-type=unsigned_int
        CompareRegVal: sw-bit-representation=number-of-bits=8, implementation-data-type=unsigned_int
        reserved: sw-bit-representation=number-of-bits=8, implementation-data-type=unsigned_int
        CmconRegVal: implementation-data-type=unsigned_int
    Mcu_PllStatusType: compu {0 - MCU_PLL_LOCKED, 1 - MCU_PLL_UNLOCKED, 2 - MCU_PLL_STATUS_UNDEFINED}, implementation-data-type=uint32, additional-native-type-qualifier=enum, type-emitter=BSW
    Mcu_ClockType: implementation-data-type=uint32, type-emitter=BSW
    Mcu_ResetType:
      compu {0 - MCU_ESR0_RESET, 1 - MCU_ESR1_RESET, 2 - MCU_SMU_RESET, 3 - MCU_SW_RESET, 4 - MCU_STM0_RESET, 5 - MCU_STM1_RESET, 6 - MCU_STM2_RESET, 7 - MCU_STM3_RESET, 8 - MCU_STM4_RESET, 9 - MCU_STM5_RESET, 10 - MCU_POWER_ON_RESET, 11 - MCU_CB0_RESET, 12 - MCU_CB1_RESET, 13 - MCU_CB3_RESET, 14 - MCU_EVRC_RESET, 15 - MCU_EVR33_RESET, 16 - MCU_SUPPLY_WDOG_RESET, 17 - MCU_STBYR_RESET, 18 - MCU_LBIST_RESET, 254 - MCU_RESET_MULTIPLE, 255 - MCU_RESET_UNDEFINED}
      implementation-data-type=uint32
      additional-native-type-qualifier=enum
      type-emitter=BSW
    Mcu_RawResetType: implementation-data-type=uint32, type-emitter=BSW
    Mcu_RamSectionType: implementation-data-type=uint32, type-emitter=BSW
    Mcu_ModeType: implementation-data-type=uint8, type-emitter=BSW
    Mcu_17_Gtm_TimChConfigType: category=STRUCTURE
      6 x element, all with category=TYPE_REFERENCE:
        TimerId: implementation-data-type=Mcu_17_Gtm_TimerChIdentifierType
        TimChCtrlReg: implementation-data-type=uint32
        TimChExtendedCtrlReg: implementation-data-type=uint32
        TimChFltRisingEdge: implementation-data-type=uint32
        TimChFltFallingEdge: implementation-data-type=uint32
        TimChIntEnMode: implementation-data-type=uint8
    Mcu_17_Gtm_TimerChIdentifierType: implementation-data-type=uint32, type-emitter=BSW
    Mcu_17_Gtm_TimerOutType: compu {0 - MCU_GTM_TIMER_TOM, 1 - MCU_GTM_TIMER_ATOM}, implementation-data-type=uint32, additional-native-type-qualifier=enum, type-emitter=BSW
    Mcu_17_Gtm_TomAtomChConfigType: category=STRUCTURE
      10 x element, all with category=TYPE_REFERENCE:
        TimerType: implementation-data-type=Mcu_17_Gtm_TimerOutType
        TimerId: implementation-data-type=Mcu_17_Gtm_TimerChIdentifierType
        TimerChCtrlReg: implementation-data-type=uint32
        TimerChCN0Reg: implementation-data-type=uint32
        TimerChCM0Reg: implementation-data-type=uint32
        TimerChCM1Reg: implementation-data-type=uint32
        TimerChSR0Reg: implementation-data-type=uint32
        TimerChSR1Reg: implementation-data-type=uint32
        TimerChPortOutConfig: implementation-data-type=uint32
        TimerChIntEnMode: implementation-data-type=uint8
    Mcu_17_Gtm_TimerStatusType: compu {0 - MCU_GTM_TIMER_STOPPED, 1 - MCU_GTM_TIMER_RUNNING}, implementation-data-type=uint32, additional-native-type-qualifier=enum, type-emitter=BSW
    Mcu_17_Ccu6_ComparatorType: implementation-data-type=uint8, type-emitter=BSW
    Mcu_17_Ccu6_KernelIdentifierType: implementation-data-type=uint8, type-emitter=BSW
    Mcu_17_Ccu6_TimerChIdentifierType: implementation-data-type=uint32, type-emitter=BSW
    Mcu_17_Ccu6_TimerConfigType: category=STRUCTURE
      11 x element, all with category=TYPE_REFERENCE:
        TimerId: implementation-data-type=Mcu_17_Ccu6_TimerChIdentifierType
        TimerCtrlReg0: implementation-data-type=uint32
        ModCtrlReg: implementation-data-type=uint32
        PasStateLvlReg: implementation-data-type=uint32
        TimerCntReg: implementation-data-type=uint32
        TimerPeriodReg: implementation-data-type=uint32
        Ccu6ShadowReg: implementation-data-type=uint32
        TimerModeSelectReg: implementation-data-type=uint8
        PortInSelReg0: implementation-data-type=uint8
        IntEnReg: implementation-data-type=uint8
        IntNodePointerReg: implementation-data-type=uint8
    Mcu_17_Gpt12_TimerChIdentifierType: implementation-data-type=uint8, type-emitter=BSW
    Mcu_17_Gpt12_TimerConfigType: category=STRUCTURE
      4 x element, all with category=TYPE_REFERENCE:
        TimerId: implementation-data-type=Mcu_17_Gpt12_TimerChIdentifierType
        TimerCtrlReg: implementation-data-type=uint32
        TimerCntReg: implementation-data-type=uint32
        PortInSelReg: implementation-data-type=uint8
    Mcu_ClockConfigType: category=STRUCTURE
      12 x element:
        SystemPllCfg: implementation-data-type=Mcu_SystemPllConfigType
        PeripheralPllCfg: implementation-data-type=Mcu_PeripheralPllConfigType
        SysPllK2DivStepUpChangeDelay: implementation-data-type=uint32
        SysPllK2DivStepDownChangeDelay: implementation-data-type=uint32
        PeripheralPllK2StepUpChangeDelay: implementation-data-type=uint32
        PeripheralPllK2StepDownChangeDelay: implementation-data-type=uint32
        PeripheralPllK3StepUpChangeDelay: implementation-data-type=uint32
        PeripheralPllK3StepDownChangeDelay: implementation-data-type=uint32
        PllDistributionCfgPtr: category=DATA_REFERENCE, sw-pointer-target-props={target-category=TYPE_REFERENCE, implementation-data-type=Mcu_PllDistributionConfigType}
        ExternalClockCfg: implementation-data-type=Mcu_ExternalClockConfigType
        BackupFreqKDiv: implementation-data-type=uint16
        ConvCtrlBlockConf: implementation-data-type=uint8
    Mcu_ConfigType: category=STRUCTURE
      10 x element:
        McuClockSettingPtr: category=DATA_REFERENCE, sw-pointer-target-props={target-category=TYPE_REFERENCE, implementation-data-type=Mcu_ClockConfigType}
        McuRamCfgPtr: category=DATA_REFERENCE, sw-pointer-target-props={target-category=TYPE_REFERENCE, implementation-data-type=Mcu_RamConfigType}
        McuGtmConfigPtr: category=DATA_REFERENCE, sw-pointer-target-props={target-category=TYPE_REFERENCE, implementation-data-type=Mcu_GtmConfigType}
        McuLowPowerModeCfgPtr: category=DATA_REFERENCE, sw-pointer-target-props={target-category=TYPE_REFERENCE, implementation-data-type=Mcu_LowPowerModeType}
        McuResetCfg: implementation-data-type=uint32
        McuArstDisCfg: implementation-data-type=uint32
        McuTrapSettingConf0: implementation-data-type=uint32
        McuTrapSettingConf1: implementation-data-type=uint32
        McuEruEiFiltCfg: implementation-data-type=uint32
        McuNoOfClockCfg: implementation-data-type=Mcu_ClockType
    Mcu_ExternalClockConfigType: implementation-data-type=uint32, type-emitter=BSW
    Mcu_GtmAdcTrigType: category=STRUCTURE
      element GtmAdcTrigOut0: implementation-data-type=uint32
      element GtmAdcTrigOut1: implementation-data-type=uint32
    Mcu_GtmAtomConfigType: category=STRUCTURE
      element AtomAgcIntTrigRstCn0: implementation-data-type=uint32
      element AtomAgcActTb: implementation-data-type=uint32
    Mcu_GtmClockSettingType: category=STRUCTURE
      7 x element, all with category=TYPE_REFERENCE:
        GtmCmuClockEnable: implementation-data-type=uint32
        GtmCmuGlobalNumerator: implementation-data-type=uint32
        GtmCmuGlobalDenominator: implementation-data-type=uint32
        GtmCmuConfClkCtrl: array-size=8, array-size-semantics=FIXED-SIZE, implementation-data-type=uint32
        GtmCmuFixedClkCtrl: implementation-data-type=uint32
        GtmCmuClsInDiv: implementation-data-type=uint32
        GtmEclkCtrl: array-size=3, array-size-semantics=FIXED-SIZE, implementation-data-type=Mcu_GtmExtClkType
    Mcu_GtmClusterConfigType: category=STRUCTURE
      element GtmCcmCfg: implementation-data-type=uint32
      element GtmCcmConfClockCfg: implementation-data-type=uint32
      element GtmCcmFixedClockCfg: implementation-data-type=uint32
    Mcu_GtmConfigType: category=STRUCTURE
      9 x element:
        GtmAtomModuleUsage: implementation-data-type=uint16
        GtmClockCfgPtr: category=DATA_REFERENCE, sw-pointer-target-props={target-category=TYPE_REFERENCE, implementation-data-type=Mcu_GtmClockSettingType}
        GtmTbuCfg: implementation-data-type=uint32
        GtmTomModuleUsage: implementation-data-type=uint16
        GtmClusterCfgPtr: category=DATA_REFERENCE, sw-pointer-target-props={target-category=TYPE_REFERENCE, implementation-data-type=Mcu_GtmClusterConfigType}
        GtmTomCfg: array-size=MCU_GTM_NO_OF_TOM_ AVAILABLE * 2, array-size-semantics=FIXED-SIZE, implementation-data-type=Mcu_GtmTomConfigType
        GtmAtomCfg: array-size=MCU_GTM_NO_OF_ATOM_ AVAILABLE, array-size-semantics=FIXED-SIZE, implementation-data-type=Mcu_GtmAtomConfigType
        GtmAdcTrigCfg: array-size=MCU_NO_OF_GTM_ADC_TRIGGER, array-size-semantics=FIXED-SIZE, implementation-data-type=Mcu_GtmAdcTrigType
        IsGtmSleepModeEnabled: implementation-data-type=boolean
    Mcu_GtmExtClkType: category=STRUCTURE
      element GtmCmuExtClockNum: implementation-data-type=uint32
      element GtmCmuExtClockDen: implementation-data-type=uint32
    Mcu_GtmTomConfigType: category=STRUCTURE
      element TomTgcIntTrigRstCn0: implementation-data-type=uint32
      element TomTgcActTb: implementation-data-type=uint32
    Mcu_LowPowerModeType: category=STRUCTURE
      6 x element:
        MaxModeEvrcCtrl: implementation-data-type=Mcu_ModeEvrcCtrlType
        Pmswcr0: implementation-data-type=uint32
        Pmswcr{3..5}: implementation-data-type=uint32
        StdbyRamAdr: category=DATA_REFERENCE, array-size=MCU_NO_OF_STDBY_RAM_BLK, array-size-semantics=FIXED-SIZE, sw-pointer-target-props={target-category=TYPE_REFERENCE, implementation-data-type=uint32}
    Mcu_ModeEvrcCtrlType: category=STRUCTURE
      element McuMode: category=DATA_REFERENCE, sw-pointer-target-props={target-category=TYPE_REFERENCE, sw-bit-representation=number-of-bits=3, implementation-data-type=unsigned_int}
      element EvrcLowPowerMode: category=DATA_REFERENCE, sw-pointer-target-props={target-category=TYPE_REFERENCE, sw-bit-representation=number-of-bits=1, implementation-data-type=unsigned_int}
      element Reserved: category=DATA_REFERENCE, sw-pointer-target-props={target-category=TYPE_REFERENCE, sw-bit-representation=number-of-bits=28, implementation-data-type=unsigned_int}
    Mcu_PeripheralPllConfigType: category=STRUCTURE
      6 x element, all with category=TYPE_REFERENCE, implementation-data-type=unsigned_int:
        PerPllNDiv: sw-bit-representation=number-of-bits=7
        PerPllPDiv: sw-bit-representation=number-of-bits=3
        PerPllK2Div: sw-bit-representation=number-of-bits=3
        PerPllK3Div: sw-bit-representation=number-of-bits=3
        K3DivByPass: sw-bit-representation=number-of-bits=1
        Reserved: sw-bit-representation=number-of-bits=15
    Mcu_PllDistributionConfigType: category=STRUCTURE
      7 x element, all with category=TYPE_REFERENCE, implementation-data-type=uint32:
        Ccucon{0..3}
        Ccucon5
        Ccucon4
        CcuconCpu: array-size=MCU_NO_OF_CPU, array-size-semantics=FIXED-SIZE
    Mcu_RamBaseAdrType: category=DATA_REFERENCE, sw-pointer-target-props={target-category=TYPE_REFERENCE, base-type=void}, type-emitter=BSW
    Mcu_RamConfigType: category=STRUCTURE
      element RamBaseAdrPtr: implementation-data-type=Mcu_RamBaseAdrType
      element RamSize: implementation-data-type=Mcu_RamSizeType
      element RamPrstData: implementation-data-type=Mcu_RamPrstDatType
    Mcu_RamPrstDatType: implementation-data-type=uint8, type-emitter=BSW
    Mcu_RamSizeType: implementation-data-type=uint32, type-emitter=BSW
    Mcu_SystemPllConfigType: category=STRUCTURE
      6 x element, all with category=TYPE_REFERENCE, implementation-data-type=unsigned_int:
        Insel: sw-bit-representation=number-of-bits=2
        SysPllPDiv: sw-bit-representation=number-of-bits=3
        SysPllNDiv: sw-bit-representation=number-of-bits=7
        SysPllK2Div: sw-bit-representation=number-of-bits=3
        FmPllEn: sw-bit-representation=number-of-bits=1
        ModulationAmplitude: sw-bit-representation=number-of-bits=16
