AUTOSAR XML (schema 4-0-3)
package /DaVinci_Project
  module config Rte
    21 x RteBswModuleInstance:
      Adc
      BswM
        BswM_MainFunctionTimingEvent0 (RteBswEventToTaskMapping): RteBswUsedOsEventRef=Rte_Ev_Cyclic2_SchM_Core0_0_10ms, RteBswUsedOsAlarmRef=Os/Rte_Al_TE2_SchM_Core0_0_10ms
      Can
        3 x RteBswEventToTaskMapping, all with RteBswUsedOsEventRef=Rte_Ev_Cyclic2_SchM_Core0_0_10ms, RteBswUsedOsAlarmRef=Os/Rte_Al_TE2_SchM_Core0_0_10ms:
          Can_MainFunction_BusOffTimingEvent0
          Can_MainFunction_ModeTimingEvent0
          Can_MainFunction_WakeupTimingEvent0
      CanIf
      CanSM
        CanSM_MainFunctionTimingEvent0 (RteBswEventToTaskMapping): RteBswUsedOsEventRef=Rte_Ev_Cyclic2_SchM_Core0_0_10ms, RteBswUsedOsAlarmRef=Os/Rte_Al_TE2_SchM_Core0_0_10ms
      Com
        Com_MainFunctionRxTimingEvent0 (RteBswEventToTaskMapping): RteBswUsedOsEventRef=Rte_Ev_Cyclic2_SchM_Core0_0_10ms, RteBswUsedOsAlarmRef=Os/Rte_Al_TE2_SchM_Core0_0_10ms
        Com_MainFunctionTxTimingEvent0 (RteBswEventToTaskMapping): RteBswUsedOsEventRef=Rte_Ev_Cyclic2_SchM_Core0_0_1ms, RteBswUsedOsAlarmRef=Os/Rte_Al_TE2_SchM_Core0_0_1ms
      ComM
        6 x RteBswEventToTaskMapping, all with RteBswUsedOsEventRef=Rte_Ev_Cyclic2_SchM_Core0_0_20ms, RteBswUsedOsAlarmRef=Os/Rte_Al_TE2_SchM_Core0_0_20ms:
          ComM_MainFunction_{0..5}TimingEvent0
      Det
      Dio
      Dma
      EcuM
        6 x RteBswEventToTaskMapping:
          EcuM_MainFunctionTimingEvent0: RteBswUsedOsAlarmRef=Os/Rte_Al_TE1_EcuM_EcuM_MainFunction
          EcuM_MainFunctionTimingEvent1: RteBswUsedOsAlarmRef=Os/Rte_Al_TE2_EcuM_EcuM_MainFunction
          EcuM_MainFunctionTimingEvent2: RteBswUsedOsAlarmRef=Os/Rte_Al_TE3_EcuM_EcuM_MainFunction
          EcuM_MainFunctionTimingEvent3: RteBswUsedOsAlarmRef=Os/Rte_Al_TE4_EcuM_EcuM_MainFunction
          EcuM_MainFunctionTimingEvent4: RteBswUsedOsEventRef=Rte_Ev_Cyclic2_SchM_Core0_0_10ms, RteBswUsedOsAlarmRef=Os/Rte_Al_TE2_SchM_Core0_0_10ms
          EcuM_MainFunctionTimingEvent5: RteBswUsedOsAlarmRef=Os/Rte_Al_TE6_EcuM_EcuM_MainFunction
      Gpt
      Icu
      Irq
      McalLib
      Mcu
      PduR
      Port
      Pwm
      Spi
        Spi_MainFunction_HandlingTimingEvent0 (RteBswEventToTaskMapping): RteBswUsedOsEventRef=Rte_Ev_Cyclic2_SchM_Core0_0_5ms, RteBswUsedOsAlarmRef=Os/Rte_Al_TE2_SchM_Core0_0_5ms
      Xcp
        CanXcp_MainFunctionTimingEvent0 (RteBswEventToTaskMapping): RteBswUsedOsEventRef=Rte_Ev_Cyclic2_SchM_Core0_0_5ms, RteBswUsedOsAlarmRef=Os/Rte_Al_TE2_SchM_Core0_0_5ms
        Xcp_MainFunctionTimingEvent0 (RteBswEventToTaskMapping): RteBswUsedOsEventRef=Rte_Ev_Cyclic2_SchM_Core0_0_5ms, RteBswUsedOsAlarmRef=Os/Rte_Al_TE2_SchM_Core0_0_5ms
    21 x RteSwComponentInstance:
      BswM_EcuSwComposition
        Timer_BswM_MainFunction (RteEventToTaskMapping): RteUsedOsEventRef=Rte_Ev_Cyclic2_SchM_Core0_0_10ms, RteUsedOsAlarmRef=Os/Rte_Al_TE2_SchM_Core0_0_10ms
      ComM_EcuSwComposition
        6 x RteEventToTaskMapping, all with RteUsedOsEventRef=Rte_Ev_Cyclic2_SchM_Core0_0_20ms, RteUsedOsAlarmRef=Os/Rte_Al_TE2_SchM_Core0_0_20ms:
          Timer_ComM_MainFunction_{0..5}
      Core5swc_EcuSwComposition
        TMT_Runnable (RteEventToTaskMapping): RteUsedOsAlarmRef=Os/Rte_Al_TE_Core5swc_Runnable
      CtCDD_EcuSwComposition
        TMT_CtCDD (RteEventToTaskMapping): RteUsedOsAlarmRef=Os/Rte_Al_TE_CtCDD_CtCDD
      CtIoHardWare_EcuSwComposition
        TMT_Adc_Write (RteEventToTaskMapping): RteUsedOsEventRef=Rte_Ev_Run_CtIoHardWare_Adc_Write, RteUsedOsAlarmRef=Os/Rte_Al_TE_CtIoHardWare_Adc_Write
      CtMDA_Control_Logic_EcuSwComposition
        TMT_MDA_Control_Logic (RteEventToTaskMapping): RteUsedOsAlarmRef=Os/Rte_Al_TE_CtMDA_Control_Logic_MDA_Control_Logic
      CtMotor_FL_EcuSwComposition
        TMT_CtApMotor_FL (RteEventToTaskMapping): RteUsedOsAlarmRef=Os/Rte_Al_TE_CtMotor_FL_CpApMotor_FL
      CtMotor_FR_EcuSwComposition
        TMT_CpApMotor_FR (RteEventToTaskMapping): RteUsedOsAlarmRef=Os/Rte_Al_TE_CtMotor_FR_CpApMotor_FR
      CtMotor_RL_EcuSwComposition
        TMT_CpApMotor_RL (RteEventToTaskMapping): RteUsedOsAlarmRef=Os/Rte_Al_TE_CtMotor_RL_CpApMotor_RL
      CtMotor_RR_EcuSwComposition
        TMT_CpApMotor_RR (RteEventToTaskMapping): RteUsedOsAlarmRef=Os/Rte_Al_TE_CtMotor_RR_CpApMotor_RR
      CtPSI5_Handler_EcuSwComposition
        TMT_PSI5_HD (RteEventToTaskMapping): RteUsedOsAlarmRef=Os/Rte_Al_TE_CtPSI5_Handler_PSI5MAIN_HD
      CtPT2000_Handler_EcuSwComposition
        TMT_PT2000_Diag_HD (RteEventToTaskMapping): RteUsedOsEventRef=Rte_Ev_Run_CtPT2000_Handler_PT2000_Diag_HD, RteUsedOsAlarmRef=Os/Rte_Al_TE_CtPT2000_Handler_PT2000_Diag_HD
        TMT_PT2000_Main_HD (RteEventToTaskMapping): RteUsedOsEventRef=Rte_Ev_Run_CtPT2000_Handler_PT2000_Main_HD, RteUsedOsAlarmRef=Os/Rte_Al_TE_CtPT2000_Handler_PT2000_Main_HD
      CtPWM_Handler_EcuSwComposition
        TMT_Runnable (RteEventToTaskMapping): RteUsedOsEventRef=Rte_Ev_Run_CtPWM_Handler_PWM_SET, RteUsedOsAlarmRef=Os/Rte_Al_TE_CtPWM_Handler_PWM_SET
      Det_EcuSwComposition
      EcuM_EcuSwComposition
        Timer_EcuM_MainFunction (RteEventToTaskMapping): RteUsedOsEventRef=Rte_Ev_Cyclic2_SchM_Core0_0_10ms, RteUsedOsAlarmRef=Os/Rte_Al_TE2_SchM_Core0_0_10ms
      Os_OsCore{0..5}_swc_EcuSwComposition
    RteOsInteraction
      21 x RteUsedOsActivation, all with RteExpectedActivationOffset=0:
        Rte_Al_TE_CtMDA_Control_Logic_MDA_Control_Logic: RteActivationOsAlarmRef=Os/Rte_Al_TE_CtMDA_Control_Logic_MDA_Control_Logic, RteActivationOsTaskRef=APP_Task_Core0
        Rte_Al_TE_CtMotor_FL_CpApMotor_FL: RteActivationOsAlarmRef=Os/Rte_Al_TE_CtMotor_FL_CpApMotor_FL, RteActivationOsTaskRef=APP_Task_Core1
        Rte_Al_TE_CtMotor_FR_CpApMotor_FR: RteActivationOsAlarmRef=Os/Rte_Al_TE_CtMotor_FR_CpApMotor_FR, RteActivationOsTaskRef=APP_Task_Core2
        Rte_Al_TE_CtMotor_RL_CpApMotor_RL: RteActivationOsAlarmRef=Os/Rte_Al_TE_CtMotor_RL_CpApMotor_RL, RteActivationOsTaskRef=APP_Task_Core3
        Rte_Al_TE_CtMotor_RR_CpApMotor_RR: RteActivationOsAlarmRef=Os/Rte_Al_TE_CtMotor_RR_CpApMotor_RR, RteActivationOsTaskRef=APP_Task_Core4
        Rte_Al_TE_Core5swc_Runnable: RteActivationOsAlarmRef=Os/Rte_Al_TE_Core5swc_Runnable, RteActivationOsTaskRef=APP_Task_Core5
        Rte_Al_TE_CtCDD_CtCDD: RteActivationOsAlarmRef=Os/Rte_Al_TE_CtCDD_CtCDD, RteActivationOsTaskRef=Core_OsTask_CDD
        Rte_Al_TE_CtIoHardWare_Adc_Write: RteActivationOsAlarmRef=Os/Rte_Al_TE_CtIoHardWare_Adc_Write, RteActivationOsTaskRef=Core_OsTask_IOHW
        Rte_Al_TE_CtPWM_Handler_PWM_SET: RteActivationOsAlarmRef=Os/Rte_Al_TE_CtPWM_Handler_PWM_SET, RteActivationOsTaskRef=Core_OsTask_IOHW
        Rte_Al_TE_CtPSI5_Handler_PSI5MAIN_HD: RteActivationOsAlarmRef=Os/Rte_Al_TE_CtPSI5_Handler_PSI5MAIN_HD, RteActivationOsTaskRef=Core_OsTask_PSI5
        Rte_Al_TE_CtPT2000_Handler_PT2000_Diag_HD: RteActivationOsAlarmRef=Os/Rte_Al_TE_CtPT2000_Handler_PT2000_Diag_HD, RteActivationOsTaskRef=Core_OsTask_PT2000
        Rte_Al_TE_CtPT2000_Handler_PT2000_Main_HD: RteActivationOsAlarmRef=Os/Rte_Al_TE_CtPT2000_Handler_PT2000_Main_HD, RteActivationOsTaskRef=Core_OsTask_PT2000
        Rte_Al_TE2_SchM_Core0_0_10ms: RteActivationOsAlarmRef=Os/Rte_Al_TE2_SchM_Core0_0_10ms, RteActivationOsTaskRef=SchM_Core0
        Rte_Al_TE2_SchM_Core0_0_1ms: RteActivationOsAlarmRef=Os/Rte_Al_TE2_SchM_Core0_0_1ms, RteActivationOsTaskRef=SchM_Core0
        Rte_Al_TE2_SchM_Core0_0_20ms: RteActivationOsAlarmRef=Os/Rte_Al_TE2_SchM_Core0_0_20ms, RteActivationOsTaskRef=SchM_Core0
        Rte_Al_TE2_SchM_Core0_0_5ms: RteActivationOsAlarmRef=Os/Rte_Al_TE2_SchM_Core0_0_5ms, RteActivationOsTaskRef=SchM_Core0
        Rte_Al_TE{1..4}_EcuM_EcuM_MainFunction: RteActivationOsAlarmRef=Os/Rte_Al_TE{1..4}_EcuM_EcuM_MainFunction, RteActivationOsTaskRef=SchM_Core{1..4}
        Rte_Al_TE6_EcuM_EcuM_MainFunction: RteActivationOsAlarmRef=Os/Rte_Al_TE6_EcuM_EcuM_MainFunction, RteActivationOsTaskRef=SchM_Core5
  module config NvM
  module config Os
    APP_Task_Core0 (OsTask):
      OsTaskActivation = 1
      OsTaskPriority = 60
      OsTaskSchedule = FULL
      OsTaskAccessingApplication = SystemApplication_OsCore{1..5}
    Rte_Al_TE_CtMDA_Control_Logic_MDA_Control_Logic (OsAlarm):
      OsAlarmCounterRef = SystemTimer0
      OsAlarmAccessingApplication = SystemApplication_OsCore{1..5}
      OsAlarmAction
        OsAlarmActivateTask: OsAlarmActivateTaskRef=APP_Task_Core0
    APP_Task_Core1 (OsTask):
      OsTaskActivation = 1
      OsTaskPriority = 50
      OsTaskSchedule = FULL
      OsTaskAccessingApplication = SystemApplication_OsCore0
      OsTaskAccessingApplication = SystemApplication_OsCore{2..5}
    Rte_Al_TE_CtMotor_FL_CpApMotor_FL (OsAlarm):
      OsAlarmCounterRef = SystemTimer1
      OsAlarmAccessingApplication = SystemApplication_OsCore0
      OsAlarmAccessingApplication = SystemApplication_OsCore{2..5}
      OsAlarmAction
        OsAlarmActivateTask: OsAlarmActivateTaskRef=APP_Task_Core1
    APP_Task_Core2 (OsTask):
      OsTaskActivation = 1
      OsTaskPriority = 50
      OsTaskSchedule = FULL
      OsTaskAccessingApplication = SystemApplication_OsCore0
      OsTaskAccessingApplication = SystemApplication_OsCore1
      OsTaskAccessingApplication = SystemApplication_OsCore{3..5}
    Rte_Al_TE_CtMotor_FR_CpApMotor_FR (OsAlarm):
      OsAlarmCounterRef = SystemTimer2
      OsAlarmAccessingApplication = SystemApplication_OsCore0
      OsAlarmAccessingApplication = SystemApplication_OsCore1
      OsAlarmAccessingApplication = SystemApplication_OsCore{3..5}
      OsAlarmAction
        OsAlarmActivateTask: OsAlarmActivateTaskRef=APP_Task_Core2
    APP_Task_Core3 (OsTask):
      OsTaskActivation = 1
      OsTaskPriority = 50
      OsTaskSchedule = FULL
      OsTaskAccessingApplication = SystemApplication_OsCore{0..2}
      OsTaskAccessingApplication = SystemApplication_OsCore4
      OsTaskAccessingApplication = SystemApplication_OsCore5
    Rte_Al_TE_CtMotor_RL_CpApMotor_RL (OsAlarm):
      OsAlarmCounterRef = SystemTimer3
      OsAlarmAccessingApplication = SystemApplication_OsCore{0..2}
      OsAlarmAccessingApplication = SystemApplication_OsCore4
      OsAlarmAccessingApplication = SystemApplication_OsCore5
      OsAlarmAction
        OsAlarmActivateTask: OsAlarmActivateTaskRef=APP_Task_Core3
    APP_Task_Core4 (OsTask):
      OsTaskActivation = 1
      OsTaskPriority = 50
      OsTaskSchedule = FULL
      OsTaskAccessingApplication = SystemApplication_OsCore{0..3}
      OsTaskAccessingApplication = SystemApplication_OsCore5
    Rte_Al_TE_CtMotor_RR_CpApMotor_RR (OsAlarm):
      OsAlarmCounterRef = SystemTimer4
      OsAlarmAccessingApplication = SystemApplication_OsCore{0..3}
      OsAlarmAccessingApplication = SystemApplication_OsCore5
      OsAlarmAction
        OsAlarmActivateTask: OsAlarmActivateTaskRef=APP_Task_Core4
    APP_Task_Core5 (OsTask):
      OsTaskActivation = 1
      OsTaskPriority = 50
      OsTaskSchedule = FULL
      OsTaskAccessingApplication = SystemApplication_OsCore{0..4}
    Rte_Al_TE_Core5swc_Runnable (OsAlarm):
      OsAlarmCounterRef = SystemTimer5
      OsAlarmAccessingApplication = SystemApplication_OsCore{0..4}
      OsAlarmAction
        OsAlarmActivateTask: OsAlarmActivateTaskRef=APP_Task_Core5
    Core_OsTask_CDD (OsTask):
      OsTaskActivation = 1
      OsTaskPriority = 56
      OsTaskSchedule = FULL
      OsTaskAccessingApplication = SystemApplication_OsCore{1..5}
    Rte_Al_TE_CtCDD_CtCDD (OsAlarm):
      OsAlarmCounterRef = SystemTimer0
      OsAlarmAccessingApplication = SystemApplication_OsCore{1..5}
      OsAlarmAction
        OsAlarmActivateTask: OsAlarmActivateTaskRef=Core_OsTask_CDD
    Core_OsTask_IOHW (OsTask):
      OsTaskActivation = 1
      OsTaskPriority = 57
      OsTaskSchedule = FULL
      OsTaskEventRef = Rte_Ev_Run_CtIoHardWare_Adc_Write
      OsTaskEventRef = Rte_Ev_Run_CtPWM_Handler_PWM_SET
      OsTaskAccessingApplication = SystemApplication_OsCore{1..5}
    Rte_Al_TE_CtIoHardWare_Adc_Write (OsAlarm):
      OsAlarmCounterRef = SystemTimer0
      OsAlarmAccessingApplication = SystemApplication_OsCore{1..5}
      OsAlarmAction
        OsAlarmSetEvent: OsAlarmSetEventRef=Rte_Ev_Run_CtIoHardWare_Adc_Write, OsAlarmSetEventTaskRef=Core_OsTask_IOHW
    Rte_Al_TE_CtPWM_Handler_PWM_SET (OsAlarm):
      OsAlarmCounterRef = SystemTimer0
      OsAlarmAccessingApplication = SystemApplication_OsCore{1..5}
      OsAlarmAction
        OsAlarmSetEvent: OsAlarmSetEventRef=Rte_Ev_Run_CtPWM_Handler_PWM_SET, OsAlarmSetEventTaskRef=Core_OsTask_IOHW
    Core_OsTask_PSI5 (OsTask):
      OsTaskActivation = 1
      OsTaskPriority = 59
      OsTaskSchedule = NON
      OsTaskAccessingApplication = SystemApplication_OsCore{1..5}
    Rte_Al_TE_CtPSI5_Handler_PSI5MAIN_HD (OsAlarm):
      OsAlarmCounterRef = SystemTimer0
      OsAlarmAccessingApplication = SystemApplication_OsCore{1..5}
      OsAlarmAction
        OsAlarmActivateTask: OsAlarmActivateTaskRef=Core_OsTask_PSI5
    Core_OsTask_PT2000 (OsTask):
      OsTaskActivation = 1
      OsTaskPriority = 58
      OsTaskSchedule = FULL
      OsTaskEventRef = Rte_Ev_Run_CtPT2000_Handler_PT2000_Diag_HD
      OsTaskEventRef = Rte_Ev_Run_CtPT2000_Handler_PT2000_Main_HD
      OsTaskAccessingApplication = SystemApplication_OsCore{1..5}
    Rte_Al_TE_CtPT2000_Handler_PT2000_Diag_HD (OsAlarm):
      OsAlarmCounterRef = SystemTimer0
      OsAlarmAccessingApplication = SystemApplication_OsCore{1..5}
      OsAlarmAction
        OsAlarmSetEvent: OsAlarmSetEventRef=Rte_Ev_Run_CtPT2000_Handler_PT2000_Diag_HD, OsAlarmSetEventTaskRef=Core_OsTask_PT2000
    Rte_Al_TE_CtPT2000_Handler_PT2000_Main_HD (OsAlarm):
      OsAlarmCounterRef = SystemTimer0
      OsAlarmAccessingApplication = SystemApplication_OsCore{1..5}
      OsAlarmAction
        OsAlarmSetEvent: OsAlarmSetEventRef=Rte_Ev_Run_CtPT2000_Handler_PT2000_Main_HD, OsAlarmSetEventTaskRef=Core_OsTask_PT2000
    SchM_Core0 (OsTask):
      OsTaskActivation = 1
      OsTaskPriority = 20
      OsTaskSchedule = FULL
      OsTaskEventRef = Rte_Ev_Cyclic2_SchM_Core0_0_10ms
      OsTaskEventRef = Rte_Ev_Cyclic2_SchM_Core0_0_1ms
      OsTaskEventRef = Rte_Ev_Cyclic2_SchM_Core0_0_20ms
      OsTaskEventRef = Rte_Ev_Cyclic2_SchM_Core0_0_5ms
      OsTaskAccessingApplication = SystemApplication_OsCore{1..5}
    4 x OsAlarm, all with OsAlarmCounterRef=SystemTimer0, OsAlarmAccessingApplication=SystemApplication_OsCore1, OsAlarmAccessingApplication=SystemApplication_OsCore2, OsAlarmAccessingApplication=SystemApplication_OsCore3, OsAlarmAccessingApplication=SystemApplication_OsCore4, OsAlarmAccessingApplication=SystemApplication_OsCore5:
      Rte_Al_TE2_SchM_Core0_0_10ms
        OsAlarmAction
          OsAlarmSetEvent: OsAlarmSetEventRef=Rte_Ev_Cyclic2_SchM_Core0_0_10ms, OsAlarmSetEventTaskRef=SchM_Core0
      Rte_Al_TE2_SchM_Core0_0_1ms
        OsAlarmAction
          OsAlarmSetEvent: OsAlarmSetEventRef=Rte_Ev_Cyclic2_SchM_Core0_0_1ms, OsAlarmSetEventTaskRef=SchM_Core0
      Rte_Al_TE2_SchM_Core0_0_20ms
        OsAlarmAction
          OsAlarmSetEvent: OsAlarmSetEventRef=Rte_Ev_Cyclic2_SchM_Core0_0_20ms, OsAlarmSetEventTaskRef=SchM_Core0
      Rte_Al_TE2_SchM_Core0_0_5ms
        OsAlarmAction
          OsAlarmSetEvent: OsAlarmSetEventRef=Rte_Ev_Cyclic2_SchM_Core0_0_5ms, OsAlarmSetEventTaskRef=SchM_Core0
    SchM_Core1 (OsTask):
      OsTaskActivation = 1
      OsTaskPriority = 20
      OsTaskSchedule = FULL
      OsTaskAccessingApplication = SystemApplication_OsCore0
      OsTaskAccessingApplication = SystemApplication_OsCore{2..5}
    Rte_Al_TE1_EcuM_EcuM_MainFunction (OsAlarm):
      OsAlarmCounterRef = SystemTimer1
      OsAlarmAccessingApplication = SystemApplication_OsCore0
      OsAlarmAccessingApplication = SystemApplication_OsCore{2..5}
      OsAlarmAction
        OsAlarmActivateTask: OsAlarmActivateTaskRef=SchM_Core1
    SchM_Core2 (OsTask):
      OsTaskActivation = 1
      OsTaskPriority = 20
      OsTaskSchedule = FULL
      OsTaskAccessingApplication = SystemApplication_OsCore0
      OsTaskAccessingApplication = SystemApplication_OsCore1
      OsTaskAccessingApplication = SystemApplication_OsCore{3..5}
    Rte_Al_TE2_EcuM_EcuM_MainFunction (OsAlarm):
      OsAlarmCounterRef = SystemTimer2
      OsAlarmAccessingApplication = SystemApplication_OsCore0
      OsAlarmAccessingApplication = SystemApplication_OsCore1
      OsAlarmAccessingApplication = SystemApplication_OsCore{3..5}
      OsAlarmAction
        OsAlarmActivateTask: OsAlarmActivateTaskRef=SchM_Core2
    SchM_Core3 (OsTask):
      OsTaskActivation = 1
      OsTaskPriority = 20
      OsTaskSchedule = FULL
      OsTaskAccessingApplication = SystemApplication_OsCore{0..2}
      OsTaskAccessingApplication = SystemApplication_OsCore4
      OsTaskAccessingApplication = SystemApplication_OsCore5
    Rte_Al_TE3_EcuM_EcuM_MainFunction (OsAlarm):
      OsAlarmCounterRef = SystemTimer3
      OsAlarmAccessingApplication = SystemApplication_OsCore{0..2}
      OsAlarmAccessingApplication = SystemApplication_OsCore4
      OsAlarmAccessingApplication = SystemApplication_OsCore5
      OsAlarmAction
        OsAlarmActivateTask: OsAlarmActivateTaskRef=SchM_Core3
    SchM_Core4 (OsTask):
      OsTaskActivation = 1
      OsTaskPriority = 20
      OsTaskSchedule = FULL
      OsTaskAccessingApplication = SystemApplication_OsCore{0..3}
      OsTaskAccessingApplication = SystemApplication_OsCore5
    Rte_Al_TE4_EcuM_EcuM_MainFunction (OsAlarm):
      OsAlarmCounterRef = SystemTimer4
      OsAlarmAccessingApplication = SystemApplication_OsCore{0..3}
      OsAlarmAccessingApplication = SystemApplication_OsCore5
      OsAlarmAction
        OsAlarmActivateTask: OsAlarmActivateTaskRef=SchM_Core4
    SchM_Core5 (OsTask):
      OsTaskActivation = 1
      OsTaskPriority = 20
      OsTaskSchedule = FULL
      OsTaskAccessingApplication = SystemApplication_OsCore{0..4}
    Rte_Al_TE6_EcuM_EcuM_MainFunction (OsAlarm):
      OsAlarmCounterRef = SystemTimer5
      OsAlarmAccessingApplication = SystemApplication_OsCore{0..4}
      OsAlarmAction
        OsAlarmActivateTask: OsAlarmActivateTaskRef=SchM_Core5
    8 x OsEvent:
      Rte_Ev_Cyclic2_SchM_Core0_0_10ms
      Rte_Ev_Cyclic2_SchM_Core0_0_1ms
      Rte_Ev_Cyclic2_SchM_Core0_0_20ms
      Rte_Ev_Cyclic2_SchM_Core0_0_5ms
      Rte_Ev_Run_CtIoHardWare_Adc_Write
      Rte_Ev_Run_CtPT2000_Handler_PT2000_Diag_HD
      Rte_Ev_Run_CtPT2000_Handler_PT2000_Main_HD
      Rte_Ev_Run_CtPWM_Handler_PWM_SET
    6 x OsApplication, all with OsTrusted=true:
      SystemApplication_OsCore0: OsAppTaskRef=APP_Task_Core0, OsAppAlarmRef=Os/Rte_Al_TE_CtMDA_Control_Logic_MDA_Control_Logic, OsAppTaskRef=Core_OsTask_CDD, OsAppAlarmRef=Os/Rte_Al_TE_CtCDD_CtCDD, OsAppTaskRef=Core_OsTask_IOHW, OsAppAlarmRef=Os/Rte_Al_TE_CtIoHardWare_Adc_Write, OsAppAlarmRef=Os/Rte_Al_TE_CtPWM_Handler_PWM_SET, OsAppTaskRef=Core_OsTask_PSI5, OsAppAlarmRef=Os/Rte_Al_TE_CtPSI5_Handler_PSI5MAIN_HD, OsAppTaskRef=Core_OsTask_PT2000, OsAppAlarmRef=Os/Rte_Al_TE_CtPT2000_Handler_PT2000_Diag_HD, OsAppAlarmRef=Os/Rte_Al_TE_CtPT2000_Handler_PT2000_Main_HD, OsAppTaskRef=SchM_Core0, OsAppAlarmRef=Os/Rte_Al_TE2_SchM_Core0_0_10ms, OsAppAlarmRef=Os/Rte_Al_TE2_SchM_Core0_0_1ms, OsAppAlarmRef=Os/Rte_Al_TE2_SchM_Core0_0_20ms, OsAppAlarmRef=Os/Rte_Al_TE2_SchM_Core0_0_5ms
      SystemApplication_OsCore1: OsAppTaskRef=APP_Task_Core1, OsAppAlarmRef=Os/Rte_Al_TE_CtMotor_FL_CpApMotor_FL, OsAppTaskRef=SchM_Core1, OsAppAlarmRef=Os/Rte_Al_TE1_EcuM_EcuM_MainFunction
      SystemApplication_OsCore2: OsAppTaskRef=APP_Task_Core2, OsAppAlarmRef=Os/Rte_Al_TE_CtMotor_FR_CpApMotor_FR, OsAppTaskRef=SchM_Core2, OsAppAlarmRef=Os/Rte_Al_TE2_EcuM_EcuM_MainFunction
      SystemApplication_OsCore3: OsAppTaskRef=APP_Task_Core3, OsAppAlarmRef=Os/Rte_Al_TE_CtMotor_RL_CpApMotor_RL, OsAppTaskRef=SchM_Core3, OsAppAlarmRef=Os/Rte_Al_TE3_EcuM_EcuM_MainFunction
      SystemApplication_OsCore4: OsAppTaskRef=APP_Task_Core4, OsAppAlarmRef=Os/Rte_Al_TE_CtMotor_RR_CpApMotor_RR, OsAppTaskRef=SchM_Core4, OsAppAlarmRef=Os/Rte_Al_TE4_EcuM_EcuM_MainFunction
      SystemApplication_OsCore5: OsAppTaskRef=APP_Task_Core5, OsAppAlarmRef=Os/Rte_Al_TE_Core5swc_Runnable, OsAppTaskRef=SchM_Core5, OsAppAlarmRef=Os/Rte_Al_TE6_EcuM_EcuM_MainFunction
    8 x OsSpinlock, all with OsSpinlockLockMethod=LOCK_CAT2_INTERRUPTS, OsSpinlockAccessingApplication=SystemApplication_OsCore0:
      Rte_Spinlock_CtMDA_Control_Logic_PpMotTgtOutFL_MotTgtOutFL: OsSpinlockAccessingApplication=SystemApplication_OsCore1
      Rte_Spinlock_CtMDA_Control_Logic_PpMotTgtOutFR_MotTgtOutFR: OsSpinlockAccessingApplication=SystemApplication_OsCore2
      Rte_Spinlock_CtMDA_Control_Logic_PpMotTgtOutRL_MotTgtOutRL: OsSpinlockAccessingApplication=SystemApplication_OsCore3
      Rte_Spinlock_CtMDA_Control_Logic_PpMotTgtOutRR_MotTgtOutRR: OsSpinlockAccessingApplication=SystemApplication_OsCore4
      Rte_Spinlock_CtMotor_FL_PpMotFLAct_MotFLAct: OsSpinlockAccessingApplication=SystemApplication_OsCore1
      Rte_Spinlock_CtMotor_FR_PpMotFRAct_MotFRAct: OsSpinlockAccessingApplication=SystemApplication_OsCore2
      Rte_Spinlock_CtMotor_RL_PpMotRLAct_MotRLAct: OsSpinlockAccessingApplication=SystemApplication_OsCore3
      Rte_Spinlock_CtMotor_RR_PpMotRRAct_MotRRAct: OsSpinlockAccessingApplication=SystemApplication_OsCore4
  module config EcuC
  ecuc value collection DaVinci_Project: ecuc-values=[Com, Rte, Os, EcuC, NvM]
