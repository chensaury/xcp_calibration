AUTOSAR XML (schema 4-2-2)
# Copyright (C) Infineon Technologies (2018)
# All rights reserved.
package /AUTOSAR_Gpt/BswModuleDescriptions
  bsw module description Gpt: category=BSW_MODULE, module-id=100  # GPT Driver
    provided-entrys:
      Gpt_Init
      Gpt_DeInit
      Gpt_GetTimeElapsed
      Gpt_GetTimeRemaining
      Gpt_StartTimer
      Gpt_StopTimer
      Gpt_EnableNotification
      Gpt_DisableNotification
      Gpt_GetVersionInfo
      Gpt_GetPredefTimerValue
      Gpt_Isr
    bsw module dependency McalLibDependency: target-module-id=255, required-entrys=[Mcal_SetBitAtomic, Mcal_GetBitAtomic, Mcal_GetCpuIndex]
    bsw module dependency McuDependency: target-module-id=101, expected-callbacks=Gpt_Isr
      required-entrys:
        Mcu_17_Gtm_TomChannelInit
        Mcu_17_Gtm_TomChannelShadowTransfer
        Mcu_17_Gtm_AtomChannelInit
        Mcu_17_Gtm_AtomChannelShadowTransfer
        Mcu_17_Gtm_TomChannelEnable
        Mcu_17_Gtm_AtomChannelEnable
        Mcu_17_Gtm_TomChannelDisable
        Mcu_17_Gtm_AtomChannelDisable
        Mcu_17_Gtm_TomChannelDeInit
    bsw internal behavior GptBehavior
      exclusive area Get1UsPredefTimerValue
      exclusive area Get100UsPredefTimerValue
      10 x bsw called entity:
        Gpt_Init: reentrancy-level=NON-REENTRANT, implemented-entry=Gpt_Init
        Gpt_DeInit: reentrancy-level=NON-REENTRANT, implemented-entry=Gpt_DeInit
        Gpt_GetTimeElapsed: reentrancy-level=MULTICORE-REENTRANT, implemented-entry=Gpt_GetTimeElapsed
        Gpt_GetTimeRemaining: reentrancy-level=MULTICORE-REENTRANT, implemented-entry=Gpt_GetTimeRemaining
        Gpt_StartTimer: reentrancy-level=MULTICORE-REENTRANT, implemented-entry=Gpt_StartTimer
        Gpt_StopTimer: reentrancy-level=MULTICORE-REENTRANT, implemented-entry=Gpt_StopTimer
        Gpt_EnableNotification: reentrancy-level=MULTICORE-REENTRANT, implemented-entry=Gpt_EnableNotification
        Gpt_DisableNotification: reentrancy-level=MULTICORE-REENTRANT, implemented-entry=Gpt_DisableNotification
        Gpt_GetVersionInfo: reentrancy-level=MULTICORE-REENTRANT, implemented-entry=Gpt_GetVersionInfo
        Gpt_GetPredefTimerValue: can-enter-exclusive-area=[Get1UsPredefTimerValue, Get100UsPredefTimerValue], reentrancy-level=MULTICORE-REENTRANT, implemented-entry=Gpt_GetPredefTimerValue
      bsw interrupt entity Gpt_Isr: reentrancy-level=MULTICORE-REENTRANT, implemented-entry=Gpt_Isr, interrupt-category=CAT-1
package /AUTOSAR_Gpt/BswModuleEntrys
  11 x bsw module entry, all with is-synchronous=true:
    Gpt_Init: service-id=1, is-reentrant=false, call-type=REGULAR, execution-context=TASK, sw-service-impl-policy=STANDARD
      sw service arg ConfigPtr: category=DATA_REFERENCE, sw-pointer-target-props={target-category=TYPE_REFERENCE, implementation-data-type=Gpt_ConfigType}
    Gpt_DeInit: service-id=2, is-reentrant=false, call-type=REGULAR, execution-context=TASK, sw-service-impl-policy=STANDARD
    Gpt_GetTimeElapsed: service-id=3, is-reentrant=true, call-type=REGULAR, execution-context=TASK, sw-service-impl-policy=STANDARD
      return type Return: implementation-data-type=Gpt_ValueType
      sw service arg Channel: implementation-data-type=Gpt_ChannelType
    Gpt_GetTimeRemaining: service-id=4, is-reentrant=true, call-type=REGULAR, execution-context=TASK, sw-service-impl-policy=STANDARD
      return type Return: implementation-data-type=Gpt_ValueType
      sw service arg Channel: implementation-data-type=Gpt_ChannelType
    Gpt_StartTimer: service-id=5, is-reentrant=true, call-type=REGULAR, execution-context=TASK, sw-service-impl-policy=STANDARD
      sw service arg Channel: implementation-data-type=Gpt_ChannelType
      sw service arg Value: implementation-data-type=Gpt_ValueType
    Gpt_StopTimer: service-id=6, is-reentrant=true, call-type=REGULAR, execution-context=TASK, sw-service-impl-policy=STANDARD
      sw service arg Channel: implementation-data-type=Gpt_ChannelType
    Gpt_EnableNotification: service-id=7, is-reentrant=true, call-type=REGULAR, execution-context=TASK, sw-service-impl-policy=STANDARD
      sw service arg Channel: implementation-data-type=Gpt_ChannelType
    Gpt_DisableNotification: service-id=8, is-reentrant=true, call-type=REGULAR, execution-context=TASK, sw-service-impl-policy=STANDARD
      sw service arg Channel: implementation-data-type=Gpt_ChannelType
    Gpt_GetVersionInfo: service-id=0, is-reentrant=true, call-type=REGULAR, execution-context=TASK, sw-service-impl-policy=MACRO
      sw service arg VersionInfoPtr: category=DATA_REFERENCE, sw-pointer-target-props={target-category=TYPE_REFERENCE, implementation-data-type=Std_VersionInfoType}
    Gpt_GetPredefTimerValue: service-id=13, is-reentrant=true, call-type=REGULAR, execution-context=TASK, sw-service-impl-policy=STANDARD
      return type Return: implementation-data-type=Std_ReturnType
      sw service arg PredefTimer: implementation-data-type=Gpt_PredefTimerType
      sw service arg TimeValuePtr: category=DATA_REFERENCE, sw-pointer-target-props={target-category=TYPE_REFERENCE, implementation-data-type=uint32}
    Gpt_Isr: is-reentrant=true, call-type=INTERRUPT, execution-context=INTERRUPT-CAT-1, sw-service-impl-policy=STANDARD
      sw service arg LogicalChId: implementation-data-type=Gpt_ChannelType
      sw service arg StatusFlags: implementation-data-type=uint32
package /AUTOSAR_Gpt/Implementations
  bsw implementation Gpt: programming-language=C, sw-version=3.0.0, vendor-id=17, ar-release-version=4.2.2, behavior=GptBehavior, vendor-specific-module-def=Gpt
    code-descriptors:
      code Files
        artifact-descriptors:
          short-label=ssc::src::Gpt.c, category=SWSRC
          short-label=ssc::inc::Gpt.h, category=SWHDR
          short-label=ssc::inc::Gpt_Cbk.h, category=SWHDR
    4 x compiler:
      TASKING_COMPILE: name=TASKING, options="--core=tc1.6.2 --iso=99 -O2 --eabi-compliant -AGKpvX --switch=auto --integer-enumeration --default-near-size=0 --fp-model=1", vendor=Altium, version=V6.2r2
      GNU_COMPILE: name=GNU, options="-DGNU -Wall -std=c99 -c -O2 -mtc162 -meabi -fno-short-enums -ffunction-sections -fdata-sections -fstrict-volatile-bitfields", vendor=Hightec, version=V4.9.2.0
      DIAB_COMPILE: name=DIAB, options="-tTC162NF:simple -O -XO -Xsection-split=1 -Xkeep-assembly-file=2 -g3 -Xinline=0 -Xdialect-c99 -ei5388,2273,5387 -ei1824 -Xsmall-data=0 -Xsmall-const=0", vendor=Windriver, version=V5.9.6.4
      GHS_COMPILE: name=GHS, options="-cpu=tc1v162 --no_commons --gnu_asm --no_short_enum -c99 -Ospeed -Onounroll -g -c -dwarf2", vendor=GreenHills, version=V2017.5.5
    generated-artifacts:
      5 x dependency on artifact:
        Gpt_PBcfg_c: artifact-descriptor={short-label=generate::template::src::Gpt_PBcfg.c, category=SWTEMPLATE}, usages=EXECUTE
        Gpt_Cfg_h: artifact-descriptor={short-label=generate::template::inc::Gpt_Cfg.h, category=SWTEMPLATE}, usages=COMPILE
        Gpt_PBcfg_h: artifact-descriptor={short-label=generate::template::inc::Gpt_PBcfg.h, category=SWTEMPLATE}, usages=EXECUTE
        Gpt_xdm: artifact-descriptor={short-label=config::Gpt.xdm, category=SWTOOL}, usages=CODEGENERATION
        Gpt_bmd: artifact-descriptor={short-label=autosar::TC39x::TC397x::Gpt.bmd, category=SWTOOL}, usages=CODEGENERATION
    4 x linker:
      TASKING_LINK: name=TASKING, options="--map-file -OtcXYL --core=mpe:vtc", vendor=Altium, version=V6.2r2
      GNU_LINK: name=GNU, options="-Wl,--mcpu=tc162 -Wl,--gc-sections -nostartfiles -n", vendor=Hightec, version=V4.9.2.0
      DIAB_LINK: name=DIAB, options="-tTC162NF:simple -m6 -Xremove-unused-sections", vendor=Windriver, version=V5.9.6.4
      GHS_LINK: name=GHS, options="-cpu=tc1v162 -ignore_debug_references", vendor=GreenHills, version=V2017.5.5
    resource consumption ResourceConsumption
      10 x memory section:
        VAR_CLEARED_ASIL_B_CORE0_32: alignment=32, sw-addrmethod=VAR
        VAR_INIT_ASIL_B_CORE0_UNSPECIFIED: alignment=UNSPECIFIED, sw-addrmethod=VAR
        CONST_ASIL_B_CORE0_8: alignment=8, sw-addrmethod=CONST
        CONFIG_DATA_ASIL_B_CORE0_UNSPECIFIED: alignment=UNSPECIFIED, sw-addrmethod=CONST
        VAR_INIT_ASIL_B_GLOBAL_UNSPECIFIED: alignment=UNSPECIFIED, sw-addrmethod=VAR
        VAR_INIT_ASIL_B_GLOBAL_32: alignment=32, sw-addrmethod=VAR
        VAR_CLEARED_ASIL_B_GLOBAL_32: alignment=32, sw-addrmethod=VAR
        CONFIG_DATA_ASIL_B_GLOBAL_UNSPECIFIED: alignment=UNSPECIFIED, sw-addrmethod=CONST
        CODE_ASIL_B_GLOBAL: alignment=UNSPECIFIED, sw-addrmethod=CODE
        CODE_FAST_ASIL_B_GLOBAL: alignment=UNSPECIFIED, sw-addrmethod=CODE
      section name prefix GPT
package /AUTOSAR_Gpt/ImplementationDataTypes
  12 x impl type:
    Gpt_ChannelType: implementation-data-type=uint8, type-emitter=BSW
    Gpt_ModeType: compu {0=GPT_MODE_NORMAL, 1=GPT_MODE_SLEEP}, implementation-data-type=uint32, additional-native-type-qualifier=enum, type-emitter=BSW
    Gpt_NotificationPtrType: category=DATA_REFERENCE, sw-pointer-target-props={target-category=FUNCTION_REFERENCE, function-pointer-signature=IoHwAb_GptNotification}
    Gpt_PredefTimerType: compu {0=GPT_PREDEF_TIMER_1US_16BIT, 1=GPT_PREDEF_TIMER_1US_24BIT, 2=GPT_PREDEF_TIMER_1US_32BIT, 3=GPT_PREDEF_TIMER_100US_32BIT}, implementation-data-type=uint32, additional-native-type-qualifier=enum, type-emitter=BSW
    Gpt_ConfigType: category=STRUCTURE
      element Gpt_Config_CorePtr: category=DATA_REFERENCE, sw-pointer-target-props={target-category=TYPE_REFERENCE, implementation-data-type=Gpt_CoreConfigType}
    Gpt_ValueType: implementation-data-type=uint32, type-emitter=BSW
    Gpt_ChannelModeType: implementation-data-type=uint8, type-emitter=BSW
    Gpt_EnableWakeupType: implementation-data-type=boolean, type-emitter=BSW
    Gpt_100UsPredefTimerChannelConfigType: category=STRUCTURE
      5 x element, all with category=TYPE_REFERENCE:
        GptGtm100UsTimerInfo{0..2}: implementation-data-type=Mcu_17_Gtm_TomAtomChConfigType
        ExtraChRequirement100Us: implementation-data-type=boolean
        Gpt100UsPredefTimerUsed0: implementation-data-type=Gpt_PredefTimerType
    Gpt_1UsPredefTimerChannelConfigType: category=STRUCTURE
      7 x element, all with category=TYPE_REFERENCE:
        GptGtm1UsTimerInfo{0..2}: implementation-data-type=Mcu_17_Gtm_TomAtomChConfigType
        ExtraChRequirement1Us: implementation-data-type=boolean
        Gpt1UsPredefTimerUsed{0..2}: implementation-data-type=Gpt_PredefTimerType
    Gpt_ChannelConfigType: category=STRUCTURE
      5 x element:
        GptNotificationPtr: category=DATA_REFERENCE, sw-pointer-target-props={target-category=TYPE_REFERENCE, implementation-data-type=Gpt_NotificationPtrType}
        GptChannelWakeupInfo: implementation-data-type=EcuM_WakeupSourceType
        GptEnableWakeupState: implementation-data-type=Gpt_EnableWakeupType
        GptChannelMode: implementation-data-type=Gpt_ChannelModeType
        GptGtmTimerInfo: implementation-data-type=Mcu_17_Gtm_TomAtomChConfigType
    Gpt_CoreConfigType: category=STRUCTURE
      5 x element:
        Gpt_ChannelIndexPtr: category=DATA_REFERENCE, sw-pointer-target-props={target-category=TYPE_REFERENCE, implementation-data-type=uint8}
        ChannelConfigPtr: category=DATA_REFERENCE, sw-pointer-target-props={target-category=TYPE_REFERENCE, implementation-data-type=Gpt_ChannelConfigType}
        Predef1UsChannelConfigPtr: category=DATA_REFERENCE, sw-pointer-target-props={target-category=TYPE_REFERENCE, implementation-data-type=Gpt_1UsPredefTimerChannelConfigType}
        Predef100UsChannelConfigPtr: category=DATA_REFERENCE, sw-pointer-target-props={target-category=TYPE_REFERENCE, implementation-data-type=Gpt_100UsPredefTimerChannelConfigType}
        Gpt_MaxNormalChannels: implementation-data-type=uint8
