AUTOSAR XML (schema 4-2-2)
# Copyright (C) Infineon Technologies (2018)
# All rights reserved.
package /AURIX2G_Dma/BswModuleDescriptions
  bsw module description Dma: category=BSW_MODULE, module-id=255  # Direct Memory Access
    provided-entrys:
      Dma_Init
      Dma_ChDeInit
      Dma_IsInitDone
      Dma_ChInit
      Dma_ChUpdate
      Dma_ChTransferFreeze
      Dma_ChTransferResume
      Dma_ChEnableHardwareTrigger
      Dma_ChDisableHardwareTrigger
      Dma_ChStartTransfer
      Dma_ChStopTransfer
      Dma_ChGetRemainingData
      Dma_ChSwitchBuffer
      Dma_ChIsStatusAsserted
      Dma_ChStatusClear
      Dma_ChInterruptEnable
      Dma_ChInterruptDisable
      Dma_GetChannelEvent
      Dma_GetMoveEngineEvent
      Dma_MEStatusClear
      Dma_ChInterruptHandler
      Dma_MEInterruptHandler
      Dma_MEInterruptDispatcher
      Dma_InitCheck
      Dma_GetCurrentTimeStamp
      Dma_GetCrcValue
      Dma_IsChannelInitDone
    bsw module dependency DetDependency: target-module-id=15, required-entrys=Det_ReportError
    bsw module dependency McalLibDependency: target-module-id=255
      required-entrys:
        Mcal_SetBitAtomic
        Mcal_WriteCpuEndInitProtReg
        Mcal_WriteSafetyEndInitProtReg
        Mcal_GetCpuIndex
        Mcal_GetCpuPhysicalId
        Mcal_GetGlobalDsprAddress
    bsw internal behavior DmaBehavior
      exclusive area ChannelConfigUpdate
      20 x bsw called entity:
        Dma_Init: reentrancy-level=NON-REENTRANT, implemented-entry=Dma_Init
        Dma_ChDeInit: can-enter-exclusive-area=ChannelConfigUpdate, reentrancy-level=MULTICORE-REENTRANT, implemented-entry=Dma_ChDeInit
        Dma_IsInitDone: reentrancy-level=MULTICORE-REENTRANT, implemented-entry=Dma_IsInitDone
        Dma_ChInit: can-enter-exclusive-area=ChannelConfigUpdate, reentrancy-level=MULTICORE-REENTRANT, implemented-entry=Dma_ChInit
        Dma_ChUpdate: can-enter-exclusive-area=ChannelConfigUpdate, reentrancy-level=MULTICORE-REENTRANT, implemented-entry=Dma_ChUpdate
        Dma_ChTransferFreeze: can-enter-exclusive-area=ChannelConfigUpdate, reentrancy-level=MULTICORE-REENTRANT, implemented-entry=Dma_ChTransferFreeze
        Dma_ChTransferResume: can-enter-exclusive-area=ChannelConfigUpdate, reentrancy-level=MULTICORE-REENTRANT, implemented-entry=Dma_ChTransferResume
        Dma_ChEnableHardwareTrigger: can-enter-exclusive-area=ChannelConfigUpdate, reentrancy-level=MULTICORE-REENTRANT, implemented-entry=Dma_ChEnableHardwareTrigger
        Dma_ChDisableHardwareTrigger: can-enter-exclusive-area=ChannelConfigUpdate, reentrancy-level=MULTICORE-REENTRANT, implemented-entry=Dma_ChDisableHardwareTrigger
        Dma_ChInterruptEnable: can-enter-exclusive-area=ChannelConfigUpdate, reentrancy-level=MULTICORE-REENTRANT, implemented-entry=Dma_ChInterruptEnable
        Dma_ChInterruptDisable: can-enter-exclusive-area=ChannelConfigUpdate, reentrancy-level=MULTICORE-REENTRANT, implemented-entry=Dma_ChInterruptDisable
        Dma_ChStartTransfer: can-enter-exclusive-area=ChannelConfigUpdate, reentrancy-level=MULTICORE-REENTRANT, implemented-entry=Dma_ChStartTransfer
        Dma_ChGetRemainingData: can-enter-exclusive-area=ChannelConfigUpdate, reentrancy-level=MULTICORE-REENTRANT, implemented-entry=Dma_ChGetRemainingData
        Dma_ChStopTransfer: can-enter-exclusive-area=ChannelConfigUpdate, reentrancy-level=MULTICORE-REENTRANT, implemented-entry=Dma_ChStopTransfer
        Dma_ChSwitchBuffer: can-enter-exclusive-area=ChannelConfigUpdate, reentrancy-level=MULTICORE-REENTRANT, implemented-entry=Dma_ChSwitchBuffer
        Dma_ChIsStatusAsserted: can-enter-exclusive-area=ChannelConfigUpdate, reentrancy-level=MULTICORE-REENTRANT, implemented-entry=Dma_ChIsStatusAsserted
        Dma_ChStatusClear: can-enter-exclusive-area=ChannelConfigUpdate, reentrancy-level=MULTICORE-REENTRANT, implemented-entry=Dma_ChStatusClear
        Dma_GetChannelEvent: can-enter-exclusive-area=ChannelConfigUpdate, reentrancy-level=MULTICORE-REENTRANT, implemented-entry=Dma_GetChannelEvent
        Dma_GetMoveEngineEvent: can-enter-exclusive-area=ChannelConfigUpdate, reentrancy-level=MULTICORE-REENTRANT, implemented-entry=Dma_GetMoveEngineEvent
        Dma_MEStatusClear: can-enter-exclusive-area=ChannelConfigUpdate, reentrancy-level=MULTICORE-REENTRANT, implemented-entry=Dma_MEStatusClear
      bsw interrupt entity Dma_MEInterruptHandler: reentrancy-level=NON-REENTRANT, implemented-entry=Dma_MEInterruptHandler
      bsw interrupt entity Dma_MEInterruptDispatcher: reentrancy-level=NON-REENTRANT, implemented-entry=Dma_MEInterruptDispatcher
      bsw interrupt entity Dma_ChInterruptHandler: reentrancy-level=MULTICORE-REENTRANT, implemented-entry=Dma_ChInterruptHandler
      4 x bsw called entity:
        Dma_GetCrcValue: can-enter-exclusive-area=ChannelConfigUpdate, reentrancy-level=MULTICORE-REENTRANT, implemented-entry=Dma_GetCrcValue
        Dma_GetCurrentTimeStamp: reentrancy-level=MULTICORE-REENTRANT, implemented-entry=Dma_GetCurrentTimeStamp
        Dma_IsChannelInitDone: reentrancy-level=MULTICORE-REENTRANT, implemented-entry=Dma_IsChannelInitDone
        Dma_InitCheck: reentrancy-level=NON-REENTRANT, implemented-entry=Dma_InitCheck
package /AURIX2G_Dma/BswModuleEntrys
  27 x bsw module entry, all with is-synchronous=true, sw-service-impl-policy=STANDARD:
    Dma_Init: service-id=1, is-reentrant=false, call-type=REGULAR, execution-context=TASK
      sw service arg ConfigPtr: category=DATA_REFERENCE, sw-pointer-target-props={target-category=TYPE_REFERENCE, implementation-data-type=Dma_ConfigType}
    Dma_ChDeInit: service-id=5, is-reentrant=true, call-type=REGULAR, execution-context=TASK
      sw service arg Channel: implementation-data-type=uint8
    Dma_IsInitDone: service-id=2, is-reentrant=true, call-type=REGULAR, execution-context=TASK
      return type Return: implementation-data-type=Std_ReturnType
    Dma_ChInit: service-id=3, is-reentrant=true, call-type=REGULAR, execution-context=TASK
      sw service arg Channel: implementation-data-type=uint8
    Dma_ChUpdate: service-id=4, is-reentrant=true, call-type=REGULAR, execution-context=TASK
      sw service arg Channel: implementation-data-type=uint8
      sw service arg Config: category=DATA_REFERENCE, sw-pointer-target-props={target-category=TYPE_REFERENCE, implementation-data-type=Dma_ConfigUpdateType}
      sw service arg NodeAddress: category=DATA_REFERENCE, sw-pointer-target-props={target-category=TYPE_REFERENCE, implementation-data-type=uint32}
    Dma_ChTransferFreeze: service-id=6, is-reentrant=true, call-type=REGULAR, execution-context=TASK
      sw service arg Channel: implementation-data-type=uint8
    Dma_ChTransferResume: service-id=7, is-reentrant=true, call-type=REGULAR, execution-context=TASK
      sw service arg Channel: implementation-data-type=uint8
    Dma_ChEnableHardwareTrigger: service-id=8, is-reentrant=true, call-type=REGULAR, execution-context=TASK
      sw service arg Channel: implementation-data-type=uint8
    Dma_ChDisableHardwareTrigger: service-id=9, is-reentrant=true, call-type=REGULAR, execution-context=TASK
      sw service arg Channel: implementation-data-type=uint8
    Dma_ChStartTransfer: service-id=10, is-reentrant=true, call-type=REGULAR, execution-context=TASK
      sw service arg Channel: implementation-data-type=uint8
    Dma_ChStopTransfer: service-id=11, is-reentrant=true, call-type=REGULAR, execution-context=TASK
      sw service arg Channel: implementation-data-type=uint8
    Dma_ChGetRemainingData: service-id=12, is-reentrant=true, call-type=REGULAR, execution-context=TASK
      return type Return: implementation-data-type=uint32
      sw service arg Channel: implementation-data-type=uint8
    Dma_ChSwitchBuffer: service-id=13, is-reentrant=true, call-type=REGULAR, execution-context=TASK
      sw service arg Channel: implementation-data-type=uint8
    Dma_ChIsStatusAsserted: service-id=14, is-reentrant=true, call-type=REGULAR, execution-context=TASK
      return type Return: implementation-data-type=Std_ReturnType
      sw service arg Channel: implementation-data-type=uint8
      sw service arg Event: implementation-data-type=Dma_ChEventType
    Dma_ChStatusClear: service-id=15, is-reentrant=true, call-type=REGULAR, execution-context=TASK
      sw service arg Channel: implementation-data-type=uint8
      sw service arg Event: implementation-data-type=Dma_ChEventType
    Dma_ChInterruptEnable: service-id=16, is-reentrant=true, call-type=REGULAR, execution-context=TASK
      sw service arg Channel: implementation-data-type=uint8
      sw service arg Event: implementation-data-type=Dma_ChEventType
    Dma_ChInterruptDisable: service-id=17, is-reentrant=true, call-type=REGULAR, execution-context=TASK
      sw service arg Channel: implementation-data-type=uint8
      sw service arg Event: implementation-data-type=Dma_ChEventType
    Dma_GetChannelEvent: service-id=19, is-reentrant=true, call-type=REGULAR, execution-context=TASK
      return type Return: implementation-data-type=uint32
      sw service arg Channel: implementation-data-type=uint8
    Dma_GetMoveEngineEvent: service-id=20, is-reentrant=true, call-type=REGULAR, execution-context=TASK
      return type Return: implementation-data-type=uint32
      sw service arg Channel: implementation-data-type=uint8
    Dma_MEStatusClear: service-id=21, is-reentrant=true, call-type=REGULAR, execution-context=TASK
      sw service arg MoveEngineNumber: implementation-data-type=Dma_MoveEngineListType
    Dma_ChInterruptHandler: is-reentrant=true, call-type=INTERRUPT, execution-context=INTERRUPT-CAT-1
      sw service arg Channel: implementation-data-type=uint8
    Dma_MEInterruptHandler: is-reentrant=false, call-type=INTERRUPT, execution-context=INTERRUPT-CAT-1
      sw service arg lErrorSource: implementation-data-type=uint8
      sw service arg lErrorData: implementation-data-type=uint32
    Dma_MEInterruptDispatcher: is-reentrant=false, call-type=INTERRUPT, execution-context=INTERRUPT-CAT-1
    Dma_GetCrcValue: service-id=23, is-reentrant=true, call-type=REGULAR, execution-context=TASK
      return type Return: implementation-data-type=uint32
      sw service arg ChannelId: implementation-data-type=uint8
      sw service arg CrcType: implementation-data-type=Dma_CrcType
    Dma_GetCurrentTimeStamp: service-id=24, is-reentrant=true, call-type=REGULAR, execution-context=TASK
      return type Return: implementation-data-type=uint32
    Dma_IsChannelInitDone: service-id=25, is-reentrant=true, call-type=REGULAR, execution-context=TASK
      return type Return: implementation-data-type=Std_ReturnType
      sw service arg Channel: implementation-data-type=uint8
    Dma_InitCheck: service-id=22, is-reentrant=false, call-type=REGULAR, execution-context=TASK
      return type Return: implementation-data-type=Std_ReturnType
      sw service arg ConfigPtr: implementation-data-type=Dma_ConfigType
package /AURIX2G_Dma/Implementations
  bsw implementation Dma: programming-language=C, sw-version=2.1.0, vendor-id=17, ar-release-version=4.2.2, behavior=DmaBehavior, vendor-specific-module-def=Dma
    code-descriptors:
      code Files: artifact-descriptors=[{short-label=ssc::src::Dma.c, category=SWSRC}, {short-label=ssc::inc::Dma.h, category=SWHDR}]
    4 x compiler:
      TASKING_COMPILE: name=TASKING, options="--core=tc1.6.2 --iso=99 -O2 --eabi-compliant -AGKpvX --switch=auto --integer-enumeration --default-near-size=0 --fp-model=1", vendor=Altium, version=V6.2r2
      GNU_COMPILE: name=GNU, options="-DGNU -Wall -std=c99 -c -O2 -mtc162 -meabi -fno-short-enums -ffunction-sections -fdata-sections -fstrict-volatile-bitfields", vendor=Hightec, version=V4.9.2.0
      DIAB_COMPILE: name=DIAB, options="-tTC162NF:simple -O -XO -Xsection-split=1 -Xkeep-assembly-file=2 -g3 -Xinline=0 -Xdialect-c99 -ei5388,2273,5387 -ei1824 -Xsmall-data=0 -Xsmall-const=0", vendor=Windriver, version=V5.9.6.4
      GHS_COMPILE: name=GHS, options="-cpu=tc1v162 --no_commons --gnu_asm --no_short_enum -c99 -Ospeed -Onounroll -g -c -dwarf2", vendor=GreenHills, version=V2017.5.5
    generated-artifacts:
      5 x dependency on artifact:
        Dma_PBcfg_c: artifact-descriptor={short-label=generate::template::src::Dma_PBcfg.c, category=SWTEMPLATE}, usages=EXECUTE
        Dma_PBcfg_h: artifact-descriptor={short-label=generate::template::inc::Dma_PBcfg.h, category=SWTEMPLATE}, usages=EXECUTE
        Dma_Cfg_h: artifact-descriptor={short-label=generate::template::inc::Dma_Cfg.h, category=SWTEMPLATE}, usages=COMPILE
        Dma_xdm: artifact-descriptor={short-label=config::Dma.xdm, category=SWTOOL}, usages=CODEGENERATION
        Dma_bmd: artifact-descriptor={short-label=autosar::TC39x::TC397x::Dma.bmd, category=SWTOOL}, usages=CODEGENERATION
    4 x linker:
      TASKING_LINK: name=TASKING, options="--map-file -OtcXYL --core=mpe:vtc", vendor=Altium, version=V6.2r2
      GNU_LINK: name=GNU, options="-Wl,--mcpu=tc162 -Wl,--gc-sections -nostartfiles -n", vendor=Hightec, version=V4.9.2.0
      DIAB_LINK: name=DIAB, options="-tTC162NF:simple -m6 -Xremove-unused-sections", vendor=Windriver, version=V5.9.6.4
      GHS_LINK: name=GHS, options="-cpu=tc1v162 -ignore_debug_references", vendor=GreenHills, version=V2017.5.5
    resource consumption ResourceConsumption
      13 x memory section:
        VAR_CLEARED_ASIL_B_GLOBAL_32: alignment=32, sw-addrmethod=VAR
        VAR_CLEARED_ASIL_B_GLOBAL_8: alignment=8, sw-addrmethod=VAR
        CODE_ASIL_B_GLOBAL: alignment=UNSPECIFIED, sw-addrmethod=CODE
        CONST_ASIL_B_GLOBAL_32: alignment=32, sw-addrmethod=CONST
        CONFIG_DATA_ASIL_B_CORE0_256: alignment=256, sw-addrmethod=CONFIG_DATA
        CONFIG_DATA_ASIL_B_CORE0_UNSPECIFIED: alignment=256, sw-addrmethod=CONFIG_DATA
        VAR_CLEARED_ASIL_B_CORE{0..5}_8: alignment=8, sw-addrmethod=VAR
        CONFIG_DATA_ASIL_B_GLOBAL_UNSPECIFIED: alignment=UNSPECIFIED, sw-addrmethod=CONFIG_DATA
      section name prefix DMA
package /AURIX2G_Dma/ImplementationDataTypes
  13 x impl type:
    Dma_ChannelNotificationFnPtrType: category=DATA_REFERENCE, sw-pointer-target-props={target-category=FUNCTION_REFERENCE, function-pointer-signature=Dma_ChannelNotification}
    Dma_ChEventType: compu {0=DMA_CHEVENT_NONE, 1=DMA_CHEVENT_TRANSFER_COMPLETE, 2=DMA_CHEVENT_BUFFER_WRAP_SOURCE, 4=DMA_CHEVENT_BUFFER_WRAP_DEST, 8=DMA_CHEVENT_UNKNOWN_EVENT}, implementation-data-type=uint32, additional-native-type-qualifier=enum, type-emitter=BSW
    Dma_ConfigUpdateType: category=STRUCTURE
      13 x element, all with category=TYPE_REFERENCE:
        AddressCrc: implementation-data-type=uint32
        Config: implementation-data-type=uint32
        Control: implementation-data-type=uint32
        DestAddress: implementation-data-type=uint32
        UpdateAddressCrc: sw-bit-representation=number-of-bits=1, implementation-data-type=unsigned_int
        UpdateConfig: sw-bit-representation=number-of-bits=1, implementation-data-type=unsigned_int
        UpdateControlAdicr: sw-bit-representation=number-of-bits=1, implementation-data-type=unsigned_int
        UpdateDestAddress: sw-bit-representation=number-of-bits=1, implementation-data-type=unsigned_int
        UpdateShadowConfig: sw-bit-representation=number-of-bits=1, implementation-data-type=unsigned_int
        UpdateSourceAddress: sw-bit-representation=number-of-bits=1, implementation-data-type=unsigned_int
        ShadowConfig: implementation-data-type=uint32
        SourceAddress: implementation-data-type=uint32
        UpdateControlChcsr: sw-bit-representation=number-of-bits=1, implementation-data-type=unsigned_int
    Dma_CrcType: compu {0=DMA_NO_CRC_TYPE, 1=DMA_DATA_CRC_TYPE, 2=DMA_ADDRESS_CRC_TYPE}, implementation-data-type=uint32, additional-native-type-qualifier=enum, type-emitter=BSW
    Dma_MoveEngineErrorNotificationPtrType: category=DATA_REFERENCE, sw-pointer-target-props={target-category=FUNCTION_REFERENCE, function-pointer-signature=Dma_MoveEngineErrorNotification}
    Dma_MoveEngineEventType: compu {0=DMA_MOVE_ENGINE_EVENT_NONE, 1=DMA_MOVE_ENGINE_SOURCE_ERROR, 2=DMA_MOVE_ENGINE_DESTINATION_ERROR, 4=DMA_MOVE_ENGINE_SPB_ERROR, 8=DMA_MOVE_ENGINE_SRI_ERROR, 16=DMA_MOVE_ENGINE_RAM_ERROR, 32=DMA_MOVE_ENGINE_SAFE_LINKEDLIST_ERROR, 64=DMA_MOVE_ENGINE_DMA_LINKEDLIST_ERROR, 128=DMA_CHANNEL_TRL_ERROR}, implementation-data-type=uint32, additional-native-type-qualifier=enum, type-emitter=BSW
    Dma_MoveEngineListType: compu {0=DMA_ME_NONE, 1=DMA_ME_0, 2=DMA_ME_1, 4=DMA_ME_ALL}, implementation-data-type=uint32, additional-native-type-qualifier=enum, type-emitter=BSW
    Dma_ChannelMapType: category=STRUCTURE
      element Dma_ChannelConfIndexMap: category=DATA_REFERENCE, sw-pointer-target-props={target-category=TYPE_REFERENCE, implementation-data-type=uint8}
      element Dma_ChannelCoreMap: category=DATA_REFERENCE, sw-pointer-target-props={target-category=TYPE_REFERENCE, implementation-data-type=uint8}
    Dma_CoreSpecificChConfigType: category=STRUCTURE
      element DmaChConfigPtr: category=DATA_REFERENCE, sw-pointer-target-props={target-category=TYPE_REFERENCE, implementation-data-type=Dma_ChConfigType}
      element DmaNumberofChConfiguredPerCore: implementation-data-type=uint8
    Dma_TransactionCtrlSetType: category=STRUCTURE
      8 x element:
        DmaReadDataCrc: implementation-data-type=uint32
        DmaSourceDestAddressCrc: implementation-data-type=uint32
        DmaSourceAddress: category=DATA_REFERENCE, sw-pointer-target-props={target-category=TYPE_REFERENCE, implementation-data-type=uint32}
        DmaDestinationAddress: category=DATA_REFERENCE, sw-pointer-target-props={target-category=TYPE_REFERENCE, implementation-data-type=uint32}
        DmaAddressInterruptControl: implementation-data-type=uint32
        DmaChannelConfig: implementation-data-type=uint32
        DmaShadowAddress: category=DATA_REFERENCE, sw-pointer-target-props={target-category=TYPE_REFERENCE, implementation-data-type=Dma_TransactionCtrlSetType}
        DmaChControlStatus: implementation-data-type=uint32
    Dma_ChConfigType: category=STRUCTURE
      6 x element:
        DmaChTCSPtr: category=DATA_REFERENCE, sw-pointer-target-props={target-category=TYPE_REFERENCE, implementation-data-type=Dma_TransactionCtrlSetType}
        DmaChNotifPtr: implementation-data-type=Dma_ChannelNotificationFnPtrType
        DmaTsrConfig: implementation-data-type=uint32
        DmaChNumber: implementation-data-type=uint8
        DmaChHwPartitionConfig: implementation-data-type=uint8
        DmaMEErrorNotifPtr: implementation-data-type=Dma_MoveEngineErrorNotificationPtrType
    Dma_ResourcePartitionConfigType: category=STRUCTURE
      element DmaHwResourceBusMasterAccess: array-size=4, array-size-semantics=FIXED-SIZE, implementation-data-type=uint32
      element DmaHwResourceMode: array-size=4, array-size-semantics=FIXED-SIZE, implementation-data-type=uint8
    Dma_ConfigType: category=STRUCTURE
      5 x element:
        DmaCoreConfigPtr: category=DATA_REFERENCE, array-size=6, array-size-semantics=FIXED-SIZE, sw-pointer-target-props={target-category=TYPE_REFERENCE, implementation-data-type=Dma_CoreSpecificChConfigType}
        DmaMovEngErr: array-size=2, array-size-semantics=FIXED-SIZE, implementation-data-type=uint32
        DmaHwResourcePartition: implementation-data-type=Dma_ResourcePartitionConfigType
        Dma_ChannelMaps: array-size=128, array-size-semantics=FIXED-SIZE, implementation-data-type=Dma_ChannelMapType
        DmaTotalChConfigured: implementation-data-type=uint8
