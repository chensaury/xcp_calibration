AUTOSAR XML (schema 4-2-2)
# Copyright (C) Infineon Technologies (2018)
# All rights reserved.
package /AUTOSAR_Pwm/BswModuleDescriptions
  bsw module description Pwm: category=BSW_MODULE, module-id=121  # PWM Driver
    provided-entrys:
      Pwm_Init
      Pwm_DeInit
      Pwm_SetDutyCycle
      Pwm_SetPeriodAndDuty
      Pwm_SetOutputToIdle
      Pwm_GetOutputState
      Pwm_DisableNotification
      Pwm_EnableNotification
      Pwm_Isr
    bsw module dependency DetDependency: target-module-id=15, required-entrys=Det_ReportError
    bsw module dependency McuDependency: target-module-id=101
      required-entrys:
        Mcu_17_Gtm_TomChannelInit
        Mcu_17_Gtm_TomChannelShadowTransfer
        Mcu_17_Gtm_ConnectTimerOutToPortPin
        Mcu_17_Gtm_AtomChannelInit
        Mcu_17_Gtm_AtomChannelShadowTransfer
        Mcu_17_Ccu6_TimerInit
        Mcu_17_Ccu6_TimerShadowTransfer
        Mcu_17_Ccu6_TimerIntEnable
        Mcu_17_Ccu6_TimerIntDisable
        Mcu_17_Ccu6_TimerStart
        Mcu_17_Ccu6_TimerStop
    bsw module dependency McalLibDependency: target-module-id=255, required-entrys=[Mcal_GetCpuIndex, Mcal_SetBitAtomic]
    bsw internal behavior PwmBehavior
      exclusive area HandleNotification
      exclusive area PeriodAndDutyUpdate
      8 x bsw called entity:
        Pwm_Init: reentrancy-level=NON-REENTRANT, implemented-entry=Pwm_Init
        Pwm_DeInit: reentrancy-level=NON-REENTRANT, implemented-entry=Pwm_DeInit
        Pwm_SetDutyCycle: can-enter-exclusive-area=[HandleNotification, PeriodAndDutyUpdate], reentrancy-level=MULTICORE-REENTRANT, implemented-entry=Pwm_SetDutyCycle
        Pwm_SetPeriodAndDuty: can-enter-exclusive-area=[HandleNotification, PeriodAndDutyUpdate], reentrancy-level=MULTICORE-REENTRANT, implemented-entry=Pwm_SetPeriodAndDuty
        Pwm_SetOutputToIdle: can-enter-exclusive-area=[HandleNotification, PeriodAndDutyUpdate], reentrancy-level=MULTICORE-REENTRANT, implemented-entry=Pwm_SetOutputToIdle
        Pwm_GetOutputState: reentrancy-level=MULTICORE-REENTRANT, implemented-entry=Pwm_GetOutputState
        Pwm_DisableNotification: can-enter-exclusive-area=HandleNotification, reentrancy-level=MULTICORE-REENTRANT, implemented-entry=Pwm_DisableNotification
        Pwm_EnableNotification: can-enter-exclusive-area=HandleNotification, reentrancy-level=MULTICORE-REENTRANT, implemented-entry=Pwm_EnableNotification
      bsw interrupt entity Pwm_Isr: reentrancy-level=NON-REENTRANT, implemented-entry=Pwm_Isr, interrupt-category=CAT-1, interrupt-source=SRC_GTMTOMxy, SRC_GTMATOMxy
package /AUTOSAR_Pwm/BswModuleEntrys
  9 x bsw module entry, all with is-synchronous=true, sw-service-impl-policy=STANDARD:
    Pwm_Init: service-id=0, is-reentrant=false, call-type=REGULAR, execution-context=TASK
      sw service arg ConfigPtr: category=DATA_REFERENCE, sw-pointer-target-props={target-category=TYPE_REFERENCE, implementation-data-type=Pwm_ConfigType}
    Pwm_DeInit: service-id=1, is-reentrant=false, call-type=REGULAR, execution-context=TASK
    Pwm_SetDutyCycle: service-id=2, is-reentrant=true, call-type=REGULAR, execution-context=TASK
      sw service arg ChannelNumber: implementation-data-type=Pwm_ChannelType
      sw service arg DutyCycle: implementation-data-type=uint16
    Pwm_SetPeriodAndDuty: service-id=3, is-reentrant=true, call-type=REGULAR, execution-context=TASK
      sw service arg ChannelNumber: implementation-data-type=Pwm_ChannelType
      sw service arg Period: implementation-data-type=Pwm_PeriodType
      sw service arg DutyCycle: implementation-data-type=uint16
    Pwm_SetOutputToIdle: service-id=4, is-reentrant=true, call-type=REGULAR, execution-context=TASK
      sw service arg ChannelNumber: implementation-data-type=Pwm_ChannelType
    Pwm_GetOutputState: service-id=5, is-reentrant=true, call-type=REGULAR, execution-context=TASK
      return type Return: implementation-data-type=Pwm_OutputStateType
      sw service arg ChannelNumber: implementation-data-type=Pwm_ChannelType
    Pwm_DisableNotification: service-id=6, is-reentrant=true, call-type=REGULAR, execution-context=TASK
      sw service arg ChannelNumber: implementation-data-type=Pwm_ChannelType
    Pwm_EnableNotification: service-id=7, is-reentrant=true, call-type=REGULAR, execution-context=TASK
      sw service arg ChannelNumber: implementation-data-type=Pwm_ChannelType
      sw service arg Notification: implementation-data-type=Pwm_EdgeNotificationType
    Pwm_Isr: service-id=9, is-reentrant=false, call-type=INTERRUPT, execution-context=INTERRUPT-CAT-1
      sw service arg ChannelNumber: implementation-data-type=Pwm_ChannelType
package /AUTOSAR_Pwm/Implementations
  bsw implementation Pwm: programming-language=C, sw-version=4.0.0, vendor-id=17, ar-release-version=4.2.2, behavior=PwmBehavior, vendor-api-infix=GtmCcu6, vendor-specific-module-def=Pwm
    code-descriptors:
      code Files
        artifact-descriptors:
          short-label=src::Pwm_17_GtmCcu6.c, category=SWSRC
          short-label=inc::Pwm_17_GtmCcu6.h, category=SWHDR
          short-label=inc::Pwm_17_GtmCcu6_Cbk.h, category=SWHDR
    4 x compiler:
      TASKING_COMPILE: name=TASKING, options="--core=tc1.6.2 --iso=99 -O2 --eabi-compliant -AGKpvX --switch=auto --integer-enumeration --default-near-size=0 --fp-model=1", vendor=Altium, version=V6.2r2
      GNU_COMPILE: name=GNU, options="-DGNU -Wall -std=c99 -c -O2 -mtc162 -meabi -fno-short-enums -ffunction-sections -fdata-sections -fstrict-volatile-bitfields", vendor=Hightec, version=V4.9.2.0
      DIAB_COMPILE: name=DIAB, options="-tTC162NF:simple -O -XO -Xsection-split=1 -Xkeep-assembly-file=2 -g3 -Xinline=0 -Xdialect-c99 -ei5388,2273,5387 -ei1824 -Xsmall-data=0 -Xsmall-const=0", vendor=Windriver, version=V5.9.6.4
      GHS_COMPILE: name=GHS, options="-cpu=tc1v162 --no_commons --gnu_asm --no_short_enum -c99 -Ospeed -Onounroll -g -c -dwarf2", vendor=GreenHills, version=V2017.5.5
    generated-artifacts:
      5 x dependency on artifact:
        Pwm_PBcfg_c: artifact-descriptor={short-label=plugins::Pwm_17_GtmCcu6_Aurix::generate::src::Pwm_17_GtmCcu6_PBcfg.c, category=SWTEMPLATE}, usages=EXECUTE
        Pwm_Cfg_h: artifact-descriptor={short-label=plugins::Pwm_17_GtmCcu6_Aurix::generate::inc::Pwm_17_GtmCcu6_Cfg.h, category=SWTEMPLATE}, usages=COMPILE
        Pwm_PBcfg_h: artifact-descriptor={short-label=plugins::Pwm_17_GtmCcu6_Aurix::generate::inc::Pwm_17_GtmCcu6_PBcfg.h, category=SWTEMPLATE}, usages=EXECUTE
        Pwm_xdm: artifact-descriptor={short-label=config::Pwm_17_GtmCcu6.xdm, category=SWTOOL}, usages=CODEGENERATION
        Pwm_bmd: artifact-descriptor={short-label=autosar::TC39x::TC397x::Pwm_17_GtmCcu6.bmd, category=SWTOOL}, usages=CODEGENERATION
    4 x linker:
      TASKING_LINK: name=TASKING, options="--map-file -OtcXYL --core=mpe:vtc", vendor=Altium, version=V6.2r2
      GNU_LINK: name=GNU, options="-Wl,--mcpu=tc162 -Wl,--gc-sections -nostartfiles -n", vendor=Hightec, version=V4.9.2.0
      DIAB_LINK: name=DIAB, options="-tTC162NF:simple -m6 -Xremove-unused-sections", vendor=Windriver, version=V5.9.6.4
      GHS_LINK: name=GHS, options="-cpu=tc1v162 -ignore_debug_references", vendor=GreenHills, version=V2017.5.5
    resource consumption ResourceConsumption
      7 x memory section:
        VAR_CLEARED_ASIL_B_GLOBAL_32: alignment=32, sw-addrmethod=VAR
        CODE_ASIL_B_GLOBAL: alignment=UNSPECIFIED, sw-addrmethod=CODE
        VAR_CLEARED_ASIL_B_CORE0_UNSPECIFIED: alignment=UNSPECIFIED, sw-addrmethod=VAR
        CONST_ASIL_B_GLOBAL_UNSPECIFIED: alignment=UNSPECIFIED, sw-addrmethod=VAR
        CONFIG_DATA_ASIL_B_GLOBAL_UNSPECIFIED: alignment=UNSPECIFIED, sw-addrmethod=CONFIG_DATA
        CONFIG_DATA_ASIL_B_CORE0_UNSPECIFIED: alignment=UNSPECIFIED, sw-addrmethod=CONFIG_DATA
        CODE_FAST_ASIL_B_GLOBAL: alignment=UNSPECIFIED, sw-addrmethod=CODE
      section name prefix PWM_17_GTMCCU6
package /AUTOSAR_Pwm/ImplementationDataTypes
  7 x impl type:
    Pwm_ChannelType: implementation-data-type=uint8, type-emitter=BSW
    Pwm_NotifiPtrType: category=DATA_REFERENCE, sw-pointer-target-props={target-category=FUNCTION_REFERENCE, function-pointer-signature=IoHwAb_PwmNotification}
    Pwm_PeriodType: implementation-data-type=uint32, type-emitter=BSW
    Pwm_OutputStateType: implementation-data-type=uint8, type-emitter=BSW
    Pwm_EdgeNotificationType: implementation-data-type=uint8, type-emitter=BSW
    Pwm_ConfigType: category=STRUCTURE
      element PwmChannelIdxmapPtr: category=DATA_REFERENCE, sw-pointer-target-props={target-category=TYPE_REFERENCE, implementation-data-type=uint8}
      element PwmCoreAdd: category=DATA_REFERENCE, array-size=6, array-size-semantics=FIXED-SIZE, sw-pointer-target-props={target-category=TYPE_REFERENCE, implementation-data-type=Pwm_ChannelConfigType}
      element PwmCcu6ChIdx: category=DATA_REFERENCE, sw-pointer-target-props={target-category=TYPE_REFERENCE, implementation-data-type=uint32}
    Pwm_ChannelConfigType: category=STRUCTURE
      8 x element:
        PwmNotification: implementation-data-type=Pwm_NotifiPtrType
        PwmChannelInfo: implementation-data-type=uint16
        PwmPeriodDefault: implementation-data-type=Pwm_PeriodType
        PwmDutycycleDefault: implementation-data-type=uint32
        PwmShiftValue: implementation-data-type=uint32
        PwmChanneId: implementation-data-type=Pwm_ChannelType
        PwmTimerPtr: category=DATA_REFERENCE, sw-pointer-target-props={target-category=TYPE_REFERENCE, implementation-data-type=uint32}
        PwmTimerUsed: implementation-data-type=uint8
