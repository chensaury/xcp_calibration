AUTOSAR XML (schema 4-2-2)
# Copyright (C) Infineon Technologies (2018)
# All rights reserved.
package /AUTOSAR_Icu/BswModuleDescriptions
  bsw module description Icu: category=BSW_MODULE, module-id=122  # ICU Driver
    provided-entrys:
      Icu_Init
      Icu_DeInit
      Icu_SetMode
      Icu_DisableWakeup
      Icu_EnableWakeup
      Icu_SetActivationCondition
      Icu_DisableEdgeDetection
      Icu_EnableEdgeDetection
      Icu_DisableNotification
      Icu_EnableNotification
      Icu_GetInputState
      Icu_ResetEdgeCount
      Icu_EnableEdgeCount
      Icu_DisableEdgeCount
      Icu_GetEdgeNumbers
      Icu_StartSignalMeasurement
      Icu_StopSignalMeasurement
      Icu_GetTimeElapsed
      Icu_GetDutyCycleValues
      Icu_CheckWakeup
      Icu_Timer_Isr
      Icu_EnableMultiEdgeDetection
      Icu_InitCheck
    bsw module dependency McuDependency: target-module-id=101
      required-entrys:
        Mcu_17_Gpt12_TimerClockInit
        Mcu_17_Gtm_TimChannelDeInit
        Mcu_17_Ccu6_TimerDeInit
        Mcu_17_Gpt12_TimerDeInit
        Mcu_17_Ccu6_TimerStop
        Mcu_17_Gtm_ConnectPortPinToTim
        Mcu_17_Gtm_TimChannelInit
        Mcu_17_Ccu6_TimerInit
        Mcu_17_Ccu6_TimerShadowTransfer
        Mcu_17_Ccu6_TimerStart
        Mcu_17_Gpt12_TimerInit
        Mcu_17_Ccu6_TimerShadowTransfer
    bsw module dependency McalLibDependency: target-module-id=255, required-entrys=[Mcal_Swap, Mcal_WriteSafetyEndInitProtRegMask, Mcal_GetCpuIndex, Mcal_GetBitAtomic, Mcal_SetBitAtomic]
    bsw internal behavior IcuBehavior
      4 x exclusive area:
        ResetEdgeCount
        GtmGetDutyCycle
        SetActivationCondition
        GtmEnableEdgeCount
      22 x bsw called entity:
        Icu_Init: reentrancy-level=NON-REENTRANT, implemented-entry=Icu_Init
        Icu_InitCheck: reentrancy-level=NON-REENTRANT, implemented-entry=Icu_InitCheck
        Icu_DeInit: reentrancy-level=NON-REENTRANT, implemented-entry=Icu_DeInit
        Icu_SetMode: reentrancy-level=NON-REENTRANT, implemented-entry=Icu_SetMode
        Icu_DisableWakeup: reentrancy-level=MULTICORE-REENTRANT, implemented-entry=Icu_DisableWakeup
        Icu_EnableWakeup: reentrancy-level=MULTICORE-REENTRANT, implemented-entry=Icu_EnableWakeup
        Icu_SetActivationCondition: can-enter-exclusive-area=SetActivationCondition, reentrancy-level=MULTICORE-REENTRANT, implemented-entry=Icu_SetActivationCondition
        Icu_DisableEdgeDetection: reentrancy-level=MULTICORE-REENTRANT, implemented-entry=Icu_DisableEdgeDetection
        Icu_EnableEdgeDetection: reentrancy-level=MULTICORE-REENTRANT, implemented-entry=Icu_EnableEdgeDetection
        Icu_DisableNotification: reentrancy-level=MULTICORE-REENTRANT, implemented-entry=Icu_DisableNotification
        Icu_EnableNotification: reentrancy-level=MULTICORE-REENTRANT, implemented-entry=Icu_EnableNotification
        Icu_GetInputState: reentrancy-level=MULTICORE-REENTRANT, implemented-entry=Icu_GetInputState
        Icu_ResetEdgeCount: can-enter-exclusive-area=ResetEdgeCount, reentrancy-level=MULTICORE-REENTRANT, implemented-entry=Icu_ResetEdgeCount
        Icu_EnableEdgeCount: can-enter-exclusive-area=GtmEnableEdgeCount, reentrancy-level=MULTICORE-REENTRANT, implemented-entry=Icu_EnableEdgeCount
        Icu_DisableEdgeCount: reentrancy-level=MULTICORE-REENTRANT, implemented-entry=Icu_DisableEdgeCount
        Icu_GetEdgeNumbers: reentrancy-level=MULTICORE-REENTRANT, implemented-entry=Icu_GetEdgeNumbers
        Icu_StartSignalMeasurement: reentrancy-level=MULTICORE-REENTRANT, implemented-entry=Icu_StartSignalMeasurement
        Icu_StopSignalMeasurement: reentrancy-level=MULTICORE-REENTRANT, implemented-entry=Icu_StopSignalMeasurement
        Icu_GetTimeElapsed: reentrancy-level=MULTICORE-REENTRANT, implemented-entry=Icu_GetTimeElapsed
        Icu_GetDutyCycleValues: can-enter-exclusive-area=GtmGetDutyCycle, reentrancy-level=MULTICORE-REENTRANT, implemented-entry=Icu_GetDutyCycleValues
        Icu_CheckWakeup: reentrancy-level=MULTICORE-REENTRANT, implemented-entry=Icu_CheckWakeup
        Icu_EnableMultiEdgeDetection: reentrancy-level=MULTICORE-REENTRANT, implemented-entry=Icu_EnableMultiEdgeDetection
      bsw interrupt entity Icu_Timer_Isr: reentrancy-level=MULTICORE-REENTRANT, implemented-entry=Icu_Timer_Isr
package /AUTOSAR_Icu/BswModuleEntrys
  23 x bsw module entry, all with sw-service-impl-policy=STANDARD:
    Icu_Init: service-id=0, is-reentrant=false, is-synchronous=true, call-type=REGULAR, execution-context=TASK
      sw service arg ConfigPtr: category=DATA_REFERENCE, sw-pointer-target-props={target-category=TYPE_REFERENCE, implementation-data-type=Icu_17_TimerIp_ConfigType}
    Icu_InitCheck: service-id=48, is-reentrant=false, is-synchronous=true, call-type=REGULAR, execution-context=TASK
      sw service arg ConfigPtr: category=DATA_REFERENCE, sw-pointer-target-props={target-category=TYPE_REFERENCE, implementation-data-type=Icu_17_TimerIp_ConfigType}
    Icu_DeInit: service-id=1, is-reentrant=false, is-synchronous=true, call-type=REGULAR, execution-context=TASK
    Icu_SetMode: service-id=2, is-reentrant=false, is-synchronous=true, call-type=REGULAR, execution-context=TASK
      sw service arg Mode: implementation-data-type=Icu_17_TimerIp_ModeType
    Icu_DisableWakeup: service-id=3, is-reentrant=true, is-synchronous=true, call-type=REGULAR, execution-context=TASK
      sw service arg Channel: implementation-data-type=Icu_17_TimerIp_ChannelType
    Icu_EnableWakeup: service-id=4, is-reentrant=true, is-synchronous=true, call-type=REGULAR, execution-context=TASK
      sw service arg Channel: implementation-data-type=Icu_17_TimerIp_ChannelType
    Icu_SetActivationCondition: service-id=5, is-reentrant=true, is-synchronous=true, call-type=REGULAR, execution-context=TASK
      sw service arg Channel: implementation-data-type=Icu_17_TimerIp_ChannelType
      sw service arg Activation: implementation-data-type=Icu_17_TimerIp_ActivationType
    Icu_DisableEdgeDetection: service-id=23, is-reentrant=true, is-synchronous=true, call-type=REGULAR, execution-context=TASK
      sw service arg Channel: implementation-data-type=Icu_17_TimerIp_ChannelType
    Icu_EnableEdgeDetection: service-id=22, is-reentrant=true, is-synchronous=true, call-type=REGULAR, execution-context=TASK
      sw service arg Channel: implementation-data-type=Icu_17_TimerIp_ChannelType
    Icu_DisableNotification: service-id=6, is-reentrant=true, is-synchronous=true, call-type=REGULAR, execution-context=TASK
      sw service arg Channel: implementation-data-type=Icu_17_TimerIp_ChannelType
    Icu_EnableNotification: service-id=7, is-reentrant=true, is-synchronous=true, call-type=REGULAR, execution-context=TASK
      sw service arg Channel: implementation-data-type=Icu_17_TimerIp_ChannelType
    Icu_GetInputState: service-id=8, is-reentrant=true, is-synchronous=true, call-type=REGULAR, execution-context=TASK
      return type Return: implementation-data-type=Icu_17_TimerIp_InputStateType
      sw service arg Channel: implementation-data-type=Icu_17_TimerIp_ChannelType
    Icu_ResetEdgeCount: service-id=12, is-reentrant=true, is-synchronous=true, call-type=REGULAR, execution-context=TASK
      sw service arg Channel: implementation-data-type=Icu_17_TimerIp_ChannelType
    Icu_EnableEdgeCount: service-id=13, is-reentrant=true, is-synchronous=true, call-type=REGULAR, execution-context=TASK
      sw service arg Channel: implementation-data-type=Icu_17_TimerIp_ChannelType
    Icu_DisableEdgeCount: service-id=14, is-reentrant=true, is-synchronous=true, call-type=REGULAR, execution-context=TASK
      sw service arg Channel: implementation-data-type=Icu_17_TimerIp_ChannelType
    Icu_GetEdgeNumbers: service-id=15, is-reentrant=true, is-synchronous=true, call-type=REGULAR, execution-context=TASK
      return type Return: implementation-data-type=Icu_17_TimerIp_EdgeNumberType
      sw service arg Channel: implementation-data-type=Icu_17_TimerIp_ChannelType
    Icu_StartSignalMeasurement: service-id=19, is-reentrant=true, is-synchronous=false, call-type=REGULAR, execution-context=TASK
      sw service arg Channel: implementation-data-type=Icu_17_TimerIp_ChannelType
    Icu_StopSignalMeasurement: service-id=20, is-reentrant=true, is-synchronous=true, call-type=REGULAR, execution-context=TASK
      sw service arg Channel: implementation-data-type=Icu_17_TimerIp_ChannelType
    Icu_GetTimeElapsed: service-id=16, is-reentrant=true, is-synchronous=true, call-type=REGULAR, execution-context=TASK
      return type Return: implementation-data-type=Icu_17_TimerIp_ValueType
      sw service arg Channel: implementation-data-type=Icu_17_TimerIp_ChannelType
    Icu_GetDutyCycleValues: service-id=17, is-reentrant=true, is-synchronous=true, call-type=REGULAR, execution-context=TASK
      sw service arg Channel: implementation-data-type=Icu_17_TimerIp_ChannelType
      sw service arg DutyCycleValues: category=DATA_REFERENCE, sw-pointer-target-props={target-category=TYPE_REFERENCE, implementation-data-type=Icu_17_TimerIp_DutyCycleType}
    Icu_CheckWakeup: service-id=21, is-reentrant=true, is-synchronous=true, call-type=REGULAR, execution-context=TASK
      sw service arg WakeupSource: implementation-data-type=EcuM_WakeupSourceType
    Icu_Timer_Isr: service-id=32, is-reentrant=true, is-synchronous=true, call-type=CALLBACK, execution-context=INTERRUPT-CAT-1
      sw service arg Channel: implementation-data-type=uint8
    Icu_EnableMultiEdgeDetection: service-id=25, is-reentrant=true, is-synchronous=true, call-type=REGULAR, execution-context=TASK
      sw service arg Channel: implementation-data-type=Icu_17_TimerIp_ChannelType
      sw service arg EdgeCount: implementation-data-type=uint32
package /AUTOSAR_Icu/Implementations
  bsw implementation Icu: programming-language=C, sw-version=3.0.0, vendor-id=17, ar-release-version=4.2.2, behavior=IcuBehavior, vendor-api-infix=TimerIp, vendor-specific-module-def=Icu
    code-descriptors:
      code Files
        artifact-descriptors:
          short-label=ssc::src::Icu_17_TimerIp.c, category=SWSRC
          short-label=ssc::inc::Icu_17_TimerIp.h, category=SWHDR
          short-label=ssc::inc::Icu_17_TimerIp_Local.h, category=SWHDR
          short-label=ssc::inc::Icu_17_TimerIp_Cbk.h, category=SWHDR
    4 x compiler:
      TASKING_COMPILE: name=TASKING, options="--core=tc1.6.2 --iso=99 -O2 --eabi-compliant -AGKpvX --switch=auto --integer-enumeration --default-near-size=0 --fp-model=1", vendor=Altium, version=V6.2r2
      GNU_COMPILE: name=GNU, options="-DGNU -Wall -std=c99 -c -O2 -mtc162 -meabi -fno-short-enums -ffunction-sections -fdata-sections -fstrict-volatile-bitfields", vendor=Hightec, version=V4.9.2.0
      DIAB_COMPILE: name=DIAB, options="-tTC162NF:simple -O -XO -Xsection-split=1 -Xkeep-assembly-file=2 -g3 -Xinline=0 -Xdialect-c99 -ei5388,2273,5387 -ei1824 -Xsmall-data=0 -Xsmall-const=0", vendor=Windriver, version=V5.9.6.4
      GHS_COMPILE: name=GHS, options="-cpu=tc1v162 --no_commons --gnu_asm --no_short_enum -c99 -Ospeed -Onounroll -g -c -dwarf2", vendor=GreenHills, version=V2017.5.5
    generated-artifacts:
      5 x dependency on artifact:
        Icu_PBcfg_c: artifact-descriptor={short-label=generate::template::src::Icu_17_TimerIp_PBcfg.c, category=SWTEMPLATE}, usages=EXECUTE
        Icu_PBcfg_h: artifact-descriptor={short-label=generate::template::inc::Icu_17_TimerIp_PBcfg.h, category=SWTEMPLATE}, usages=EXECUTE
        Icu_Cfg_h: artifact-descriptor={short-label=generate::template::inc::Icu_17_TimerIp_Cfg.h, category=SWTEMPLATE}, usages=COMPILE
        Icu_xdm: artifact-descriptor={short-label=config::Icu_17_TimerIp.xdm, category=SWTOOL}, usages=CODEGENERATION
        Icu_bmd: artifact-descriptor={short-label=autosar::TC39x::TC397x::Icu_17_TimerIp.bmd, category=SWTOOL}, usages=CODEGENERATION
    4 x linker:
      TASKING_LINK: name=TASKING, options="--map-file -OtcXYL --core=mpe:vtc", vendor=Altium, version=V6.2r2
      GNU_LINK: name=GNU, options="-Wl,--mcpu=tc162 -Wl,--gc-sections -nostartfiles -n", vendor=Hightec, version=V4.9.2.0
      DIAB_LINK: name=DIAB, options="-tTC162NF:simple -m6 -Xremove-unused-sections", vendor=Windriver, version=V5.9.6.4
      GHS_LINK: name=GHS, options="-cpu=tc1v162 -ignore_debug_references", vendor=GreenHills, version=V2017.5.5
    resource consumption ResourceConsumption
      5 x memory section:
        VAR_CLEARED_ASIL_B_CORE0_32: alignment=32, sw-addrmethod=VAR
        CONFIG_DATA_ASIL_B_CORE0_UNSPECIFIED: alignment=UNSPECIFIED, sw-addrmethod=CONFIG_DATA
        VAR_CLEARED_ASIL_B_GLOBAL_32: alignment=32, sw-addrmethod=VAR
        CONFIG_DATA_ASIL_B_GLOBAL_UNSPECIFIED: alignment=UNSPECIFIED, sw-addrmethod=CONFIG_DATA
        CODE_ASIL_B_GLOBAL: alignment=UNSPECIFIED, sw-addrmethod=CODE
      section name prefix ICU_17_TIMERIP
package /AUTOSAR_Icu/ImplementationDataTypes
  11 x impl type:
    Icu_17_TimerIp_NotifiPtrType: category=DATA_REFERENCE, sw-pointer-target-props={target-category=FUNCTION_REFERENCE, function-pointer-signature=IoHwAb_IcuNotification}
    Icu_17_TimerIp_ModeType: compu {0=ICU_17_TIMERIP_MODE_NORMAL, 1=ICU_17_TIMERIP_MODE_SLEEP}, implementation-data-type=uint32, additional-native-type-qualifier=enum, type-emitter=BSW
    Icu_17_TimerIp_ChannelType: implementation-data-type=uint8, type-emitter=BSW
    Icu_17_TimerIp_InputStateType: compu {0=ICU_17_TIMERIP_ACTIVE, 1=ICU_17_TIMERIP_IDLE}, implementation-data-type=uint32, additional-native-type-qualifier=enum, type-emitter=BSW
    Icu_17_TimerIp_ActivationType: compu {0=ICU_17_TIMERIP_RISING_EDGE, 1=ICU_17_TIMERIP_FALLING_EDGE, 2=ICU_17_TIMERIP_BOTH_EDGES, 3=ICU_17_TIMERIP_NO_EDGE}, implementation-data-type=uint32, additional-native-type-qualifier=enum, type-emitter=BSW
    Icu_17_TimerIp_ValueType: implementation-data-type=uint32, type-emitter=BSW
    Icu_17_TimerIp_DutyCycleType: category=STRUCTURE
      element ActiveTime: implementation-data-type=Icu_17_TimerIp_ValueType
      element PeriodTime: implementation-data-type=Icu_17_TimerIp_ValueType
    Icu_17_TimerIp_EdgeNumberType: implementation-data-type=uint32, type-emitter=BSW
    Icu_17_TimerIp_ConfigType: category=STRUCTURE
      element EruChannelMap: array-size=8, array-size-semantics=FIXED-SIZE, implementation-data-type=uint16
      element CoreConfig: category=DATA_REFERENCE, array-size=6, array-size-semantics=FIXED-SIZE, sw-pointer-target-props={target-category=TYPE_REFERENCE, implementation-data-type=Icu_17_TimerIp_CoreConfigType}
      element ChannelMapping: array-size=2, array-size-semantics=FIXED-SIZE, implementation-data-type=uint16
    Icu_17_TimerIp_ChannelConfigType: category=STRUCTURE
      21 x element, all with category=TYPE_REFERENCE:
        NotificationPointer: implementation-data-type=Icu_17_TimerIp_NotifiPtrType
        MeasurementMode: sw-bit-representation=number-of-bits=2, implementation-data-type=unsigned_int
        DefaultStartEdge: sw-bit-representation=number-of-bits=2, implementation-data-type=unsigned_int
        MeasurementProperty: sw-bit-representation=number-of-bits=2, implementation-data-type=unsigned_int
        WakeupCapability: sw-bit-representation=number-of-bits=2, implementation-data-type=unsigned_int
        AssignedHwUnitNumber: sw-bit-representation=number-of-bits=16, implementation-data-type=unsigned_int
        AssignedHwUnit: sw-bit-representation=number-of-bits=2, implementation-data-type=unsigned_int
        PinSelection: sw-bit-representation=number-of-bits=4, implementation-data-type=unsigned_int
        Reserved: sw-bit-representation=number-of-bits=2, implementation-data-type=unsigned_int
        TimChFilterTimeForRisingEdge: implementation-data-type=uint32
        TimChFilterTimeForFallingEdge: implementation-data-type=uint32
        InterruptMode: implementation-data-type=uint8
        TimChannelClockSelect: implementation-data-type=uint8
        TimChannelGpr0InputSelect: implementation-data-type=uint8
        TimChannelFilterEnable: implementation-data-type=uint8
        TimChFilterCounterFreqSelect: implementation-data-type=uint8
        TimChFilterModeForRisingEdge: implementation-data-type=uint8
        ModeMappingIndex: implementation-data-type=uint8
        TimChFilterModeForFallingEdge: implementation-data-type=uint8
        OverflowISRThreshold: implementation-data-type=uint32
        TimChannelInputSelect: implementation-data-type=uint8
    Icu_17_TimerIp_CoreConfigType: category=STRUCTURE
      element MaxChannelCore: implementation-data-type=Icu_17_TimerIp_ChannelType
      element ChannelConfigPtr: category=DATA_REFERENCE, sw-pointer-target-props={target-category=TYPE_REFERENCE, implementation-data-type=Icu_17_TimerIp_ChannelConfigType}
      element MaxDataChannelCore: implementation-data-type=Icu_17_TimerIp_ChannelType
