VERSION "HIPBNYYYYYYYYYYYYYYYYYYYYYYYYYYY"

NS_ :

BS_:

BU_: CANextender SG

BO_ 1280 Test: 4 Vector__XXX
 SG_ Test : 0|32@1- (1,0) [0|100000] "" Vector__XXX

BO_ 256 Task100ms: 1 Vector__XXX
 SG_ led_counter : 0|32@1+ (1,0) [0|0] "" Vector__XXX

BA_DEF_  "BusType" STRING ;
BA_DEF_DEF_  "BusType" "";
BA_ "BusType" "CAN";
