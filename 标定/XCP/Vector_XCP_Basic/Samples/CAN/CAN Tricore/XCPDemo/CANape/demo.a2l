/* @@@@ File written by CANAPE_VERSION 16 0 31 @@@@ */ ASAP2_VERSION 1 61
/begin PROJECT demo ""
/begin MODULE CPP ""
/begin MOD_COMMON "" BYTE_ORDER MSB_LAST ALIGNMENT_BYTE 1 ALIGNMENT_WORD 1 ALIGNMENT_LONG 1 ALIGNMENT_INT64 1 ALIGNMENT_FLOAT32_IEEE 1 ALIGNMENT_FLOAT64_IEEE 1 /end MOD_COMMON
/begin IF_DATA XCP
 /begin PROTOCOL_LAYER 0x0100 0x03E8 0x2710 0x00 0x00 0x00 0x00 0x00 0x08 0x08 BYTE_ORDER_MSB_LAST ADDRESS_GRANULARITY_BYTE OPTIONAL_CMD ALLOC_ODT_ENTRY OPTIONAL_CMD ALLOC_ODT OPTIONAL_CMD ALLOC_DAQ OPTIONAL_CMD FREE_DAQ OPTIONAL_CMD GET_DAQ_RESOLUTION_INFO OPTIONAL_CMD GET_DAQ_PROCESSOR_INFO OPTIONAL_CMD GET_DAQ_CLOCK OPTIONAL_CMD START_STOP_SYNCH OPTIONAL_CMD START_STOP_DAQ_LIST OPTIONAL_CMD GET_DAQ_LIST_MODE OPTIONAL_CMD SET_DAQ_LIST_MODE OPTIONAL_CMD WRITE_DAQ OPTIONAL_CMD SET_DAQ_PTR OPTIONAL_CMD CLEAR_DAQ_LIST OPTIONAL_CMD COPY_CAL_PAGE OPTIONAL_CMD GET_CAL_PAGE OPTIONAL_CMD SET_CAL_PAGE OPTIONAL_CMD SHORT_DOWNLOAD OPTIONAL_CMD DOWNLOAD_MAX OPTIONAL_CMD DOWNLOAD OPTIONAL_CMD BUILD_CHECKSUM OPTIONAL_CMD SHORT_UPLOAD OPTIONAL_CMD UPLOAD OPTIONAL_CMD SET_MTA OPTIONAL_CMD GET_COMM_MODE_INFO /end PROTOCOL_LAYER
 /begin DAQ DYNAMIC 0x00 0x02 0x00 OPTIMISATION_TYPE_DEFAULT ADDRESS_EXTENSION_FREE IDENTIFICATION_FIELD_TYPE_ABSOLUTE GRANULARITY_ODT_ENTRY_SIZE_DAQ_BYTE 0x07 OVERLOAD_INDICATION_PID PRESCALER_SUPPORTED /begin TIMESTAMP_SUPPORTED 0x2C72 SIZE_WORD UNIT_1NS /end TIMESTAMP_SUPPORTED /begin EVENT "Task_10ms" "Task_10ms" 0x00 DAQ 0xFF 0x0A 0x06 0x00 /end EVENT /begin EVENT "Task_100ms" "Task_100m" 0x01 DAQ 0xFF 0x64 0x06 0x00 /end EVENT /end DAQ
 /begin PAG 0x01 /end PAG
 /begin PGM PGM_MODE_ABSOLUTE 0x02 0x00 /begin SECTOR "Sector" 0x00 0xA0000000 0x100000 0x00 0x00 0x00 /end SECTOR /begin SECTOR "Sector" 0x01 0xA0100000 0x100000 0x00 0x00 0x00 /end SECTOR /end PGM
 /begin XCP_ON_CAN 0x00 CAN_ID_MASTER 0x0201 CAN_ID_SLAVE 0x0200 BAUDRATE 0x07A120 SAMPLE_POINT 0x4B SAMPLE_RATE SINGLE BTL_CYCLES 0x08 SJW 0x02 SYNC_EDGE SINGLE /end XCP_ON_CAN
 /begin XCP_ON_TCP_IP 0x00 0x15B3 ADDRESS "10.49.47.80" /end XCP_ON_TCP_IP
/end IF_DATA
/begin MOD_PAR ""
 /begin MEMORY_SEGMENT CALRAM "" DATA FLASH INTERN 0xA0080000 0x4000 -1 -1 -1 -1 -1
  /begin IF_DATA XCP
   /begin SEGMENT 0x00 0x02 0x00 0x00 0x00 /begin CHECKSUM XCP_ADD_14 MAX_BLOCK_SIZE 0xFFFFFFFF EXTERNAL_FUNCTION "" /end CHECKSUM
    /begin PAGE 0x00 ECU_ACCESS_DONT_CARE XCP_READ_ACCESS_DONT_CARE XCP_WRITE_ACCESS_NOT_ALLOWED /end PAGE
    /begin PAGE 0x01 ECU_ACCESS_DONT_CARE XCP_READ_ACCESS_DONT_CARE XCP_WRITE_ACCESS_NOT_ALLOWED /end PAGE
    /begin ADDRESS_MAPPING 0xA0080000 0xA0080000 0x4000 /end ADDRESS_MAPPING
   /end SEGMENT
  /end IF_DATA
 /end MEMORY_SEGMENT
/end MOD_PAR
/begin COMPU_METHOD COMPU_METHOD_1 "Q = V" IDENTICAL "%0.6f" "" /end COMPU_METHOD
/begin COMPU_METHOD SYSTEM_TIMER0 "Für 30ns / 133 Mhz" LINEAR "%3.1" "us" COEFFS_LINEAR 0.03333333333 0 /end COMPU_METHOD
/begin CHARACTERISTIC Test_D8000000 "Test value in external RAM." VALUE 0xD8000000 __ULONG_S 0 NO_COMPU_METHOD 0 10000000000 FORMAT "%.15" /end CHARACTERISTIC
/begin MEASUREMENT TraceLoad "VX1000 trace load in %" UBYTE NO_COMPU_METHOD 0 0 0 100 ECU_ADDRESS 0x92000080 ECU_ADDRESS_EXTENSION 0xFD FORMAT "%.15" PHYS_UNIT "%" /end MEASUREMENT
/begin MEASUREMENT adc "" FLOAT32_IEEE NO_COMPU_METHOD 0 0 0 1 ECU_ADDRESS 0xD00017DA FORMAT "%.15"
 /begin IF_DATA XCP
  /begin DAQ_EVENT FIXED_EVENT_LIST EVENT 0x0 /end DAQ_EVENT
 /end IF_DATA
/end MEASUREMENT
/begin CHARACTERISTIC adc_ampl "Amplification for adc " VALUE 0xA0080010 __FLOAT32_IEEE_S 0 NO_COMPU_METHOD 0 1 FORMAT "%.15" /end CHARACTERISTIC
/begin CHARACTERISTIC adc_filter "Filter strength for adc" VALUE 0xA0080014 __FLOAT32_IEEE_S 0 NO_COMPU_METHOD 0 1 FORMAT "%.15" /end CHARACTERISTIC
/begin MEASUREMENT adc_raw "" UWORD NO_COMPU_METHOD 0 0 0 4096 ECU_ADDRESS 0xD00017D8 FORMAT "%.15"
 /begin IF_DATA XCP
  /begin DAQ_EVENT FIXED_EVENT_LIST EVENT 0x0 /end DAQ_EVENT
 /end IF_DATA
/end MEASUREMENT
/begin MEASUREMENT adc_task_counter "" ULONG NO_COMPU_METHOD 0 0 0 4294967295 ECU_ADDRESS 0xD00017D4 FORMAT "%.15"
 /begin IF_DATA XCP
  /begin DAQ_EVENT FIXED_EVENT_LIST EVENT 0x0 /end DAQ_EVENT
 /end IF_DATA
/end MEASUREMENT
/begin MEASUREMENT adc_task_cycle "Cycle time for 10ms ADC Task" ULONG NO_COMPU_METHOD 0 0 100 1000000 READ_WRITE ECU_ADDRESS 0xD00017CC FORMAT "%.15"
 /begin IF_DATA XCP
  /begin DAQ_EVENT FIXED_EVENT_LIST EVENT 0x0 /end DAQ_EVENT
 /end IF_DATA
/end MEASUREMENT
/begin MEASUREMENT clock "" ULONG NO_COMPU_METHOD 0 0 0 4294967295 ECU_ADDRESS 0xD0001000 FORMAT "%.15" /end MEASUREMENT
/begin MEASUREMENT clock_adc "" ULONG NO_COMPU_METHOD 0 0 0 4294967295 ECU_ADDRESS 0xD0001004 FORMAT "%.15"
 /begin IF_DATA XCP
  /begin DAQ_EVENT FIXED_EVENT_LIST EVENT 0x0 /end DAQ_EVENT
 /end IF_DATA
/end MEASUREMENT
/begin MEASUREMENT clock_background "" ULONG NO_COMPU_METHOD 0 0 0 4294967295 ECU_ADDRESS 0xD0001008 FORMAT "%.15"
 /begin IF_DATA XCP
  /begin DAQ_EVENT FIXED_EVENT_LIST EVENT 0x1 /end DAQ_EVENT
 /end IF_DATA
/end MEASUREMENT
/begin MEASUREMENT led_counter "" ULONG NO_COMPU_METHOD 0 0 0 4294967295 ECU_ADDRESS 0xD00017C8 FORMAT "%.15"
 /begin IF_DATA XCP
  /begin DAQ_EVENT VARIABLE /begin AVAILABLE_EVENT_LIST EVENT 0x0 EVENT 0x1 /end AVAILABLE_EVENT_LIST /begin DEFAULT_EVENT_LIST EVENT 0x1 /end DEFAULT_EVENT_LIST /end DAQ_EVENT
 /end IF_DATA
/end MEASUREMENT
/begin CHARACTERISTIC led_pattern "Pattern for Evaluation Board LEDs" CURVE 0xA0080000 __UBYTE_Z 0 NO_COMPU_METHOD 0 255
 /begin AXIS_DESCR FIX_AXIS NO_INPUT_QUANTITY NO_COMPU_METHOD 16 0 15 READ_ONLY FORMAT "%.15" FIX_AXIS_PAR_DIST 0 1 16 /end AXIS_DESCR
 FORMAT "%.15" /end CHARACTERISTIC
/begin MEASUREMENT led_value "" UBYTE NO_COMPU_METHOD 0 0 0 255 ECU_ADDRESS 0xD0001826 FORMAT "%.15"
 /begin IF_DATA XCP
  /begin DAQ_EVENT VARIABLE /begin AVAILABLE_EVENT_LIST EVENT 0x0 EVENT 0x1 /end AVAILABLE_EVENT_LIST /begin DEFAULT_EVENT_LIST EVENT 0x1 /end DEFAULT_EVENT_LIST /end DAQ_EVENT
 /end IF_DATA
/end MEASUREMENT
/begin CHARACTERISTIC map0 "" MAP 0xA0080018 Map_16_8 0 NO_COMPU_METHOD 0 1e+016
 /begin AXIS_DESCR FIX_AXIS NO_INPUT_QUANTITY NO_COMPU_METHOD 8 0 7 READ_ONLY FORMAT "%.15" FIX_AXIS_PAR_DIST 0 1 8 /end AXIS_DESCR
 /begin AXIS_DESCR FIX_AXIS NO_INPUT_QUANTITY NO_COMPU_METHOD 8 0 7 READ_ONLY FORMAT "%.15" FIX_AXIS_PAR_DIST 0 1 8 /end AXIS_DESCR
 FORMAT "%.15" /end CHARACTERISTIC
/begin CHARACTERISTIC map1 "" MAP 0xA0080218 Map_16_8 0 NO_COMPU_METHOD 0 1e+016
 /begin AXIS_DESCR FIX_AXIS NO_INPUT_QUANTITY NO_COMPU_METHOD 8 0 7 READ_ONLY FORMAT "%.15" FIX_AXIS_PAR_DIST 0 1 8 /end AXIS_DESCR
 /begin AXIS_DESCR FIX_AXIS NO_INPUT_QUANTITY NO_COMPU_METHOD 8 0 7 READ_ONLY FORMAT "%.15" FIX_AXIS_PAR_DIST 0 1 8 /end AXIS_DESCR
 FORMAT "%.15" /end CHARACTERISTIC
/begin CHARACTERISTIC map10 "" MAP 0xA0081418 Map_16_8 0 NO_COMPU_METHOD 0 1e+016
 /begin AXIS_DESCR FIX_AXIS NO_INPUT_QUANTITY NO_COMPU_METHOD 8 0 0 READ_ONLY FORMAT "%.15" FIX_AXIS_PAR_DIST 0 1 8 /end AXIS_DESCR
 /begin AXIS_DESCR FIX_AXIS NO_INPUT_QUANTITY NO_COMPU_METHOD 8 0 0 READ_ONLY FORMAT "%.15" FIX_AXIS_PAR_DIST 0 1 8 /end AXIS_DESCR
 FORMAT "%.15" /end CHARACTERISTIC
/begin CHARACTERISTIC map11 "" MAP 0xA0081618 Map_16_8 0 NO_COMPU_METHOD 0 1e+016
 /begin AXIS_DESCR FIX_AXIS NO_INPUT_QUANTITY NO_COMPU_METHOD 8 0 0 READ_ONLY FORMAT "%.15" FIX_AXIS_PAR_DIST 0 1 8 /end AXIS_DESCR
 /begin AXIS_DESCR FIX_AXIS NO_INPUT_QUANTITY NO_COMPU_METHOD 8 0 0 READ_ONLY FORMAT "%.15" FIX_AXIS_PAR_DIST 0 1 8 /end AXIS_DESCR
 FORMAT "%.15" /end CHARACTERISTIC
/begin CHARACTERISTIC map12 "" MAP 0xA0081818 Map_16_8 0 NO_COMPU_METHOD 0 1e+016
 /begin AXIS_DESCR FIX_AXIS NO_INPUT_QUANTITY NO_COMPU_METHOD 8 0 0 READ_ONLY FORMAT "%.15" FIX_AXIS_PAR_DIST 0 1 8 /end AXIS_DESCR
 /begin AXIS_DESCR FIX_AXIS NO_INPUT_QUANTITY NO_COMPU_METHOD 8 0 0 READ_ONLY FORMAT "%.15" FIX_AXIS_PAR_DIST 0 1 8 /end AXIS_DESCR
 FORMAT "%.15" /end CHARACTERISTIC
/begin CHARACTERISTIC map13 "" MAP 0xA0081A18 Map_16_8 0 NO_COMPU_METHOD 0 1e+016
 /begin AXIS_DESCR FIX_AXIS NO_INPUT_QUANTITY NO_COMPU_METHOD 8 0 0 READ_ONLY FORMAT "%.15" FIX_AXIS_PAR_DIST 0 1 8 /end AXIS_DESCR
 /begin AXIS_DESCR FIX_AXIS NO_INPUT_QUANTITY NO_COMPU_METHOD 8 0 0 READ_ONLY FORMAT "%.15" FIX_AXIS_PAR_DIST 0 1 8 /end AXIS_DESCR
 FORMAT "%.15" /end CHARACTERISTIC
/begin CHARACTERISTIC map14 "" MAP 0xA0081C18 Map_16_8 0 NO_COMPU_METHOD 0 1e+016
 /begin AXIS_DESCR FIX_AXIS NO_INPUT_QUANTITY NO_COMPU_METHOD 8 0 0 READ_ONLY FORMAT "%.15" FIX_AXIS_PAR_DIST 0 1 8 /end AXIS_DESCR
 /begin AXIS_DESCR FIX_AXIS NO_INPUT_QUANTITY NO_COMPU_METHOD 8 0 0 READ_ONLY FORMAT "%.15" FIX_AXIS_PAR_DIST 0 1 8 /end AXIS_DESCR
 FORMAT "%.15" /end CHARACTERISTIC
/begin CHARACTERISTIC map15 "" MAP 0xA0081E18 Map_16_8 0 NO_COMPU_METHOD 0 1e+016
 /begin AXIS_DESCR FIX_AXIS NO_INPUT_QUANTITY NO_COMPU_METHOD 8 0 0 READ_ONLY FORMAT "%.15" FIX_AXIS_PAR_DIST 0 1 8 /end AXIS_DESCR
 /begin AXIS_DESCR FIX_AXIS NO_INPUT_QUANTITY NO_COMPU_METHOD 8 0 0 READ_ONLY FORMAT "%.15" FIX_AXIS_PAR_DIST 0 1 8 /end AXIS_DESCR
 FORMAT "%.15" /end CHARACTERISTIC
/begin CHARACTERISTIC map16 "" MAP 0xA0082018 Map_16_8 0 NO_COMPU_METHOD 0 1e+016
 /begin AXIS_DESCR FIX_AXIS NO_INPUT_QUANTITY NO_COMPU_METHOD 8 0 0 READ_ONLY FORMAT "%.15" FIX_AXIS_PAR_DIST 0 1 8 /end AXIS_DESCR
 /begin AXIS_DESCR FIX_AXIS NO_INPUT_QUANTITY NO_COMPU_METHOD 8 0 0 READ_ONLY FORMAT "%.15" FIX_AXIS_PAR_DIST 0 1 8 /end AXIS_DESCR
 FORMAT "%.15" /end CHARACTERISTIC
/begin CHARACTERISTIC map2 "" MAP 0xA0080418 Map_16_8 0 NO_COMPU_METHOD 0 1e+016
 /begin AXIS_DESCR FIX_AXIS NO_INPUT_QUANTITY NO_COMPU_METHOD 8 0 7 READ_ONLY FORMAT "%.15" FIX_AXIS_PAR_DIST 0 1 8 /end AXIS_DESCR
 /begin AXIS_DESCR FIX_AXIS NO_INPUT_QUANTITY NO_COMPU_METHOD 8 0 7 READ_ONLY FORMAT "%.15" FIX_AXIS_PAR_DIST 0 1 8 /end AXIS_DESCR
 FORMAT "%.15" /end CHARACTERISTIC
/begin CHARACTERISTIC map3 "" MAP 0xA0080618 Map_16_8 0 NO_COMPU_METHOD 0 1e+016
 /begin AXIS_DESCR FIX_AXIS NO_INPUT_QUANTITY NO_COMPU_METHOD 8 0 7 READ_ONLY FORMAT "%.15" FIX_AXIS_PAR_DIST 0 1 8 /end AXIS_DESCR
 /begin AXIS_DESCR FIX_AXIS NO_INPUT_QUANTITY NO_COMPU_METHOD 8 0 7 READ_ONLY FORMAT "%.15" FIX_AXIS_PAR_DIST 0 1 8 /end AXIS_DESCR
 FORMAT "%.15" /end CHARACTERISTIC
/begin CHARACTERISTIC map4 "" MAP 0xA0080818 Map_16_8 0 NO_COMPU_METHOD 0 1e+016
 /begin AXIS_DESCR FIX_AXIS NO_INPUT_QUANTITY NO_COMPU_METHOD 8 0 0 READ_ONLY FORMAT "%.15" FIX_AXIS_PAR_DIST 0 1 8 /end AXIS_DESCR
 /begin AXIS_DESCR FIX_AXIS NO_INPUT_QUANTITY NO_COMPU_METHOD 8 0 7 READ_ONLY FORMAT "%.15" FIX_AXIS_PAR_DIST 0 1 8 /end AXIS_DESCR
 FORMAT "%.15" /end CHARACTERISTIC
/begin CHARACTERISTIC map5 "" MAP 0xA0080A18 Map_16_8 0 NO_COMPU_METHOD 0 1e+016
 /begin AXIS_DESCR FIX_AXIS NO_INPUT_QUANTITY NO_COMPU_METHOD 8 0 0 READ_ONLY FORMAT "%.15" FIX_AXIS_PAR_DIST 0 1 8 /end AXIS_DESCR
 /begin AXIS_DESCR FIX_AXIS NO_INPUT_QUANTITY NO_COMPU_METHOD 8 0 0 READ_ONLY FORMAT "%.15" FIX_AXIS_PAR_DIST 0 1 8 /end AXIS_DESCR
 FORMAT "%.15" /end CHARACTERISTIC
/begin CHARACTERISTIC map6 "" MAP 0xA0080C18 Map_16_8 0 NO_COMPU_METHOD 0 1e+016
 /begin AXIS_DESCR FIX_AXIS NO_INPUT_QUANTITY NO_COMPU_METHOD 8 0 0 READ_ONLY FORMAT "%.15" FIX_AXIS_PAR_DIST 0 1 8 /end AXIS_DESCR
 /begin AXIS_DESCR FIX_AXIS NO_INPUT_QUANTITY NO_COMPU_METHOD 8 0 0 READ_ONLY FORMAT "%.15" FIX_AXIS_PAR_DIST 0 1 8 /end AXIS_DESCR
 FORMAT "%.15" /end CHARACTERISTIC
/begin CHARACTERISTIC map7 "" MAP 0xA0080E18 Map_16_8 0 NO_COMPU_METHOD 0 1e+016
 /begin AXIS_DESCR FIX_AXIS NO_INPUT_QUANTITY NO_COMPU_METHOD 8 0 0 READ_ONLY FORMAT "%.15" FIX_AXIS_PAR_DIST 0 1 8 /end AXIS_DESCR
 /begin AXIS_DESCR FIX_AXIS NO_INPUT_QUANTITY NO_COMPU_METHOD 8 0 0 READ_ONLY FORMAT "%.15" FIX_AXIS_PAR_DIST 0 1 8 /end AXIS_DESCR
 FORMAT "%.15" /end CHARACTERISTIC
/begin CHARACTERISTIC map8 "" MAP 0xA0081018 Map_16_8 0 NO_COMPU_METHOD 0 1e+016
 /begin AXIS_DESCR FIX_AXIS NO_INPUT_QUANTITY NO_COMPU_METHOD 8 0 0 READ_ONLY FORMAT "%.15" FIX_AXIS_PAR_DIST 0 1 8 /end AXIS_DESCR
 /begin AXIS_DESCR FIX_AXIS NO_INPUT_QUANTITY NO_COMPU_METHOD 8 0 0 READ_ONLY FORMAT "%.15" FIX_AXIS_PAR_DIST 0 1 8 /end AXIS_DESCR
 FORMAT "%.15" /end CHARACTERISTIC
/begin CHARACTERISTIC map9 "" MAP 0xA0081218 Map_16_8 0 NO_COMPU_METHOD 0 1e+016
 /begin AXIS_DESCR FIX_AXIS NO_INPUT_QUANTITY NO_COMPU_METHOD 8 0 0 READ_ONLY FORMAT "%.15" FIX_AXIS_PAR_DIST 0 1 8 /end AXIS_DESCR
 /begin AXIS_DESCR FIX_AXIS NO_INPUT_QUANTITY NO_COMPU_METHOD 8 0 0 READ_ONLY FORMAT "%.15" FIX_AXIS_PAR_DIST 0 1 8 /end AXIS_DESCR
 FORMAT "%.15" /end CHARACTERISTIC
/begin CHARACTERISTIC test_array "" VAL_BLK 0xD00027F4 __UWORD_Z 0 NO_COMPU_METHOD 0 1000000 READ_ONLY MATRIX_DIM 16 1 1 FORMAT "%.0" /end CHARACTERISTIC
/begin MEASUREMENT test_bits.b1 "<a href=\"www.google.de\">Test</a>" UBYTE NO_COMPU_METHOD 0 0 0 7 READ_WRITE BIT_MASK 0x7 ECU_ADDRESS 0xD00017DE FORMAT "%.15" /end MEASUREMENT
/begin MEASUREMENT test_bits.b2 "" UWORD NO_COMPU_METHOD 0 0 0 255 READ_WRITE BIT_MASK 0x7F8 ECU_ADDRESS 0xD00017DE FORMAT "%.15" /end MEASUREMENT
/begin MEASUREMENT test_bits.b3 "" UBYTE NO_COMPU_METHOD 0 0 0 31 READ_WRITE BIT_MASK 0xF8 ECU_ADDRESS 0xD00017DF FORMAT "%.15" /end MEASUREMENT
/begin MEASUREMENT test_byte "" UBYTE NO_COMPU_METHOD 0 0 0 255 READ_WRITE ECU_ADDRESS 0xD0001827 FORMAT "%.15" /end MEASUREMENT
/begin MEASUREMENT test_double "" FLOAT32_IEEE NO_COMPU_METHOD 0 0 -3.4e+038 3.4e+038 READ_WRITE ECU_ADDRESS 0xD00017EA FORMAT "%.15" /end MEASUREMENT
/begin MEASUREMENT test_dword "" ULONG NO_COMPU_METHOD 0 0 0 4294967295 READ_WRITE ECU_ADDRESS 0xD00017E2 FORMAT "%.15" /end MEASUREMENT
/begin MEASUREMENT test_float "" FLOAT32_IEEE NO_COMPU_METHOD 0 0 -3.4e+038 3.4e+038 READ_WRITE ECU_ADDRESS 0xD00017E6 FORMAT "%.15" /end MEASUREMENT
/begin MEASUREMENT test_word "" UWORD NO_COMPU_METHOD 0 0 0 65535 READ_WRITE ECU_ADDRESS 0xD00017E0 FORMAT "%.15" /end MEASUREMENT
/begin GROUP Calibrations "Kommentar" ROOT /begin REF_CHARACTERISTIC adc_ampl adc_filter led_pattern /end REF_CHARACTERISTIC /end GROUP
/begin GROUP Measurements "Kommentar" ROOT
 /begin REF_MEASUREMENT adc adc_raw adc_task_counter clock clock_adc clock_background led_counter led_value /end REF_MEASUREMENT
/end GROUP
/begin GROUP Test "Kommentar" ROOT
 /begin REF_CHARACTERISTIC map0 map1 map10 map11 map12 map13 map14 map15 map16 map2 map3 map4 map5 map6 map7 map8 map9 test_array /end REF_CHARACTERISTIC
 /begin REF_MEASUREMENT test_bits.b1 test_bits.b2 test_bits.b3 test_byte test_double test_dword test_float test_word /end REF_MEASUREMENT
/end GROUP
/begin GROUP VX1000 "Monitoring signals from VX1000" ROOT /begin REF_MEASUREMENT TraceLoad /end REF_MEASUREMENT /end GROUP
/begin RECORD_LAYOUT Map_16_8 ALIGNMENT_BYTE 1 ALIGNMENT_FLOAT32_IEEE 1 ALIGNMENT_FLOAT64_IEEE 1 ALIGNMENT_INT64 1 ALIGNMENT_LONG 1 ALIGNMENT_WORD 1 FIX_NO_AXIS_PTS_X 16 FIX_NO_AXIS_PTS_Y 8 FNC_VALUES 1 ULONG COLUMN_DIR DIRECT /end RECORD_LAYOUT
/begin RECORD_LAYOUT Scalar_BOOLEAN FNC_VALUES 1 UBYTE COLUMN_DIR DIRECT /end RECORD_LAYOUT
/begin RECORD_LAYOUT Scalar_BYTE FNC_VALUES 1 SBYTE COLUMN_DIR DIRECT /end RECORD_LAYOUT
/begin RECORD_LAYOUT Scalar_FLOAT32_IEEE FNC_VALUES 1 FLOAT32_IEEE COLUMN_DIR DIRECT /end RECORD_LAYOUT
/begin RECORD_LAYOUT Scalar_FLOAT64_IEEE FNC_VALUES 1 FLOAT64_IEEE COLUMN_DIR DIRECT /end RECORD_LAYOUT
/begin RECORD_LAYOUT Scalar_LONG FNC_VALUES 1 SLONG COLUMN_DIR DIRECT /end RECORD_LAYOUT
/begin RECORD_LAYOUT Scalar_SWORD FNC_VALUES 1 SWORD COLUMN_DIR DIRECT /end RECORD_LAYOUT
/begin RECORD_LAYOUT Scalar_UBYTE FNC_VALUES 1 UBYTE COLUMN_DIR DIRECT /end RECORD_LAYOUT
/begin RECORD_LAYOUT Scalar_ULONG FNC_VALUES 1 ULONG COLUMN_DIR DIRECT /end RECORD_LAYOUT
/begin RECORD_LAYOUT Scalar_UWORD FNC_VALUES 1 UWORD COLUMN_DIR DIRECT /end RECORD_LAYOUT
/begin RECORD_LAYOUT __UBYTE_Z FNC_VALUES 1 UBYTE ROW_DIR DIRECT /end RECORD_LAYOUT
/begin RECORD_LAYOUT __UWORD_Z FNC_VALUES 1 UWORD ROW_DIR DIRECT /end RECORD_LAYOUT
/begin RECORD_LAYOUT __ULONG_Z FNC_VALUES 1 ULONG ROW_DIR DIRECT /end RECORD_LAYOUT
/begin RECORD_LAYOUT __SBYTE_Z FNC_VALUES 1 SBYTE ROW_DIR DIRECT /end RECORD_LAYOUT
/begin RECORD_LAYOUT __SWORD_Z FNC_VALUES 1 SWORD ROW_DIR DIRECT /end RECORD_LAYOUT
/begin RECORD_LAYOUT __SLONG_Z FNC_VALUES 1 SLONG ROW_DIR DIRECT /end RECORD_LAYOUT
/begin RECORD_LAYOUT __FLOAT32_IEEE_Z FNC_VALUES 1 FLOAT32_IEEE ROW_DIR DIRECT /end RECORD_LAYOUT
/begin RECORD_LAYOUT __FLOAT64_IEEE_Z FNC_VALUES 1 FLOAT64_IEEE ROW_DIR DIRECT /end RECORD_LAYOUT
/begin RECORD_LAYOUT __UBYTE_S FNC_VALUES 1 UBYTE COLUMN_DIR DIRECT /end RECORD_LAYOUT
/begin RECORD_LAYOUT __UWORD_S FNC_VALUES 1 UWORD COLUMN_DIR DIRECT /end RECORD_LAYOUT
/begin RECORD_LAYOUT __ULONG_S FNC_VALUES 1 ULONG COLUMN_DIR DIRECT /end RECORD_LAYOUT
/begin RECORD_LAYOUT __SBYTE_S FNC_VALUES 1 SBYTE COLUMN_DIR DIRECT /end RECORD_LAYOUT
/begin RECORD_LAYOUT __SWORD_S FNC_VALUES 1 SWORD COLUMN_DIR DIRECT /end RECORD_LAYOUT
/begin RECORD_LAYOUT __SLONG_S FNC_VALUES 1 SLONG COLUMN_DIR DIRECT /end RECORD_LAYOUT
/begin RECORD_LAYOUT __FLOAT32_IEEE_S FNC_VALUES 1 FLOAT32_IEEE COLUMN_DIR DIRECT /end RECORD_LAYOUT
/begin RECORD_LAYOUT __FLOAT64_IEEE_S FNC_VALUES 1 FLOAT64_IEEE COLUMN_DIR DIRECT /end RECORD_LAYOUT
/begin RECORD_LAYOUT SSV__UBYTE_S AXIS_PTS_X 1 UBYTE INDEX_INCR DIRECT /end RECORD_LAYOUT
/begin RECORD_LAYOUT SSV__UWORD_S AXIS_PTS_X 1 UWORD INDEX_INCR DIRECT /end RECORD_LAYOUT
/begin RECORD_LAYOUT SSV__ULONG_S AXIS_PTS_X 1 ULONG INDEX_INCR DIRECT /end RECORD_LAYOUT
/begin RECORD_LAYOUT SSV__SBYTE_S AXIS_PTS_X 1 SBYTE INDEX_INCR DIRECT /end RECORD_LAYOUT
/begin RECORD_LAYOUT SSV__SWORD_S AXIS_PTS_X 1 SWORD INDEX_INCR DIRECT /end RECORD_LAYOUT
/begin RECORD_LAYOUT SSV__SLONG_S AXIS_PTS_X 1 SLONG INDEX_INCR DIRECT /end RECORD_LAYOUT
/begin RECORD_LAYOUT SSV__FLOAT32_IEEE_S AXIS_PTS_X 1 FLOAT32_IEEE INDEX_INCR DIRECT /end RECORD_LAYOUT
/begin RECORD_LAYOUT SSV__FLOAT64_IEEE_S AXIS_PTS_X 1 FLOAT64_IEEE INDEX_INCR DIRECT /end RECORD_LAYOUT
/begin RECORD_LAYOUT __A_UINT64_Z FNC_VALUES 1 A_UINT64 ROW_DIR DIRECT /end RECORD_LAYOUT
/begin RECORD_LAYOUT __A_INT64_Z FNC_VALUES 1 A_INT64 ROW_DIR DIRECT /end RECORD_LAYOUT
/begin RECORD_LAYOUT __A_UINT64_S FNC_VALUES 1 A_UINT64 COLUMN_DIR DIRECT /end RECORD_LAYOUT
/begin RECORD_LAYOUT __A_INT64_S FNC_VALUES 1 A_INT64 COLUMN_DIR DIRECT /end RECORD_LAYOUT
/begin RECORD_LAYOUT SSV__A_UINT64_S AXIS_PTS_X 1 A_UINT64 INDEX_INCR DIRECT /end RECORD_LAYOUT
/begin RECORD_LAYOUT SSV__A_INT64_S AXIS_PTS_X 1 A_INT64 INDEX_INCR DIRECT /end RECORD_LAYOUT
/end MODULE
/end PROJECT
