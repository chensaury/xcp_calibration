/* @@@@ File written by CANAPE_VERSION 13 0 0 @@@@ */ ASAP2_VERSION 1 51
/begin PROJECT XCPDemo ""
/begin MODULE CPP ""
/begin MOD_COMMON "" BYTE_ORDER MSB_FIRST ALIGNMENT_BYTE 1 ALIGNMENT_WORD 1 ALIGNMENT_LONG 1 ALIGNMENT_FLOAT32_IEEE 1 ALIGNMENT_FLOAT64_IEEE 1 /end MOD_COMMON
/begin IF_DATA XCP
 /begin PROTOCOL_LAYER 0x0100 0xC8 0x07D0 0x00 0x00 0x00 0x00 0x00 0x08 0x08 BYTE_ORDER_MSB_FIRST ADDRESS_GRANULARITY_BYTE OPTIONAL_CMD PROGRAM_MAX OPTIONAL_CMD PROGRAM_PREPARE OPTIONAL_CMD PROGRAM_RESET OPTIONAL_CMD PROGRAM OPTIONAL_CMD PROGRAM_CLEAR OPTIONAL_CMD PROGRAM_START OPTIONAL_CMD ALLOC_ODT_ENTRY OPTIONAL_CMD ALLOC_ODT OPTIONAL_CMD ALLOC_DAQ OPTIONAL_CMD FREE_DAQ OPTIONAL_CMD GET_DAQ_LIST_INFO OPTIONAL_CMD GET_DAQ_RESOLUTION_INFO OPTIONAL_CMD GET_DAQ_PROCESSOR_INFO OPTIONAL_CMD READ_DAQ OPTIONAL_CMD GET_DAQ_CLOCK OPTIONAL_CMD START_STOP_SYNCH OPTIONAL_CMD START_STOP_DAQ_LIST OPTIONAL_CMD GET_DAQ_LIST_MODE OPTIONAL_CMD SET_DAQ_LIST_MODE OPTIONAL_CMD WRITE_DAQ OPTIONAL_CMD SET_DAQ_PTR OPTIONAL_CMD CLEAR_DAQ_LIST OPTIONAL_CMD COPY_CAL_PAGE OPTIONAL_CMD GET_CAL_PAGE OPTIONAL_CMD SET_CAL_PAGE OPTIONAL_CMD SHORT_DOWNLOAD OPTIONAL_CMD DOWNLOAD_MAX OPTIONAL_CMD DOWNLOAD_NEXT OPTIONAL_CMD DOWNLOAD OPTIONAL_CMD BUILD_CHECKSUM OPTIONAL_CMD SHORT_UPLOAD OPTIONAL_CMD UPLOAD OPTIONAL_CMD SET_MTA OPTIONAL_CMD UNLOCK OPTIONAL_CMD GET_SEED OPTIONAL_CMD GET_ID OPTIONAL_CMD GET_COMM_MODE_INFO /end PROTOCOL_LAYER
 /begin DAQ DYNAMIC 0x00 0x02 0x00 OPTIMISATION_TYPE_DEFAULT ADDRESS_EXTENSION_FREE IDENTIFICATION_FIELD_TYPE_ABSOLUTE GRANULARITY_ODT_ENTRY_SIZE_DAQ_BYTE 0x07 OVERLOAD_INDICATION_PID PRESCALER_SUPPORTED /begin TIMESTAMP_SUPPORTED 0x01F4 SIZE_WORD UNIT_1MS /end TIMESTAMP_SUPPORTED /begin EVENT "Task_100us" "Task_100u" 0x00 DAQ 0xFF 0x64 0x03 0x00 /end EVENT /begin EVENT "Task_10ms" "Task_10ms" 0x01 DAQ 0xFF 0x02 0x06 0x00 /end EVENT /end DAQ
 /begin PAG 0x03 /end PAG
 /begin PGM PGM_MODE_ABSOLUTE 0x14 0x00 /begin SECTOR "Sector" 0x00 0x00 0x4000 0x00 0x00 0x00 /end SECTOR /begin SECTOR "Sector" 0x01 0x4000 0xC000 0x00 0x00 0x00 /end SECTOR /begin SECTOR "Sector" 0x02 0x010000 0xC000 0x00 0x00 0x00 /end SECTOR /begin SECTOR "Sector" 0x03 0x01C000 0x4000 0x00 0x00 0x00 /end SECTOR /begin SECTOR "Sector" 0x04 0x020000 0x010000 0x00 0x00 0x00 /end SECTOR /begin SECTOR "Sector" 0x05 0x030000 0x010000 0x00 0x00 0x00 /end SECTOR /begin SECTOR "Sector" 0x06 0x040000 0x020000 0x00 0x00 0x00 /end SECTOR /begin SECTOR "Sector" 0x07 0x060000 0x020000 0x00 0x00 0x00 /end SECTOR /begin SECTOR "Sector" 0x08 0x080000 0x020000 0x00 0x00 0x00 /end SECTOR /begin SECTOR "Sector" 0x09 0x0A0000 0x020000 0x00 0x00 0x00 /end SECTOR /begin SECTOR "Sector" 0x0A 0x0C0000 0x020000 0x00 0x00 0x00 /end SECTOR /begin SECTOR "Sector" 0x0B 0x0E0000 0x020000 0x00 0x00 0x00 /end SECTOR /begin SECTOR "Sector" 0x0C 0x100000 0x020000 0x00 0x00 0x00 /end SECTOR /begin SECTOR "Sector" 0x0D 0x120000 0x020000 0x00 0x00 0x00 /end SECTOR /begin SECTOR "Sector" 0x0E 0x140000 0x020000 0x00 0x00 0x00 /end SECTOR /begin SECTOR "Sector" 0x0F 0x160000 0x020000 0x00 0x00 0x00 /end SECTOR /begin SECTOR "Sector" 0x10 0x180000 0x020000 0x00 0x00 0x00 /end SECTOR /begin SECTOR "Sector" 0x11 0x1A0000 0x020000 0x00 0x00 0x00 /end SECTOR /begin SECTOR "Sector" 0x12 0x1C0000 0x020000 0x00 0x00 0x00 /end SECTOR /begin SECTOR "Sector" 0x13 0x1E0000 0x020000 0x00 0x00 0x00 /end SECTOR /end PGM
 /begin XCP_ON_CAN 0x00 CAN_ID_MASTER 0x0201 CAN_ID_SLAVE 0x0200 BAUDRATE 0x0F4240 SAMPLE_POINT 0x4B SAMPLE_RATE SINGLE BTL_CYCLES 0x08 SJW 0x02 SYNC_EDGE SINGLE /end XCP_ON_CAN
 /begin XCP_ON_TCP_IP 0x0100 0x15B3 ADDRESS "192.168.1.2" /end XCP_ON_TCP_IP
 /begin XCP_ON_UDP_IP 0x0100 0x15B3 ADDRESS "10.49.47.80" /end XCP_ON_UDP_IP
/end IF_DATA
/begin MOD_PAR "" VERSION "1" CUSTOMER_NO "1" USER "Rainer" PHONE_NO "302" ECU "XCPDEMO" CPU_TYPE "MPC5564" ADDR_EPK 0x180014 EPK "XCPDEMO V1.1"
 /begin MEMORY_SEGMENT CALRAM "" DATA FLASH INTERN 0x80000 0x2000 -1 -1 -1 -1 -1
  /begin IF_DATA XCP
   /begin SEGMENT 0x00 0x02 0x00 0x00 0x00
    /begin CHECKSUM XCP_ADD_14 MAX_BLOCK_SIZE 0xFFFF EXTERNAL_FUNCTION "String.Empty" /end CHECKSUM
    /begin PAGE 0x00 ECU_ACCESS_DONT_CARE XCP_READ_ACCESS_DONT_CARE XCP_WRITE_ACCESS_NOT_ALLOWED /end PAGE
    /begin PAGE 0x01 ECU_ACCESS_DONT_CARE XCP_READ_ACCESS_DONT_CARE XCP_WRITE_ACCESS_DONT_CARE /end PAGE
    /begin ADDRESS_MAPPING 0x080000 0x40000000 0x2000 /end ADDRESS_MAPPING
   /end SEGMENT
  /end IF_DATA
 /end MEMORY_SEGMENT
 /begin MEMORY_SEGMENT CALRAM "" DATA FLASH INTERN 0x180000 0x8000 -1 -1 -1 -1 -1
  /begin IF_DATA XCP
   /begin SEGMENT 0x01 0x02 0x00 0x00 0x00
    /begin CHECKSUM XCP_ADD_14 MAX_BLOCK_SIZE 0xFFFF EXTERNAL_FUNCTION "String.Empty" /end CHECKSUM
    /begin PAGE 0x00 ECU_ACCESS_DONT_CARE XCP_READ_ACCESS_DONT_CARE XCP_WRITE_ACCESS_NOT_ALLOWED /end PAGE
    /begin PAGE 0x01 ECU_ACCESS_DONT_CARE XCP_READ_ACCESS_DONT_CARE XCP_WRITE_ACCESS_NOT_ALLOWED /end PAGE
   /end SEGMENT
  /end IF_DATA
 /end MEMORY_SEGMENT
 /begin MEMORY_SEGMENT CALRAM "" DATA RAM INTERN 0x40000000 0x2000 -1 -1 -1 -1 -1
  /begin IF_DATA XCP
   /begin SEGMENT 0x02 0x02 0x00 0x00 0x00
    /begin CHECKSUM XCP_ADD_14 MAX_BLOCK_SIZE 0xFFFF EXTERNAL_FUNCTION "String.Empty" /end CHECKSUM
    /begin PAGE 0x00 ECU_ACCESS_DONT_CARE XCP_READ_ACCESS_DONT_CARE XCP_WRITE_ACCESS_NOT_ALLOWED INIT_SEGMENT 0x00 /end PAGE
    /begin PAGE 0x01 ECU_ACCESS_DONT_CARE XCP_READ_ACCESS_DONT_CARE XCP_WRITE_ACCESS_DONT_CARE /end PAGE
   /end SEGMENT
  /end IF_DATA
 /end MEMORY_SEGMENT
 /begin MEMORY_SEGMENT CALRAM "" SERAM RAM INTERN 0x4000E010 0x200 -1 -1 -1 -1 -1
  /begin IF_DATA XCP
   /begin SEGMENT 0x03 0x02 0x00 0x00 0x00
    /begin CHECKSUM XCP_ADD_14 MAX_BLOCK_SIZE 0xFFFF EXTERNAL_FUNCTION "String.Empty" /end CHECKSUM
    /begin PAGE 0x00 ECU_ACCESS_DONT_CARE XCP_READ_ACCESS_DONT_CARE XCP_WRITE_ACCESS_NOT_ALLOWED /end PAGE
    /begin PAGE 0x01 ECU_ACCESS_DONT_CARE XCP_READ_ACCESS_DONT_CARE XCP_WRITE_ACCESS_DONT_CARE /end PAGE
   /end SEGMENT
  /end IF_DATA
 /end MEMORY_SEGMENT
 SYSTEM_CONSTANT "New" "0"
 /begin CALIBRATION_METHOD "AUTOSAR_SINGLE_POINTERED" 0x1 /begin CALIBRATION_HANDLE 0x4000E000 0x10 0x4 0x180024 /end CALIBRATION_HANDLE /end CALIBRATION_METHOD
/end MOD_PAR
/begin COMPU_METHOD adc_cycle_time.CONVERSION "@@@@RuleName created by CANape" RAT_FUNC "%3.1" "us" COEFFS 0 1 0 0 0 1 /end COMPU_METHOD
/begin COMPU_METHOD COMPU_METHOD_NONE "No conversion" RAT_FUNC "" "" COEFFS 0 1 0 0 0 1 /end COMPU_METHOD
/begin COMPU_METHOD DigitalFilterConversion "" RAT_FUNC "%5.3" "Volt" COEFFS 0 1000 -0 0 0 1 /end COMPU_METHOD
/begin COMPU_METHOD ECU_CLOCK "" RAT_FUNC "%.15" "us" COEFFS 0 128 -0 0 0 1 /end COMPU_METHOD
/begin COMPU_METHOD VX1000_CLOCK "" RAT_FUNC "%2.0" "us" COEFFS 0 128 -0 0 0 1 /end COMPU_METHOD
/begin MEASUREMENT adc "" FLOAT32_IEEE NO_COMPU_METHOD 0 0 -3.4e+038 3.4e+038 ECU_ADDRESS 0x40004048 FORMAT "%.3" /end MEASUREMENT
/begin MEASUREMENT adc0 "" UWORD NO_COMPU_METHOD 0 0 0 4294967295 ECU_ADDRESS 0x40004008 FORMAT "%.3" /end MEASUREMENT
/begin MEASUREMENT adc0_conversion "" UBYTE NO_COMPU_METHOD 0 0 0 255 ECU_ADDRESS 0x40004010 FORMAT "%.15" /end MEASUREMENT
/begin MEASUREMENT adc0_filtered "" UWORD NO_COMPU_METHOD 0 0 0 65535 ECU_ADDRESS 0x4000400A FORMAT "%.15" /end MEASUREMENT
/begin MEASUREMENT adc0_timeout "" ULONG NO_COMPU_METHOD 0 0 0 4294967295 ECU_ADDRESS 0x4000400C FORMAT "%.15" /end MEASUREMENT
/begin CHARACTERISTIC adc_cycle_time "Cycle time of the fast adc task (VXTASK100us)" VALUE 0x40000020 __ULONG_S 0 adc_cycle_time.CONVERSION 10 2000 FORMAT "%.0" /end CHARACTERISTIC
/begin CHARACTERISTIC adc_factor "RAM parameter" VALUE 0x40000008 __FLOAT32_IEEE_S 0 NO_COMPU_METHOD 0 10 FORMAT "%6.6" /end CHARACTERISTIC
/begin CHARACTERISTIC adc_filter_depth "" VALUE 0x40000000 __UBYTE_S 0 NO_COMPU_METHOD 0 255 FORMAT "%.15" /end CHARACTERISTIC
/begin CHARACTERISTIC adc_max "" VALUE 0x180084 __FLOAT32_IEEE_S 0 NO_COMPU_METHOD -3.4e+038 3.4e+038 FORMAT "%.15" /end CHARACTERISTIC
/begin CHARACTERISTIC adc_min "" VALUE 0x180080 __FLOAT32_IEEE_S 0 NO_COMPU_METHOD -3.4e+038 3.4e+038 FORMAT "%.15" /end CHARACTERISTIC
/begin CHARACTERISTIC adc_offset "" VALUE 0x180088 __FLOAT32_IEEE_S 0 NO_COMPU_METHOD -3.4e+038 3.4e+038 FORMAT "%.15" /end CHARACTERISTIC
/begin CHARACTERISTIC cal_set_led._led_pattern._0_ "" VALUE 0x18008C __UBYTE_S 0 NO_COMPU_METHOD 0 255 FORMAT "%.15" /end CHARACTERISTIC
/begin CHARACTERISTIC cal_set_led._led_pattern._10_ "" VALUE 0x180096 __UBYTE_S 0 NO_COMPU_METHOD 0 255 FORMAT "%.15" /end CHARACTERISTIC
/begin CHARACTERISTIC cal_set_led._led_pattern._11_ "" VALUE 0x180097 __UBYTE_S 0 NO_COMPU_METHOD 0 255 FORMAT "%.15" /end CHARACTERISTIC
/begin CHARACTERISTIC cal_set_led._led_pattern._12_ "" VALUE 0x180098 __UBYTE_S 0 NO_COMPU_METHOD 0 255 FORMAT "%.15" /end CHARACTERISTIC
/begin CHARACTERISTIC cal_set_led._led_pattern._13_ "" VALUE 0x180099 __UBYTE_S 0 NO_COMPU_METHOD 0 255 FORMAT "%.15" /end CHARACTERISTIC
/begin CHARACTERISTIC cal_set_led._led_pattern._14_ "" VALUE 0x18009A __UBYTE_S 0 NO_COMPU_METHOD 0 255 FORMAT "%.15" /end CHARACTERISTIC
/begin CHARACTERISTIC cal_set_led._led_pattern._15_ "" VALUE 0x18009B __UBYTE_S 0 NO_COMPU_METHOD 0 255 FORMAT "%.15" /end CHARACTERISTIC
/begin CHARACTERISTIC cal_set_led._led_pattern._1_ "" VALUE 0x18008D __UBYTE_S 0 NO_COMPU_METHOD 0 255 FORMAT "%.15" /end CHARACTERISTIC
/begin CHARACTERISTIC cal_set_led._led_pattern._2_ "" VALUE 0x18008E __UBYTE_S 0 NO_COMPU_METHOD 0 255 FORMAT "%.15" /end CHARACTERISTIC
/begin CHARACTERISTIC cal_set_led._led_pattern._3_ "" VALUE 0x18008F __UBYTE_S 0 NO_COMPU_METHOD 0 255 FORMAT "%.15" /end CHARACTERISTIC
/begin CHARACTERISTIC cal_set_led._led_pattern._4_ "" VALUE 0x180090 __UBYTE_S 0 NO_COMPU_METHOD 0 255 FORMAT "%.15" /end CHARACTERISTIC
/begin CHARACTERISTIC cal_set_led._led_pattern._5_ "" VALUE 0x180091 __UBYTE_S 0 NO_COMPU_METHOD 0 255 FORMAT "%.15" /end CHARACTERISTIC
/begin CHARACTERISTIC cal_set_led._led_pattern._6_ "" VALUE 0x180092 __UBYTE_S 0 NO_COMPU_METHOD 0 255 FORMAT "%.15" /end CHARACTERISTIC
/begin CHARACTERISTIC cal_set_led._led_pattern._7_ "" VALUE 0x180093 __UBYTE_S 0 NO_COMPU_METHOD 0 255 FORMAT "%.15" /end CHARACTERISTIC
/begin CHARACTERISTIC cal_set_led._led_pattern._8_ "" VALUE 0x180094 __UBYTE_S 0 NO_COMPU_METHOD 0 255 FORMAT "%.15" /end CHARACTERISTIC
/begin CHARACTERISTIC cal_set_led._led_pattern._9_ "" VALUE 0x180095 __UBYTE_S 0 NO_COMPU_METHOD 0 255 FORMAT "%.15" /end CHARACTERISTIC
/begin CHARACTERISTIC cal_test_array "" CURVE 0x1800B8 __ULONG_Z 0 NO_COMPU_METHOD 0 255
 /begin AXIS_DESCR FIX_AXIS NO_INPUT_QUANTITY NO_COMPU_METHOD 16 0 255 READ_ONLY FORMAT "%.15" FIX_AXIS_PAR_DIST 0 1 16 /end AXIS_DESCR
 FORMAT "%.15" /end CHARACTERISTIC
/begin CHARACTERISTIC cal_test_double "" VALUE 0x1800B0 __FLOAT64_IEEE_S 0 NO_COMPU_METHOD -1.7e+308 1.7e+308 FORMAT "%.15" /end CHARACTERISTIC
/begin CHARACTERISTIC cal_test_float "" VALUE 0x1800A8 __FLOAT32_IEEE_S 0 NO_COMPU_METHOD -3.4e+038 3.4e+038 FORMAT "%.15" /end CHARACTERISTIC
/begin CHARACTERISTIC cal_test_matrix "" MAP 0x1800F8 __UBYTE_Z 0 NO_COMPU_METHOD 0 255
 /begin AXIS_DESCR FIX_AXIS NO_INPUT_QUANTITY NO_COMPU_METHOD 8 0 255 READ_ONLY FORMAT "%.15" FIX_AXIS_PAR_DIST 0 1 8 /end AXIS_DESCR
 /begin AXIS_DESCR FIX_AXIS NO_INPUT_QUANTITY NO_COMPU_METHOD 8 0 255 READ_ONLY FORMAT "%.15" FIX_AXIS_PAR_DIST 0 1 8 /end AXIS_DESCR
 FORMAT "%.15" /end CHARACTERISTIC
/begin CHARACTERISTIC cal_test_ub "" VALUE 0x1800A0 __UBYTE_S 0 NO_COMPU_METHOD 0 255 FORMAT "%.15" /end CHARACTERISTIC
/begin CHARACTERISTIC cal_test_ul "" VALUE 0x1800A4 __ULONG_S 0 NO_COMPU_METHOD 0 4294967295 FORMAT "%.15" /end CHARACTERISTIC
/begin CHARACTERISTIC cal_test_uw "" VALUE 0x1800A2 __UWORD_S 0 NO_COMPU_METHOD 0 65535 FORMAT "%.15" /end CHARACTERISTIC
/begin MEASUREMENT clock0 "" ULONG NO_COMPU_METHOD 0 0 0 4294967295 ECU_ADDRESS 0x40004040 FORMAT "%.15" /end MEASUREMENT
/begin MEASUREMENT clock1 "" ULONG NO_COMPU_METHOD 0 0 0 4294967295 ECU_ADDRESS 0x40004044 FORMAT "%.15" /end MEASUREMENT
/begin MEASUREMENT counter0 "" UBYTE NO_COMPU_METHOD 0 0 0 255 ECU_ADDRESS 0x4000403C FORMAT "%.15" /end MEASUREMENT
/begin MEASUREMENT counter1 "" UBYTE NO_COMPU_METHOD 0 0 0 255 ECU_ADDRESS 0x4000403D FORMAT "%.15" /end MEASUREMENT
/begin CHARACTERISTIC epk "EPK" CURVE 0x180014 __UBYTE_Z 0 NO_COMPU_METHOD 0 255 READ_ONLY
 /begin AXIS_DESCR FIX_AXIS NO_INPUT_QUANTITY NO_COMPU_METHOD 16 0 15 READ_ONLY FORMAT "%.15" FIX_AXIS_PAR_DIST 0 1 16 /end AXIS_DESCR
 FORMAT "%.15" /end CHARACTERISTIC
/begin CHARACTERISTIC gCC.MagicId "" VALUE 0x18003C __ULONG_S 0 NO_COMPU_METHOD 0 4294967295 FORMAT "%.15" /end CHARACTERISTIC
/begin CHARACTERISTIC gCC.MemoryAddr "" VALUE 0x180044 __ULONG_S 0 NO_COMPU_METHOD 0 4294967295 FORMAT "%.15" /end CHARACTERISTIC
/begin CHARACTERISTIC gCC.MemorySize "" VALUE 0x180048 __ULONG_S 0 NO_COMPU_METHOD 0 4294967295 FORMAT "%.15" /end CHARACTERISTIC
/begin CHARACTERISTIC gCC.SetCount "" VALUE 0x18004C __ULONG_S 0 NO_COMPU_METHOD 0 4294967295 FORMAT "%.15" /end CHARACTERISTIC
/begin CHARACTERISTIC gCC.SetPtrFlashTableAddr "" VALUE 0x180054 __ULONG_S 0 NO_COMPU_METHOD 0 4294967295 FORMAT "%.15" /end CHARACTERISTIC
/begin CHARACTERISTIC gCC.SetPtrRamTableAddr "" VALUE 0x180058 __ULONG_S 0 NO_COMPU_METHOD 0 4294967295 FORMAT "%.15" /end CHARACTERISTIC
/begin CHARACTERISTIC gCC.SetSizeFlashTableAddr "" VALUE 0x180050 __ULONG_S 0 NO_COMPU_METHOD 0 4294967295 FORMAT "%.15" /end CHARACTERISTIC
/begin CHARACTERISTIC gCC.Version "" VALUE 0x180040 __UWORD_S 0 NO_COMPU_METHOD 0 65535 FORMAT "%.15" /end CHARACTERISTIC
/begin CHARACTERISTIC gCC_Ram._0_ "" VALUE 0x4000E010 __ULONG_S 0 NO_COMPU_METHOD 0 4294967295 FORMAT "%.15" /end CHARACTERISTIC
/begin CHARACTERISTIC gCC_RamValid "" VALUE 0x4000404C __UBYTE_S 0 NO_COMPU_METHOD 0 255 FORMAT "%.15" /end CHARACTERISTIC
/begin CHARACTERISTIC gCC_SetPtrFlashTable "" MAP 0x180024 __ULONG_Z 0 NO_COMPU_METHOD 0 4294967295
 /begin AXIS_DESCR FIX_AXIS NO_INPUT_QUANTITY NO_COMPU_METHOD 4 0 255 READ_ONLY FORMAT "%.15" FIX_AXIS_PAR_DIST 0 1 4 /end AXIS_DESCR
 /begin AXIS_DESCR FIX_AXIS NO_INPUT_QUANTITY NO_COMPU_METHOD 1 0 255 READ_ONLY FORMAT "%.15" FIX_AXIS_PAR_DIST 0 1 1 /end AXIS_DESCR
 FORMAT "%.0" /end CHARACTERISTIC
/begin CHARACTERISTIC gCC_SetPtrRamTable "" MAP 0x4000E000 __ULONG_Z 0 NO_COMPU_METHOD 0 4294967295
 /begin AXIS_DESCR FIX_AXIS NO_INPUT_QUANTITY NO_COMPU_METHOD 4 0 255 READ_ONLY FORMAT "%.15" FIX_AXIS_PAR_DIST 0 1 4 /end AXIS_DESCR
 /begin AXIS_DESCR FIX_AXIS NO_INPUT_QUANTITY NO_COMPU_METHOD 1 0 255 READ_ONLY FORMAT "%.15" FIX_AXIS_PAR_DIST 0 1 1 /end AXIS_DESCR
 FORMAT "%.0" /end CHARACTERISTIC
/begin CHARACTERISTIC gCC_SetSizeFlashTable "" MAP 0x180034 __UWORD_Z 0 NO_COMPU_METHOD 0 65535
 /begin AXIS_DESCR FIX_AXIS NO_INPUT_QUANTITY NO_COMPU_METHOD 4 0 255 READ_ONLY FORMAT "%.15" FIX_AXIS_PAR_DIST 0 1 4 /end AXIS_DESCR
 /begin AXIS_DESCR FIX_AXIS NO_INPUT_QUANTITY NO_COMPU_METHOD 1 0 255 READ_ONLY FORMAT "%.15" FIX_AXIS_PAR_DIST 0 1 1 /end AXIS_DESCR
 FORMAT "%.0" /end CHARACTERISTIC
/begin MEASUREMENT gVX1000.ToolCtrlState "" ULONG NO_COMPU_METHOD 0 0 0 4294967295 ECU_ADDRESS 0x4000F034 FORMAT "%.15" /end MEASUREMENT
/begin MEASUREMENT gVX1000.ToolDetectState "" ULONG NO_COMPU_METHOD 0 0 0 4294967295 ECU_ADDRESS 0x4000F024 FORMAT "%.15" /end MEASUREMENT
/begin CHARACTERISTIC main_cycle_time "" VALUE 0x40000004 __ULONG_S 0 NO_COMPU_METHOD 0 4294967295 FORMAT "%.15" /end CHARACTERISTIC
/begin CHARACTERISTIC map0 "" MAP 0x180138 Map_16_8 0 NO_COMPU_METHOD 0 255
 /begin AXIS_DESCR FIX_AXIS NO_INPUT_QUANTITY NO_COMPU_METHOD 8 0 7 READ_ONLY FORMAT "%.15" FIX_AXIS_PAR_DIST 0 1 8 /end AXIS_DESCR
 /begin AXIS_DESCR FIX_AXIS NO_INPUT_QUANTITY NO_COMPU_METHOD 16 0 15 READ_ONLY FORMAT "%.15" FIX_AXIS_PAR_DIST 0 1 16 /end AXIS_DESCR
 FORMAT "%.15" /end CHARACTERISTIC
/begin CHARACTERISTIC map1 "" MAP 0x180338 Map_16_8 0 NO_COMPU_METHOD 0 255
 /begin AXIS_DESCR FIX_AXIS NO_INPUT_QUANTITY NO_COMPU_METHOD 8 0 7 READ_ONLY FORMAT "%.15" FIX_AXIS_PAR_DIST 0 1 8 /end AXIS_DESCR
 /begin AXIS_DESCR FIX_AXIS NO_INPUT_QUANTITY NO_COMPU_METHOD 16 0 15 READ_ONLY FORMAT "%.15" FIX_AXIS_PAR_DIST 0 1 16 /end AXIS_DESCR
 FORMAT "%.15" /end CHARACTERISTIC
/begin CHARACTERISTIC map10 "" MAP 0x40000428 Map_16_8 0 NO_COMPU_METHOD 0 255
 /begin AXIS_DESCR FIX_AXIS NO_INPUT_QUANTITY NO_COMPU_METHOD 8 0 7 READ_ONLY FORMAT "%.15" FIX_AXIS_PAR_DIST 0 1 8 /end AXIS_DESCR
 /begin AXIS_DESCR FIX_AXIS NO_INPUT_QUANTITY NO_COMPU_METHOD 16 0 15 READ_ONLY FORMAT "%.15" FIX_AXIS_PAR_DIST 0 1 16 /end AXIS_DESCR
 FORMAT "%.15" /end CHARACTERISTIC
/begin CHARACTERISTIC map11 "" MAP 0x40000628 Map_16_8 0 NO_COMPU_METHOD 0 255
 /begin AXIS_DESCR FIX_AXIS NO_INPUT_QUANTITY NO_COMPU_METHOD 8 0 7 READ_ONLY FORMAT "%.15" FIX_AXIS_PAR_DIST 0 1 8 /end AXIS_DESCR
 /begin AXIS_DESCR FIX_AXIS NO_INPUT_QUANTITY NO_COMPU_METHOD 16 0 15 READ_ONLY FORMAT "%.15" FIX_AXIS_PAR_DIST 0 1 16 /end AXIS_DESCR
 FORMAT "%.15" /end CHARACTERISTIC
/begin CHARACTERISTIC map12 "" MAP 0x40000828 Map_16_8 0 NO_COMPU_METHOD 0 255
 /begin AXIS_DESCR FIX_AXIS NO_INPUT_QUANTITY NO_COMPU_METHOD 8 0 7 READ_ONLY FORMAT "%.15" FIX_AXIS_PAR_DIST 0 1 8 /end AXIS_DESCR
 /begin AXIS_DESCR FIX_AXIS NO_INPUT_QUANTITY NO_COMPU_METHOD 16 0 15 READ_ONLY FORMAT "%.15" FIX_AXIS_PAR_DIST 0 1 16 /end AXIS_DESCR
 FORMAT "%.15" /end CHARACTERISTIC
/begin CHARACTERISTIC map13 "" MAP 0x40000A28 Map_16_8 0 NO_COMPU_METHOD 0 255
 /begin AXIS_DESCR FIX_AXIS NO_INPUT_QUANTITY NO_COMPU_METHOD 8 0 7 READ_ONLY FORMAT "%.15" FIX_AXIS_PAR_DIST 0 1 8 /end AXIS_DESCR
 /begin AXIS_DESCR FIX_AXIS NO_INPUT_QUANTITY NO_COMPU_METHOD 16 0 15 READ_ONLY FORMAT "%.15" FIX_AXIS_PAR_DIST 0 1 16 /end AXIS_DESCR
 FORMAT "%.15" /end CHARACTERISTIC
/begin CHARACTERISTIC map14 "" MAP 0x40000C28 Map_16_8 0 NO_COMPU_METHOD 0 255
 /begin AXIS_DESCR FIX_AXIS NO_INPUT_QUANTITY NO_COMPU_METHOD 8 0 7 READ_ONLY FORMAT "%.15" FIX_AXIS_PAR_DIST 0 1 8 /end AXIS_DESCR
 /begin AXIS_DESCR FIX_AXIS NO_INPUT_QUANTITY NO_COMPU_METHOD 16 0 15 READ_ONLY FORMAT "%.15" FIX_AXIS_PAR_DIST 0 1 16 /end AXIS_DESCR
 FORMAT "%.15" /end CHARACTERISTIC
/begin CHARACTERISTIC map15 "" MAP 0x40000E28 Map_16_8 0 NO_COMPU_METHOD 0 255
 /begin AXIS_DESCR FIX_AXIS NO_INPUT_QUANTITY NO_COMPU_METHOD 8 0 7 READ_ONLY FORMAT "%.15" FIX_AXIS_PAR_DIST 0 1 8 /end AXIS_DESCR
 /begin AXIS_DESCR FIX_AXIS NO_INPUT_QUANTITY NO_COMPU_METHOD 16 0 15 READ_ONLY FORMAT "%.15" FIX_AXIS_PAR_DIST 0 1 16 /end AXIS_DESCR
 FORMAT "%.15" /end CHARACTERISTIC
/begin CHARACTERISTIC map2 "" MAP 0x180538 Map_16_8 0 NO_COMPU_METHOD 0 255
 /begin AXIS_DESCR FIX_AXIS NO_INPUT_QUANTITY NO_COMPU_METHOD 8 0 7 READ_ONLY FORMAT "%.15" FIX_AXIS_PAR_DIST 0 1 8 /end AXIS_DESCR
 /begin AXIS_DESCR FIX_AXIS NO_INPUT_QUANTITY NO_COMPU_METHOD 16 0 15 READ_ONLY FORMAT "%.15" FIX_AXIS_PAR_DIST 0 1 16 /end AXIS_DESCR
 FORMAT "%.15" /end CHARACTERISTIC
/begin CHARACTERISTIC map3 "" MAP 0x180738 Map_16_8 0 NO_COMPU_METHOD 0 255
 /begin AXIS_DESCR FIX_AXIS NO_INPUT_QUANTITY NO_COMPU_METHOD 8 0 7 READ_ONLY FORMAT "%.15" FIX_AXIS_PAR_DIST 0 1 8 /end AXIS_DESCR
 /begin AXIS_DESCR FIX_AXIS NO_INPUT_QUANTITY NO_COMPU_METHOD 16 0 15 READ_ONLY FORMAT "%.15" FIX_AXIS_PAR_DIST 0 1 16 /end AXIS_DESCR
 FORMAT "%.15" /end CHARACTERISTIC
/begin CHARACTERISTIC map4 "" MAP 0x180938 Map_16_8 0 NO_COMPU_METHOD 0 255
 /begin AXIS_DESCR FIX_AXIS NO_INPUT_QUANTITY NO_COMPU_METHOD 8 0 7 READ_ONLY FORMAT "%.15" FIX_AXIS_PAR_DIST 0 1 8 /end AXIS_DESCR
 /begin AXIS_DESCR FIX_AXIS NO_INPUT_QUANTITY NO_COMPU_METHOD 16 0 15 READ_ONLY FORMAT "%.15" FIX_AXIS_PAR_DIST 0 1 16 /end AXIS_DESCR
 FORMAT "%.15" /end CHARACTERISTIC
/begin CHARACTERISTIC map5 "" MAP 0x180B38 Map_16_8 0 NO_COMPU_METHOD 0 255
 /begin AXIS_DESCR FIX_AXIS NO_INPUT_QUANTITY NO_COMPU_METHOD 8 0 7 READ_ONLY FORMAT "%.15" FIX_AXIS_PAR_DIST 0 1 8 /end AXIS_DESCR
 /begin AXIS_DESCR FIX_AXIS NO_INPUT_QUANTITY NO_COMPU_METHOD 16 0 15 READ_ONLY FORMAT "%.15" FIX_AXIS_PAR_DIST 0 1 16 /end AXIS_DESCR
 FORMAT "%.15" /end CHARACTERISTIC
/begin CHARACTERISTIC map6 "" MAP 0x180D38 Map_16_8 0 NO_COMPU_METHOD 0 255
 /begin AXIS_DESCR FIX_AXIS NO_INPUT_QUANTITY NO_COMPU_METHOD 8 0 7 READ_ONLY FORMAT "%.15" FIX_AXIS_PAR_DIST 0 1 8 /end AXIS_DESCR
 /begin AXIS_DESCR FIX_AXIS NO_INPUT_QUANTITY NO_COMPU_METHOD 16 0 15 READ_ONLY FORMAT "%.15" FIX_AXIS_PAR_DIST 0 1 16 /end AXIS_DESCR
 FORMAT "%.15" /end CHARACTERISTIC
/begin CHARACTERISTIC map7 "" MAP 0x180F38 Map_16_8 0 NO_COMPU_METHOD 0 255
 /begin AXIS_DESCR FIX_AXIS NO_INPUT_QUANTITY NO_COMPU_METHOD 8 0 7 READ_ONLY FORMAT "%.15" FIX_AXIS_PAR_DIST 0 1 8 /end AXIS_DESCR
 /begin AXIS_DESCR FIX_AXIS NO_INPUT_QUANTITY NO_COMPU_METHOD 16 0 15 READ_ONLY FORMAT "%.15" FIX_AXIS_PAR_DIST 0 1 16 /end AXIS_DESCR
 FORMAT "%.15" /end CHARACTERISTIC
/begin CHARACTERISTIC map8 "" MAP 0x40000028 Map_16_8 0 NO_COMPU_METHOD 0 255
 /begin AXIS_DESCR FIX_AXIS NO_INPUT_QUANTITY NO_COMPU_METHOD 8 0 7 READ_ONLY FORMAT "%.15" FIX_AXIS_PAR_DIST 0 1 8 /end AXIS_DESCR
 /begin AXIS_DESCR FIX_AXIS NO_INPUT_QUANTITY NO_COMPU_METHOD 16 0 15 READ_ONLY FORMAT "%.15" FIX_AXIS_PAR_DIST 0 1 16 /end AXIS_DESCR
 FORMAT "%.15" /end CHARACTERISTIC
/begin CHARACTERISTIC map9 "" MAP 0x40000228 Map_16_8 0 NO_COMPU_METHOD 0 255
 /begin AXIS_DESCR FIX_AXIS NO_INPUT_QUANTITY NO_COMPU_METHOD 8 0 7 READ_ONLY FORMAT "%.15" FIX_AXIS_PAR_DIST 0 1 8 /end AXIS_DESCR
 /begin AXIS_DESCR FIX_AXIS NO_INPUT_QUANTITY NO_COMPU_METHOD 16 0 15 READ_ONLY FORMAT "%.15" FIX_AXIS_PAR_DIST 0 1 16 /end AXIS_DESCR
 FORMAT "%.15" /end CHARACTERISTIC
/begin CHARACTERISTIC msg_data "" VAL_BLK 0x40000014 __UBYTE_Z 0 NO_COMPU_METHOD 0 255 MATRIX_DIM 8 1 1 FORMAT "%.15" /end CHARACTERISTIC
/begin CHARACTERISTIC msg_enable "" VALUE 0x40000010 __ULONG_S 0 NO_COMPU_METHOD 0 4294967295 FORMAT "%.15" /end CHARACTERISTIC
/begin CHARACTERISTIC msg_len "" VALUE 0x4000001C __UBYTE_S 0 NO_COMPU_METHOD 0 255 FORMAT "%.15" /end CHARACTERISTIC
/begin CHARACTERISTIC msg_trigger "" VALUE 0x4000000C __ULONG_S 0 NO_COMPU_METHOD 0 4294967295 FORMAT "%.15" /end CHARACTERISTIC
/begin MEASUREMENT test_bits "" UBYTE NO_COMPU_METHOD 0 0 0 255 ECU_ADDRESS 0x40002028 FORMAT "%.15" /end MEASUREMENT
/begin MEASUREMENT test_bits.b1 "" UBYTE NO_COMPU_METHOD 0 0 0 7 BIT_MASK 0x7 ECU_ADDRESS 0x40002028 FORMAT "%.15" /end MEASUREMENT
/begin MEASUREMENT test_bits.b2 "" UWORD NO_COMPU_METHOD 0 0 0 255 BIT_MASK 0x7F8 ECU_ADDRESS 0x40002028 FORMAT "%.15" /end MEASUREMENT
/begin MEASUREMENT test_bits.b3 "" UBYTE NO_COMPU_METHOD 0 0 0 31 BIT_MASK 0xF8 ECU_ADDRESS 0x40002029 FORMAT "%.15" /end MEASUREMENT
/begin MEASUREMENT test_byte "" UBYTE NO_COMPU_METHOD 0 0 0 255 ECU_ADDRESS 0x4000202C FORMAT "%.15" /end MEASUREMENT
/begin MEASUREMENT test_double "" FLOAT64_IEEE NO_COMPU_METHOD 0 0 -1.7e+308 1.7e+308 ECU_ADDRESS 0x40002038 FORMAT "%.15" /end MEASUREMENT
/begin MEASUREMENT test_dword "" ULONG NO_COMPU_METHOD 0 0 0 4294967295 ECU_ADDRESS 0x40002030 FORMAT "%.15" /end MEASUREMENT
/begin MEASUREMENT test_float "" FLOAT32_IEEE NO_COMPU_METHOD 0 0 -3.4e+038 3.4e+038 ECU_ADDRESS 0x40002034 FORMAT "%.15" /end MEASUREMENT
/begin MEASUREMENT test_word "" UWORD NO_COMPU_METHOD 0 0 0 65535 ECU_ADDRESS 0x4000202E FORMAT "%.15" /end MEASUREMENT
/begin GROUP ADC "Comment" ROOT /begin SUB_GROUP ADC_Parameters /end SUB_GROUP /begin REF_MEASUREMENT adc adc0 adc0_conversion adc0_filtered adc0_timeout /end REF_MEASUREMENT /end GROUP
/begin GROUP ADC_Parameters "Comment"
 /begin REF_CHARACTERISTIC adc_cycle_time adc_factor adc_filter_depth adc_max adc_min adc_offset /end REF_CHARACTERISTIC
/end GROUP
/begin GROUP AUTOSAR_Parameters "Kommentar" ROOT
 /begin SUB_GROUP cal_set_adc cal_set_demo cal_set_demo2 cal_set_led internals /end SUB_GROUP
/end GROUP
/begin GROUP cal_set_adc "" /begin REF_CHARACTERISTIC adc_max adc_min adc_offset /end REF_CHARACTERISTIC /end GROUP
/begin GROUP cal_set_demo ""
 /begin REF_CHARACTERISTIC cal_test_array cal_test_double cal_test_float cal_test_ub cal_test_ul cal_test_uw /end REF_CHARACTERISTIC
/end GROUP
/begin GROUP cal_set_demo2 "Comment" /begin REF_CHARACTERISTIC cal_test_matrix /end REF_CHARACTERISTIC /end GROUP
/begin GROUP cal_set_led ""
 /begin REF_CHARACTERISTIC cal_set_led._led_pattern._0_ cal_set_led._led_pattern._10_ cal_set_led._led_pattern._11_ cal_set_led._led_pattern._12_ cal_set_led._led_pattern._13_ cal_set_led._led_pattern._14_ cal_set_led._led_pattern._15_ cal_set_led._led_pattern._1_ cal_set_led._led_pattern._2_ cal_set_led._led_pattern._3_ cal_set_led._led_pattern._4_ cal_set_led._led_pattern._5_ cal_set_led._led_pattern._6_ cal_set_led._led_pattern._7_ cal_set_led._led_pattern._8_ cal_set_led._led_pattern._9_ /end REF_CHARACTERISTIC
/end GROUP
/begin GROUP CAN "Comment" ROOT /begin REF_CHARACTERISTIC main_cycle_time msg_data msg_enable msg_len msg_trigger /end REF_CHARACTERISTIC /end GROUP
/begin GROUP internals "Comment"
 /begin REF_CHARACTERISTIC gCC.MagicId gCC.MemoryAddr gCC.MemorySize gCC.SetCount gCC.SetPtrFlashTableAddr gCC.SetPtrRamTableAddr gCC.SetSizeFlashTableAddr gCC.Version gCC_Ram._0_ gCC_RamValid gCC_SetPtrFlashTable gCC_SetPtrRamTable gCC_SetSizeFlashTable /end REF_CHARACTERISTIC
/end GROUP
/begin RECORD_LAYOUT Map_16_8 FNC_VALUES 1 ULONG COLUMN_DIR DIRECT FIX_NO_AXIS_PTS_X 8 FIX_NO_AXIS_PTS_Y 16 ALIGNMENT_BYTE 1 ALIGNMENT_WORD 1 ALIGNMENT_LONG 1 ALIGNMENT_FLOAT32_IEEE 1 ALIGNMENT_FLOAT64_IEEE 1 /end RECORD_LAYOUT
/begin RECORD_LAYOUT __UBYTE_Z FNC_VALUES 1 UBYTE ROW_DIR DIRECT /end RECORD_LAYOUT
/begin RECORD_LAYOUT __UWORD_Z FNC_VALUES 1 UWORD ROW_DIR DIRECT /end RECORD_LAYOUT
/begin RECORD_LAYOUT __ULONG_Z FNC_VALUES 1 ULONG ROW_DIR DIRECT /end RECORD_LAYOUT
/begin RECORD_LAYOUT __SBYTE_Z FNC_VALUES 1 SBYTE ROW_DIR DIRECT /end RECORD_LAYOUT
/begin RECORD_LAYOUT __SWORD_Z FNC_VALUES 1 SWORD ROW_DIR DIRECT /end RECORD_LAYOUT
/begin RECORD_LAYOUT __SLONG_Z FNC_VALUES 1 SLONG ROW_DIR DIRECT /end RECORD_LAYOUT
/begin RECORD_LAYOUT __FLOAT32_IEEE_Z FNC_VALUES 1 FLOAT32_IEEE ROW_DIR DIRECT /end RECORD_LAYOUT
/begin RECORD_LAYOUT __FLOAT64_IEEE_Z FNC_VALUES 1 FLOAT64_IEEE ROW_DIR DIRECT /end RECORD_LAYOUT
/begin RECORD_LAYOUT __UBYTE_S FNC_VALUES 1 UBYTE COLUMN_DIR DIRECT /end RECORD_LAYOUT
/begin RECORD_LAYOUT __UWORD_S FNC_VALUES 1 UWORD COLUMN_DIR DIRECT /end RECORD_LAYOUT
/begin RECORD_LAYOUT __ULONG_S FNC_VALUES 1 ULONG COLUMN_DIR DIRECT /end RECORD_LAYOUT
/begin RECORD_LAYOUT __SBYTE_S FNC_VALUES 1 SBYTE COLUMN_DIR DIRECT /end RECORD_LAYOUT
/begin RECORD_LAYOUT __SWORD_S FNC_VALUES 1 SWORD COLUMN_DIR DIRECT /end RECORD_LAYOUT
/begin RECORD_LAYOUT __SLONG_S FNC_VALUES 1 SLONG COLUMN_DIR DIRECT /end RECORD_LAYOUT
/begin RECORD_LAYOUT __FLOAT32_IEEE_S FNC_VALUES 1 FLOAT32_IEEE COLUMN_DIR DIRECT /end RECORD_LAYOUT
/begin RECORD_LAYOUT __FLOAT64_IEEE_S FNC_VALUES 1 FLOAT64_IEEE COLUMN_DIR DIRECT /end RECORD_LAYOUT
/begin RECORD_LAYOUT SSV__UBYTE_S AXIS_PTS_X 1 UBYTE INDEX_INCR DIRECT /end RECORD_LAYOUT
/begin RECORD_LAYOUT SSV__UWORD_S AXIS_PTS_X 1 UWORD INDEX_INCR DIRECT /end RECORD_LAYOUT
/begin RECORD_LAYOUT SSV__ULONG_S AXIS_PTS_X 1 ULONG INDEX_INCR DIRECT /end RECORD_LAYOUT
/begin RECORD_LAYOUT SSV__SBYTE_S AXIS_PTS_X 1 SBYTE INDEX_INCR DIRECT /end RECORD_LAYOUT
/begin RECORD_LAYOUT SSV__SWORD_S AXIS_PTS_X 1 SWORD INDEX_INCR DIRECT /end RECORD_LAYOUT
/begin RECORD_LAYOUT SSV__SLONG_S AXIS_PTS_X 1 SLONG INDEX_INCR DIRECT /end RECORD_LAYOUT
/begin RECORD_LAYOUT SSV__FLOAT32_IEEE_S AXIS_PTS_X 1 FLOAT32_IEEE INDEX_INCR DIRECT /end RECORD_LAYOUT
/begin RECORD_LAYOUT SSV__FLOAT64_IEEE_S AXIS_PTS_X 1 FLOAT64_IEEE INDEX_INCR DIRECT /end RECORD_LAYOUT
/end MODULE
/end PROJECT
