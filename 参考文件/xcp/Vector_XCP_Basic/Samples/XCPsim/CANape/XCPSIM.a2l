/* @@@@ File written by CANAPE_VERSION 16 0 31 @@@@ */ ASAP2_VERSION 1 51
/begin PROJECT XCPSIM ""
/begin MODULE CPP ""
/begin MOD_COMMON "" BYTE_ORDER MSB_LAST ALIGNMENT_BYTE 1 ALIGNMENT_WORD 1 ALIGNMENT_LONG 1 ALIGNMENT_FLOAT32_IEEE 1 ALIGNMENT_FLOAT64_IEEE 1 /end MOD_COMMON
/begin IF_DATA XCP
 /begin PROTOCOL_LAYER 0x0100 0x03E8 0xC8 0x00 0x00 0x00 0x00 0x00 0x08 0x08 BYTE_ORDER_MSB_LAST ADDRESS_GRANULARITY_BYTE OPTIONAL_CMD GET_DAQ_RESOLUTION_INFO OPTIONAL_CMD GET_DAQ_PROCESSOR_INFO OPTIONAL_CMD SHORT_UPLOAD OPTIONAL_CMD UPLOAD OPTIONAL_CMD SET_MTA OPTIONAL_CMD GET_ID OPTIONAL_CMD GET_COMM_MODE_INFO /end PROTOCOL_LAYER
 /begin DAQ DYNAMIC 0x00 0x06 0x00 OPTIMISATION_TYPE_DEFAULT ADDRESS_EXTENSION_FREE IDENTIFICATION_FIELD_TYPE_ABSOLUTE GRANULARITY_ODT_ENTRY_SIZE_DAQ_BYTE 0x07 OVERLOAD_INDICATION_PID PRESCALER_SUPPORTED /begin TIMESTAMP_SUPPORTED 0x01 SIZE_WORD UNIT_100US /end TIMESTAMP_SUPPORTED /begin EVENT "Key T" "Key T" 0x00 DAQ 0xFF 0x00 0x06 0x00 /end EVENT /begin EVENT "10 ms" "10 ms" 0x01 DAQ_STIM 0xFF 0x0A 0x06 0x00 /end EVENT /begin EVENT "100ms" "100ms" 0x02 DAQ_STIM 0xFF 0x64 0x06 0x00 /end EVENT /begin EVENT "1ms" "1ms" 0x03 DAQ_STIM 0xFF 0x01 0x06 0x00 /end EVENT
  /begin EVENT "FilterBypassDaq" "FilterByp" 0x04 DAQ_STIM 0xFF 0x00 0x06 0x00 /end EVENT
  /begin EVENT "FilterBypassSt" "FilterByp" 0x05 DAQ_STIM 0xFF 0x00 0x06 0x00 /end EVENT
 /end DAQ
 /begin PAG 0x01 /end PAG
 /begin PGM PGM_MODE_ABSOLUTE 0x01 0x00 /begin SECTOR "Sector" 0x00 0x4B5024 0x01C1 0x00 0x00 0x00 /end SECTOR /end PGM
 /begin XCP_ON_CAN 0x0100 CAN_ID_MASTER 0x01 CAN_ID_SLAVE 0x02 BAUDRATE 0x07A120 SAMPLE_POINT 0x3E SAMPLE_RATE SINGLE BTL_CYCLES 0x08 SJW 0x01 SYNC_EDGE SINGLE /end XCP_ON_CAN
 /begin XCP_ON_UDP_IP 0x0100 0x15B3 ADDRESS "127.0.0.1" /end XCP_ON_UDP_IP
/end IF_DATA
/begin MOD_PAR ""
 /begin MEMORY_SEGMENT CALRAM "" VARIABLES RAM INTERN 0x4B5024 0x1C1 -1 -1 -1 -1 -1
  /begin IF_DATA XCP
   /begin SEGMENT 0x00 0x01 0x00 0x00 0x00
    /begin PAGE 0x01 ECU_ACCESS_WITH_XCP_ONLY XCP_READ_ACCESS_WITH_ECU_ONLY XCP_WRITE_ACCESS_WITH_ECU_ONLY INIT_SEGMENT 0x00 /end PAGE
    /begin ADDRESS_MAPPING 0x4B5024 0x4B5024 0x01C1 /end ADDRESS_MAPPING
   /end SEGMENT
  /end IF_DATA
 /end MEMORY_SEGMENT
/end MOD_PAR
/begin COMPU_VTAB HighLow "High/Low for bits" TAB_VERB 2 0 "Low" 1 "High" DEFAULT_VALUE "" /end COMPU_VTAB
/begin COMPU_VTAB TestStatus.CONVERSION "" TAB_VERB 4 0 "Off" 1 "Silent" 2 "Pending" 3 "Running" DEFAULT_VALUE "" /end COMPU_VTAB
/begin COMPU_METHOD BitSlice.CONVERSION "" RAT_FUNC "%6.2f" "" COEFFS 0 1 0 0 0 1 /end COMPU_METHOD
/begin COMPU_METHOD Current "Convert Voltage into Current" FORM "%7.3" "" /begin FORMULA "X*X*2" /end FORMULA /end COMPU_METHOD
/begin COMPU_METHOD DigitalFilterConversion "" RAT_FUNC "%3.1" "Volt" COEFFS 0 1000 0 0 0 1 /end COMPU_METHOD
/begin COMPU_METHOD DtChannel1.CONVERSIONV "@@@@RuleName created by CANape" FORM "%3.1" "" /begin FORMULA "time(X1)-time(X1[-1])" /end FORMULA /end COMPU_METHOD
/begin COMPU_METHOD Factor100 "" RAT_FUNC "%3.1" "" COEFFS 0 100 0 0 0 1 /end COMPU_METHOD
/begin COMPU_METHOD HighLow "High/Low for bits" TAB_VERB "%7.3" "" COMPU_TAB_REF HighLow /end COMPU_METHOD
/begin COMPU_METHOD KF2_Y_AXIS.CONVERSION "" RAT_FUNC "%6.2" "" COEFFS 0 1 0 0 0 1 /end COMPU_METHOD
/begin COMPU_METHOD KF8_Conversion "" RAT_FUNC "%3.1" "1/min" COEFFS 0 10 0 0 0 1 /end COMPU_METHOD
/begin COMPU_METHOD map1Conversion "" RAT_FUNC "%3.1" "cm" COEFFS 0 0.1 0 0 0 1 /end COMPU_METHOD
/begin COMPU_METHOD map1Input_Conversion "" RAT_FUNC "%3.1" "m" COEFFS 0 10 0 0 0 1 /end COMPU_METHOD
/begin COMPU_METHOD MaxChannel1.CONVERSIONV "@@@@RuleName created by CANape" FORM "%3.1" "" /begin FORMULA "max(phy(X1))" /end FORMULA /end COMPU_METHOD
/begin COMPU_METHOD MinChannel1.CONVERSIONV "@@@@RuleName created by CANape" FORM "%3.1" "" /begin FORMULA "min(phy(X1))" /end FORMULA /end COMPU_METHOD
/begin COMPU_METHOD Pressure "Convert Voltage into Pressure" RAT_FUNC "%7.3" "" COEFFS 0 8.09998623 0 0 0 1 /end COMPU_METHOD
/begin COMPU_METHOD sbytePWMLevel.CONVERSION "" RAT_FUNC "%6.2" "" COEFFS 0 1 0 0 0 1 /end COMPU_METHOD
/begin COMPU_METHOD TestStatus.CONVERSION "" TAB_VERB "%3.1" "" COMPU_TAB_REF TestStatus.CONVERSION /end COMPU_METHOD
/begin MEASUREMENT BitSlice "Testsignal: 4 Bit on a byte boundary" UWORD BitSlice.CONVERSION 0 0 0 15 ECU_ADDRESS 0x26F32 FORMAT "%.3" /end MEASUREMENT
/begin MEASUREMENT BitSlice0 "Testsignal: 5 Bit" UWORD BitSlice.CONVERSION 0 0 0 31 ECU_ADDRESS 0x26F32 FORMAT "%.3" /end MEASUREMENT
/begin MEASUREMENT BitSlice1 "Testsignal: 5 Bit " UWORD BitSlice.CONVERSION 0 0 0 31 ECU_ADDRESS 0x26F32 FORMAT "%.3" /end MEASUREMENT
/begin MEASUREMENT BitSlice2 "Testsignal: 5 Bit " UWORD BitSlice.CONVERSION 0 0 0 63 ECU_ADDRESS 0x26F33 FORMAT "%.3" /end MEASUREMENT
/begin MEASUREMENT Counter_B4 "Single bit demo signal (bit from a byte shifting)" UBYTE HighLow 0 0 0 1 READ_WRITE ECU_ADDRESS 0x26F30 FORMAT "%.3" /end MEASUREMENT
/begin MEASUREMENT Counter_B5 "Single bit demo signal (bit from a byte shifting)" UBYTE HighLow 0 0 0 1 READ_WRITE ECU_ADDRESS 0x26F30 FORMAT "%.3" /end MEASUREMENT
/begin MEASUREMENT Counter_B6 "Single bit demo signal (bit from a byte shifting)" UBYTE HighLow 0 0 0 1 READ_WRITE ECU_ADDRESS 0x26F30 FORMAT "%.3" /end MEASUREMENT
/begin MEASUREMENT Counter_B7 "Single bit demo signal (bit from a byte shifting)" UBYTE HighLow 0 0 0 1 READ_WRITE ECU_ADDRESS 0x26F30 FORMAT "%.3" /end MEASUREMENT
/begin AXIS_PTS Curve1 "Curve used as axis" 0x2419C NO_INPUT_QUANTITY SSV__UBYTE_S 0 BitSlice.CONVERSION 8 0 255 DEPOSIT ABSOLUTE FORMAT "%.3" /end AXIS_PTS
/begin MEASUREMENT DtChannel1 "Time jitter of channel1" FLOAT32_IEEE DtChannel1.CONVERSIONV 0 0 0 100 /begin VIRTUAL channel1 /end VIRTUAL FORMAT "%.3" /end MEASUREMENT
/begin MEASUREMENT FW1 "Testparameter" UBYTE BitSlice.CONVERSION 0 0 0 255 READ_WRITE ECU_ADDRESS 0x2404F FORMAT "%.3" /end MEASUREMENT
/begin CHARACTERISTIC KF2 "8*8 BYTE shared axis Curve1/Curve1" MAP 0x24078 __UBYTE_Z 0 BitSlice.CONVERSION 0 255
 /begin AXIS_DESCR COM_AXIS NO_INPUT_QUANTITY BitSlice.CONVERSION 8 0 255 DEPOSIT ABSOLUTE FORMAT "%.3" AXIS_PTS_REF Curve1 /end AXIS_DESCR
 /begin AXIS_DESCR FIX_AXIS NO_INPUT_QUANTITY KF2_Y_AXIS.CONVERSION 8 0 7 READ_ONLY FORMAT "%.2" FIX_AXIS_PAR_DIST 0 1 8 /end AXIS_DESCR
 FORMAT "%.3" /end CHARACTERISTIC
/begin CHARACTERISTIC KF3 "8*6 BYTE no axis" MAP 0x24078 __UBYTE_Z 0 BitSlice.CONVERSION 0 255
 /begin AXIS_DESCR FIX_AXIS NO_INPUT_QUANTITY BitSlice.CONVERSION 8 0 7 READ_ONLY FORMAT "%.0" FIX_AXIS_PAR_DIST 0 1 8 /end AXIS_DESCR
 /begin AXIS_DESCR FIX_AXIS NO_INPUT_QUANTITY BitSlice.CONVERSION 6 0 5 READ_ONLY FORMAT "%.0" FIX_AXIS_PAR_DIST 0 1 6 /end AXIS_DESCR
 FORMAT "%.3" /end CHARACTERISTIC
/begin CHARACTERISTIC KF4 "8*6 BYTE shared axis Curve1" MAP 0x24078 __UBYTE_Z 0 BitSlice.CONVERSION 0 255
 /begin AXIS_DESCR COM_AXIS NO_INPUT_QUANTITY BitSlice.CONVERSION 8 0 255 DEPOSIT ABSOLUTE FORMAT "%.3" AXIS_PTS_REF Curve1 /end AXIS_DESCR
 /begin AXIS_DESCR FIX_AXIS NO_INPUT_QUANTITY BitSlice.CONVERSION 6 0 5 READ_ONLY FORMAT "%.0" FIX_AXIS_PAR_DIST 0 1 6 /end AXIS_DESCR
 FORMAT "%.3" /end CHARACTERISTIC
/begin CHARACTERISTIC KF5 "8*6 BYTE memory layout MapX8Y6V86ub" MAP 0x240F8 MapX8Y6V86ub 0 BitSlice.CONVERSION 0 255
 /begin AXIS_DESCR STD_AXIS NO_INPUT_QUANTITY BitSlice.CONVERSION 8 0 255 DEPOSIT ABSOLUTE FORMAT "%.3" /end AXIS_DESCR
 /begin AXIS_DESCR STD_AXIS NO_INPUT_QUANTITY BitSlice.CONVERSION 6 0 255 DEPOSIT ABSOLUTE FORMAT "%.3" /end AXIS_DESCR
 FORMAT "%.3" /end CHARACTERISTIC
/begin CHARACTERISTIC KF6 "8*8 BYTE no axis" MAP 0x24078 __UBYTE_Z 0 BitSlice.CONVERSION 0 255
 /begin AXIS_DESCR FIX_AXIS NO_INPUT_QUANTITY BitSlice.CONVERSION 8 0 7 READ_ONLY FORMAT "%.0" FIX_AXIS_PAR_DIST 0 1 8 /end AXIS_DESCR
 /begin AXIS_DESCR FIX_AXIS NO_INPUT_QUANTITY BitSlice.CONVERSION 8 0 7 READ_ONLY FORMAT "%.0" FIX_AXIS_PAR_DIST 0 1 8 /end AXIS_DESCR
 FORMAT "%.3" /end CHARACTERISTIC
/begin CHARACTERISTIC KF7 "8*8 BYTE memory layout MapV86ub, shared axis Curve1/Curve1" MAP 0x240B8 MapV86ub 0 BitSlice.CONVERSION 0 255
 /begin AXIS_DESCR COM_AXIS NO_INPUT_QUANTITY BitSlice.CONVERSION 8 0 255 DEPOSIT ABSOLUTE FORMAT "%.3" AXIS_PTS_REF Curve1 /end AXIS_DESCR
 /begin AXIS_DESCR FIX_AXIS NO_INPUT_QUANTITY KF2_Y_AXIS.CONVERSION 6 0 5 READ_ONLY FORMAT "%.2" FIX_AXIS_PAR_DIST 0 1 6 /end AXIS_DESCR
 FORMAT "%.3" /end CHARACTERISTIC
/begin CHARACTERISTIC KL1 "16 BYTE curve" VAL_BLK 0x241C8 __UBYTE_Z 0 BitSlice.CONVERSION 0 255 MATRIX_DIM 16 1 1 FORMAT "%.3" /end CHARACTERISTIC
/begin MEASUREMENT KL1Output "Value generated from curve KL1" UBYTE BitSlice.CONVERSION 0 0 0 255 ECU_ADDRESS 0x26F36 FORMAT "%.3" /end MEASUREMENT
/begin CHARACTERISTIC KL2 "8 BYTE shared axis Curve2" VAL_BLK 0x2419C __UBYTE_Z 0 BitSlice.CONVERSION 0 255 MATRIX_DIM 8 1 1 FORMAT "%.3" /end CHARACTERISTIC
/begin CHARACTERISTIC KL5 "8 BYTE CurveV8ub shared axis Curve2" VAL_BLK 0x2419C CurveV8ub 0 BitSlice.CONVERSION 0 255 MATRIX_DIM 8 1 1 FORMAT "%.3" /end CHARACTERISTIC
/begin MEASUREMENT MaxChannel1 "Maximum value of channel1" FLOAT32_IEEE MaxChannel1.CONVERSIONV 0 0 -100 100 /begin VIRTUAL channel1 /end VIRTUAL FORMAT "%.3" /end MEASUREMENT
/begin MEASUREMENT MinChannel1 "Minimum value of channel1" FLOAT32_IEEE MinChannel1.CONVERSIONV 0 0 -100 100 /begin VIRTUAL channel1 /end VIRTUAL FORMAT "%.3" /end MEASUREMENT
/begin MEASUREMENT PWM "Pulse width signal from PWM_level and Triangle" UBYTE HighLow 0 0 0 255 ECU_ADDRESS 0x26F10 FORMAT "%.0" /end MEASUREMENT
/begin MEASUREMENT PWMFiltered "Low pass filtered PWM signal" UBYTE BitSlice.CONVERSION 0 0 0 255 ECU_ADDRESS 0x26F35 FORMAT "%.3" /end MEASUREMENT
/begin MEASUREMENT PWM_Level "" SBYTE BitSlice.CONVERSION 0 0 -50 50 READ_WRITE ECU_ADDRESS 0x25544 FORMAT "%.0" /end MEASUREMENT
/begin MEASUREMENT ShiftByte "" UBYTE BitSlice.CONVERSION 0 0 0 255 ECU_ADDRESS 0x26F34 FORMAT "%.3" /end MEASUREMENT
/begin MEASUREMENT Shifter_B0 "Single bit demo signal (bit from a byte shifting)" UBYTE HighLow 0 0 0 1 READ_WRITE ECU_ADDRESS 0x26F34 FORMAT "%.3" /end MEASUREMENT
/begin MEASUREMENT Shifter_B1 "Single bit demo signal (bit from a byte shifting)" UBYTE HighLow 0 0 0 1 READ_WRITE ECU_ADDRESS 0x26F34 FORMAT "%.3" /end MEASUREMENT
/begin MEASUREMENT Shifter_B2 "Single bit demo signal (bit from a byte shifting)" UBYTE HighLow 0 0 0 1 READ_WRITE ECU_ADDRESS 0x26F34 FORMAT "%.3" /end MEASUREMENT
/begin MEASUREMENT Shifter_B3 "Single bit demo signal (bit from a byte shifting)" UBYTE HighLow 0 0 0 1 READ_WRITE ECU_ADDRESS 0x26F34 FORMAT "%.3" /end MEASUREMENT
/begin MEASUREMENT TestStatus "2 bit demo signal with symbolic conversion formula" UBYTE TestStatus.CONVERSION 0 0 0 3 READ_WRITE ECU_ADDRESS 0x26F30 FORMAT "%.0" /end MEASUREMENT
/begin MEASUREMENT Triangle "Triangle test signal used for PWM output PWM" SBYTE BitSlice.CONVERSION 0 0 -50 50 ECU_ADDRESS 0x26F29 FORMAT "%.3" /end MEASUREMENT
/begin CHARACTERISTIC a0 "Digital Filter v=(vin*a0+v*b0)/c0" VALUE 0x2404C __UWORD_S 0 DigitalFilterConversion 0 1 FORMAT "%.3" /end CHARACTERISTIC
/begin MEASUREMENT ampl "Amplitude of channel 1-3 " FLOAT32_IEEE BitSlice.CONVERSION 0 0 0 200 READ_WRITE ECU_ADDRESS 0x24044 FORMAT "%.3" /end MEASUREMENT
/begin CHARACTERISTIC b0 "Digital Filter v=(vin*a0+v*b0)/c0" VALUE 0x24050 __UWORD_S 0 DigitalFilterConversion 0 1 FORMAT "%.3" /end CHARACTERISTIC
/begin MEASUREMENT bit12Counter "Demo signal (12 bit, incrementing)" UWORD BitSlice.CONVERSION 0 0 0 4095 ECU_ADDRESS 0x26F32 FORMAT "%.3" /end MEASUREMENT
/begin MEASUREMENT byte1 "Demo, read and write possible" UBYTE BitSlice.CONVERSION 0 0 0 255 READ_WRITE ECU_ADDRESS 0x2401E FORMAT "%.3" /end MEASUREMENT
/begin MEASUREMENT byte2 "Demo, read and write possible" UBYTE BitSlice.CONVERSION 0 0 0 255 READ_WRITE ECU_ADDRESS 0x2401F FORMAT "%.3" /end MEASUREMENT
/begin MEASUREMENT byte3 "Demo, read and write possible" SBYTE BitSlice.CONVERSION 0 0 0 255 READ_WRITE ECU_ADDRESS 0x2404E FORMAT "%.3" /end MEASUREMENT
/begin MEASUREMENT byte4 "Demo, read and write possible" UBYTE BitSlice.CONVERSION 0 0 0 255 READ_WRITE ECU_ADDRESS 0x2404F FORMAT "%.3" /end MEASUREMENT
/begin MEASUREMENT byteCounter "Demo signal (byte, incrementing)" UBYTE BitSlice.CONVERSION 0 0 0 255 ECU_ADDRESS 0x26F30 FORMAT "%.3" /end MEASUREMENT
/begin MEASUREMENT bytePWMFilter "Filter constant for PWM filter" UBYTE BitSlice.CONVERSION 0 0 0 100 READ_WRITE ECU_ADDRESS 0x2401B FORMAT "%.3" /end MEASUREMENT
/begin CHARACTERISTIC c0 "Digital Filter v=(vin*a0+v*b0)/c0" VALUE 0x24054 __UWORD_S 0 DigitalFilterConversion 0 1 FORMAT "%.3" /end CHARACTERISTIC
/begin MEASUREMENT channel1 "FLOAT demo signal (sine wave)" FLOAT32_IEEE BitSlice.CONVERSION 0 0 -1e+012 1e+012 ECU_ADDRESS 0x26F20 FORMAT "%.3" /end MEASUREMENT
/begin MEASUREMENT channel2 "FLOAT demo signal (sine wave)" FLOAT32_IEEE BitSlice.CONVERSION 0 0 -1e+012 1e+012 ECU_ADDRESS 0x26F14 FORMAT "%.3" /end MEASUREMENT
/begin MEASUREMENT channel3 "FLOAT demo signal (sine wave)" FLOAT32_IEEE BitSlice.CONVERSION 0 0 -100 100 ECU_ADDRESS 0x26F04 FORMAT "%.3" /end MEASUREMENT
/begin MEASUREMENT dwordCounter "Demo signal (dword, incrementing)" ULONG BitSlice.CONVERSION 0 0 0 255 ECU_ADDRESS 0x26F2C FORMAT "%.3" /end MEASUREMENT
/begin MEASUREMENT limit "Limit for channel1" FLOAT32_IEEE BitSlice.CONVERSION 0 0 -1e+012 1e+012 READ_WRITE ECU_ADDRESS 0x24048 FORMAT "%.3" /end MEASUREMENT
/begin CHARACTERISTIC map1 "8*8 BYTE shared axis Curve1/Curve1" MAP 0x24078 __UBYTE_Z 0 map1Conversion 0 2550
 /begin AXIS_DESCR FIX_AXIS map1InputX map1Input_Conversion 8 -12.8 12.7 READ_ONLY FORMAT "%.3" FIX_AXIS_PAR_DIST 0 1 8 /end AXIS_DESCR
 /begin AXIS_DESCR FIX_AXIS map1InputY map1Input_Conversion 8 -12.8 12.7 READ_ONLY FORMAT "%.3" FIX_AXIS_PAR_DIST 0 1 8 /end AXIS_DESCR
 FORMAT "%.3" /end CHARACTERISTIC
/begin CHARACTERISTIC map1Counter "" VALUE 0x24052 __UBYTE_S 0 BitSlice.CONVERSION 0 255 FORMAT "%.3" /end CHARACTERISTIC
/begin MEASUREMENT map1InputX "" UBYTE map1Input_Conversion 0 0 0 25.5 ECU_ADDRESS 0x26F38 FORMAT "%.3" /end MEASUREMENT
/begin MEASUREMENT map1InputY "" UBYTE map1Input_Conversion 0 0 0 25.5 ECU_ADDRESS 0x26F1F FORMAT "%.3" /end MEASUREMENT
/begin MEASUREMENT map1Output "" UBYTE map1Conversion 0 0 0 2550 ECU_ADDRESS 0x26F26 FORMAT "%.3" /end MEASUREMENT
/begin CHARACTERISTIC map4_80_uc "8*8 BYTE memory layout map4_80_uc" MAP 0x240F8 MapX8Y8V88ub 0 BitSlice.CONVERSION 0 255
 /begin AXIS_DESCR STD_AXIS NO_INPUT_QUANTITY BitSlice.CONVERSION 8 0 255 DEPOSIT ABSOLUTE FORMAT "%.3" /end AXIS_DESCR
 /begin AXIS_DESCR STD_AXIS NO_INPUT_QUANTITY BitSlice.CONVERSION 8 0 255 DEPOSIT ABSOLUTE FORMAT "%.3" /end AXIS_DESCR
 FORMAT "%.3" /end CHARACTERISTIC
/begin MEASUREMENT offset "Offset for channel1" FLOAT32_IEEE BitSlice.CONVERSION 0 0 -1e+012 1e+012 READ_WRITE ECU_ADDRESS 0x2553C FORMAT "%.3" /end MEASUREMENT
/begin MEASUREMENT period "Period of channel 1-3" FLOAT32_IEEE BitSlice.CONVERSION 0 0 0 100 READ_WRITE ECU_ADDRESS 0x24040 FORMAT "%.3" /end MEASUREMENT
/begin MEASUREMENT sbytePWMLevel "" SBYTE sbytePWMLevel.CONVERSION 0 0 0 255 ECU_ADDRESS 0x25544 FORMAT "%.15" /end MEASUREMENT
/begin CHARACTERISTIC testString "vcv" ASCII 0x24010 __UBYTE_Z 0 NO_COMPU_METHOD 0 255 NUMBER 10 /end CHARACTERISTIC
/begin MEASUREMENT v "Digital Filter Outputvalue" UWORD DigitalFilterConversion 0 0 0 1 READ_WRITE ECU_ADDRESS 0x26F1C FORMAT "%.3" /end MEASUREMENT
/begin MEASUREMENT vin "Digital Filter Inputvalue" UWORD DigitalFilterConversion 0 0 0 1 READ_WRITE ECU_ADDRESS 0x26F08 FORMAT "%.3" /end MEASUREMENT
/begin MEASUREMENT wordCounter "Demo signal (word, incrementing)" UWORD BitSlice.CONVERSION 0 0 0 65535 ECU_ADDRESS 0x26F32 FORMAT "%.3" /end MEASUREMENT
/begin GROUP Axis "Shared Axis for Calibration Maps" ROOT /begin REF_CHARACTERISTIC Curve1 /end REF_CHARACTERISTIC /end GROUP
/begin GROUP Bits "Single Bit Values"
 /begin REF_MEASUREMENT Counter_B4 Counter_B5 Counter_B6 Counter_B7 ShiftByte Shifter_B0 Shifter_B1 Shifter_B2 Shifter_B3 /end REF_MEASUREMENT
/end GROUP
/begin GROUP Bitslices "Multibit Values" /begin REF_MEASUREMENT BitSlice BitSlice0 BitSlice1 BitSlice2 TestStatus /end REF_MEASUREMENT /end GROUP
/begin GROUP Curves "Calibration Curves" ROOT /begin REF_CHARACTERISTIC KL1 KL2 KL5 /end REF_CHARACTERISTIC /end GROUP
/begin GROUP Example_Double "Kommentar" ROOT /end GROUP
/begin GROUP Example_Filter "Digital Filter v=(vin*a0+v*b0)/c0" ROOT /begin REF_CHARACTERISTIC a0 b0 c0 /end REF_CHARACTERISTIC /begin REF_MEASUREMENT v vin /end REF_MEASUREMENT /end GROUP
/begin GROUP Example_PWM "Generator for a PWM Signal" ROOT /begin SUB_GROUP PWM_Parameters PWM_Signals /end SUB_GROUP /end GROUP
/begin GROUP Maps "Calibration Maps" ROOT /begin SUB_GROUP WorkingPoint /end SUB_GROUP /begin REF_CHARACTERISTIC KF2 KF3 KF4 KF5 KF6 KF7 map4_80_uc /end REF_CHARACTERISTIC /end GROUP
/begin GROUP Measure "Measurement Values" ROOT /begin SUB_GROUP Bits Bitslices Test_Signals /end SUB_GROUP /begin REF_MEASUREMENT channel1 channel2 channel3 /end REF_MEASUREMENT /end GROUP
/begin GROUP Parameters "Calibration Parameters" ROOT /begin SUB_GROUP Test_Parameters /end SUB_GROUP /begin REF_MEASUREMENT ampl limit offset period /end REF_MEASUREMENT /end GROUP
/begin GROUP PWM_Parameters "Parametes for PWM Example" /begin REF_MEASUREMENT FW1 PWM_Level bytePWMFilter /end REF_MEASUREMENT /end GROUP
/begin GROUP PWM_Signals "Measurement Signals from PWM" /begin REF_MEASUREMENT PWM PWMFiltered Triangle /end REF_MEASUREMENT /end GROUP
/begin GROUP Test_Parameters "Test Parameters, BYTE" /end GROUP
/begin GROUP Test_Signals "Test Signals"
 /begin REF_MEASUREMENT KL1Output bit12Counter byte1 byte2 byte3 byte4 byteCounter dwordCounter wordCounter /end REF_MEASUREMENT
/end GROUP
/begin GROUP Virtual "Virtual Signals" ROOT /begin REF_MEASUREMENT DtChannel1 MaxChannel1 MinChannel1 /end REF_MEASUREMENT /end GROUP
/begin GROUP WorkingPoint "Example for working point" /begin REF_CHARACTERISTIC map1 map1Counter /end REF_CHARACTERISTIC /begin REF_MEASUREMENT map1InputX map1InputY map1Output /end REF_MEASUREMENT /end GROUP
/begin RECORD_LAYOUT CurveNxVub AXIS_PTS_X 1 UBYTE INDEX_INCR DIRECT FNC_VALUES 2 UBYTE ROW_DIR DIRECT /end RECORD_LAYOUT
/begin RECORD_LAYOUT CurveNxXVub AXIS_PTS_X 2 UBYTE INDEX_INCR DIRECT FNC_VALUES 3 UBYTE ROW_DIR DIRECT NO_AXIS_PTS_X 1 UBYTE /end RECORD_LAYOUT
/begin RECORD_LAYOUT CurveV8ub FIX_NO_AXIS_PTS_X 8 FNC_VALUES 1 UBYTE ROW_DIR DIRECT /end RECORD_LAYOUT
/begin RECORD_LAYOUT CurveVub FNC_VALUES 1 UBYTE ROW_DIR DIRECT /end RECORD_LAYOUT
/begin RECORD_LAYOUT CurveX8ub AXIS_PTS_X 1 UBYTE INDEX_INCR DIRECT FIX_NO_AXIS_PTS_X 8 /end RECORD_LAYOUT
/begin RECORD_LAYOUT CurveX8V8ub AXIS_PTS_X 1 UBYTE INDEX_INCR DIRECT FIX_NO_AXIS_PTS_X 8 FNC_VALUES 2 UBYTE ROW_DIR DIRECT /end RECORD_LAYOUT
/begin RECORD_LAYOUT CurveX8V8ubAlternate AXIS_PTS_X 1 UWORD INDEX_INCR DIRECT FIX_NO_AXIS_PTS_X 8 FNC_VALUES 2 UWORD ALTERNATE_WITH_X DIRECT /end RECORD_LAYOUT
/begin RECORD_LAYOUT MapColRowuw FNC_VALUES 1 UWORD COLUMN_DIR DIRECT /end RECORD_LAYOUT
/begin RECORD_LAYOUT MapNxNyVub FNC_VALUES 3 UBYTE ROW_DIR DIRECT NO_AXIS_PTS_X 1 UBYTE NO_AXIS_PTS_Y 2 UBYTE /end RECORD_LAYOUT
/begin RECORD_LAYOUT MapNxNyXYVsb ALIGNMENT_BYTE 1 ALIGNMENT_FLOAT32_IEEE 1 ALIGNMENT_FLOAT64_IEEE 1 ALIGNMENT_LONG 1 ALIGNMENT_WORD 1 AXIS_PTS_X 3 SBYTE INDEX_INCR DIRECT AXIS_PTS_Y 4 SBYTE INDEX_INCR DIRECT FNC_VALUES 5 SBYTE ROW_DIR DIRECT NO_AXIS_PTS_X 1 SBYTE NO_AXIS_PTS_Y 2 SBYTE /end RECORD_LAYOUT
/begin RECORD_LAYOUT MapNxNyXYVub AXIS_PTS_X 3 UBYTE INDEX_INCR DIRECT AXIS_PTS_Y 4 UBYTE INDEX_INCR DIRECT FNC_VALUES 5 UBYTE ROW_DIR DIRECT NO_AXIS_PTS_X 1 UBYTE NO_AXIS_PTS_Y 2 UBYTE /end RECORD_LAYOUT
/begin RECORD_LAYOUT MapNxXNyYVuc AXIS_PTS_X 2 UBYTE INDEX_INCR DIRECT AXIS_PTS_Y 4 UBYTE INDEX_INCR DIRECT FNC_VALUES 5 UBYTE ROW_DIR DIRECT NO_AXIS_PTS_X 1 UBYTE NO_AXIS_PTS_Y 3 UBYTE /end RECORD_LAYOUT
/begin RECORD_LAYOUT MapRowColub FNC_VALUES 1 UBYTE ROW_DIR DIRECT /end RECORD_LAYOUT
/begin RECORD_LAYOUT MapV86ub FIX_NO_AXIS_PTS_X 8 FIX_NO_AXIS_PTS_Y 6 FNC_VALUES 1 UBYTE ROW_DIR DIRECT /end RECORD_LAYOUT
/begin RECORD_LAYOUT MapX8Y6V86ub AXIS_PTS_X 1 UBYTE INDEX_INCR DIRECT AXIS_PTS_Y 2 UBYTE INDEX_INCR DIRECT FIX_NO_AXIS_PTS_X 8 FIX_NO_AXIS_PTS_Y 6 FNC_VALUES 3 UBYTE ROW_DIR DIRECT /end RECORD_LAYOUT
/begin RECORD_LAYOUT MapX8Y8V88ub AXIS_PTS_X 1 UBYTE INDEX_INCR DIRECT AXIS_PTS_Y 2 UBYTE INDEX_INCR DIRECT FIX_NO_AXIS_PTS_X 8 FIX_NO_AXIS_PTS_Y 8 FNC_VALUES 3 UBYTE ROW_DIR DIRECT /end RECORD_LAYOUT
/begin RECORD_LAYOUT MapXYVub AXIS_PTS_X 1 UBYTE INDEX_INCR DIRECT AXIS_PTS_Y 2 UBYTE INDEX_INCR DIRECT FNC_VALUES 3 UBYTE ROW_DIR DIRECT /end RECORD_LAYOUT
/begin RECORD_LAYOUT __UBYTE_Z FNC_VALUES 1 UBYTE ROW_DIR DIRECT /end RECORD_LAYOUT
/begin RECORD_LAYOUT __UWORD_Z FNC_VALUES 1 UWORD ROW_DIR DIRECT /end RECORD_LAYOUT
/begin RECORD_LAYOUT __ULONG_Z FNC_VALUES 1 ULONG ROW_DIR DIRECT /end RECORD_LAYOUT
/begin RECORD_LAYOUT __SBYTE_Z FNC_VALUES 1 SBYTE ROW_DIR DIRECT /end RECORD_LAYOUT
/begin RECORD_LAYOUT __SWORD_Z FNC_VALUES 1 SWORD ROW_DIR DIRECT /end RECORD_LAYOUT
/begin RECORD_LAYOUT __SLONG_Z FNC_VALUES 1 SLONG ROW_DIR DIRECT /end RECORD_LAYOUT
/begin RECORD_LAYOUT __FLOAT32_IEEE_Z FNC_VALUES 1 FLOAT32_IEEE ROW_DIR DIRECT /end RECORD_LAYOUT
/begin RECORD_LAYOUT __FLOAT64_IEEE_Z FNC_VALUES 1 FLOAT64_IEEE ROW_DIR DIRECT /end RECORD_LAYOUT
/begin RECORD_LAYOUT __UBYTE_S FNC_VALUES 1 UBYTE COLUMN_DIR DIRECT /end RECORD_LAYOUT
/begin RECORD_LAYOUT __UWORD_S FNC_VALUES 1 UWORD COLUMN_DIR DIRECT /end RECORD_LAYOUT
/begin RECORD_LAYOUT __ULONG_S FNC_VALUES 1 ULONG COLUMN_DIR DIRECT /end RECORD_LAYOUT
/begin RECORD_LAYOUT __SBYTE_S FNC_VALUES 1 SBYTE COLUMN_DIR DIRECT /end RECORD_LAYOUT
/begin RECORD_LAYOUT __SWORD_S FNC_VALUES 1 SWORD COLUMN_DIR DIRECT /end RECORD_LAYOUT
/begin RECORD_LAYOUT __SLONG_S FNC_VALUES 1 SLONG COLUMN_DIR DIRECT /end RECORD_LAYOUT
/begin RECORD_LAYOUT __FLOAT32_IEEE_S FNC_VALUES 1 FLOAT32_IEEE COLUMN_DIR DIRECT /end RECORD_LAYOUT
/begin RECORD_LAYOUT __FLOAT64_IEEE_S FNC_VALUES 1 FLOAT64_IEEE COLUMN_DIR DIRECT /end RECORD_LAYOUT
/begin RECORD_LAYOUT SSV__UBYTE_S AXIS_PTS_X 1 UBYTE INDEX_INCR DIRECT /end RECORD_LAYOUT
/begin RECORD_LAYOUT SSV__UWORD_S AXIS_PTS_X 1 UWORD INDEX_INCR DIRECT /end RECORD_LAYOUT
/begin RECORD_LAYOUT SSV__ULONG_S AXIS_PTS_X 1 ULONG INDEX_INCR DIRECT /end RECORD_LAYOUT
/begin RECORD_LAYOUT SSV__SBYTE_S AXIS_PTS_X 1 SBYTE INDEX_INCR DIRECT /end RECORD_LAYOUT
/begin RECORD_LAYOUT SSV__SWORD_S AXIS_PTS_X 1 SWORD INDEX_INCR DIRECT /end RECORD_LAYOUT
/begin RECORD_LAYOUT SSV__SLONG_S AXIS_PTS_X 1 SLONG INDEX_INCR DIRECT /end RECORD_LAYOUT
/begin RECORD_LAYOUT SSV__FLOAT32_IEEE_S AXIS_PTS_X 1 FLOAT32_IEEE INDEX_INCR DIRECT /end RECORD_LAYOUT
/begin RECORD_LAYOUT SSV__FLOAT64_IEEE_S AXIS_PTS_X 1 FLOAT64_IEEE INDEX_INCR DIRECT /end RECORD_LAYOUT
/end MODULE
/end PROJECT
