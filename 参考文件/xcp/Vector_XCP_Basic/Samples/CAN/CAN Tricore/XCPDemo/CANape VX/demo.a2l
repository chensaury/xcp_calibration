/* @@@@ File written by CANAPE_VERSION 16 0 31 @@@@ */ ASAP2_VERSION 1 61
/begin PROJECT demo ""
/begin MODULE CPP ""
/begin MOD_COMMON "" BYTE_ORDER MSB_LAST ALIGNMENT_BYTE 1 ALIGNMENT_WORD 1 ALIGNMENT_LONG 1 ALIGNMENT_INT64 1 ALIGNMENT_FLOAT32_IEEE 1 ALIGNMENT_FLOAT64_IEEE 1 /end MOD_COMMON
/begin IF_DATA XCP
 /begin PROTOCOL_LAYER 0x0100 0x03E8 0x2710 0x00 0x00 0x00 0x00 0x00 0xFA 0xFA BYTE_ORDER_MSB_LAST ADDRESS_GRANULARITY_BYTE OPTIONAL_CMD PROGRAM_PREPARE OPTIONAL_CMD PROGRAM_RESET OPTIONAL_CMD PROGRAM OPTIONAL_CMD PROGRAM_CLEAR OPTIONAL_CMD PROGRAM_START OPTIONAL_CMD ALLOC_ODT_ENTRY OPTIONAL_CMD ALLOC_ODT OPTIONAL_CMD ALLOC_DAQ OPTIONAL_CMD FREE_DAQ OPTIONAL_CMD GET_DAQ_RESOLUTION_INFO OPTIONAL_CMD GET_DAQ_PROCESSOR_INFO OPTIONAL_CMD GET_DAQ_CLOCK OPTIONAL_CMD START_STOP_SYNCH OPTIONAL_CMD START_STOP_DAQ_LIST OPTIONAL_CMD GET_DAQ_LIST_MODE OPTIONAL_CMD SET_DAQ_LIST_MODE OPTIONAL_CMD WRITE_DAQ OPTIONAL_CMD SET_DAQ_PTR OPTIONAL_CMD CLEAR_DAQ_LIST OPTIONAL_CMD COPY_CAL_PAGE OPTIONAL_CMD GET_CAL_PAGE OPTIONAL_CMD SET_CAL_PAGE OPTIONAL_CMD SHORT_DOWNLOAD OPTIONAL_CMD DOWNLOAD_MAX OPTIONAL_CMD DOWNLOAD OPTIONAL_CMD BUILD_CHECKSUM OPTIONAL_CMD SHORT_UPLOAD OPTIONAL_CMD UPLOAD OPTIONAL_CMD SET_MTA OPTIONAL_CMD GET_COMM_MODE_INFO /end PROTOCOL_LAYER
 /begin DAQ DYNAMIC 0x00 0x04 0x00 OPTIMISATION_TYPE_DEFAULT ADDRESS_EXTENSION_FREE IDENTIFICATION_FIELD_TYPE_RELATIVE_BYTE GRANULARITY_ODT_ENTRY_SIZE_DAQ_BYTE 0xF8 OVERLOAD_INDICATION_PID /begin STIM GRANULARITY_ODT_ENTRY_SIZE_STIM_BYTE 0xF8 /end STIM /begin TIMESTAMP_SUPPORTED 0x2D SIZE_DWORD UNIT_1US /end TIMESTAMP_SUPPORTED /begin EVENT "Task_10ms" "Task_10ms" 0x00 DAQ 0xFF 0x0A 0x06 0x00 /end EVENT /begin EVENT "Task_100ms" "Task_100m" 0x01 DAQ 0xFF 0x64 0x06 0x00 /end EVENT /begin EVENT "Bypass_DAQ" "Bypass_DA" 0x02 DAQ 0xFF 0x01 0x07 0xFF /end EVENT /begin EVENT "Bypass_STIM" "Bypass_ST" 0x03 STIM 0xFF 0x01 0x07 0xFF /end EVENT /end DAQ
 /begin PAG 0x01 /end PAG
 /begin PGM PGM_MODE_ABSOLUTE 0x14 0x00 /begin SECTOR "Sector" 0x00 0xA0000000 0x020000 0x00 0x00 0x00 /end SECTOR /begin SECTOR "Sector" 0x01 0xA0020000 0x020000 0x00 0x00 0x00 /end SECTOR /begin SECTOR "Sector" 0x02 0xA0040000 0x040000 0x00 0x00 0x00 /end SECTOR /begin SECTOR "Sector" 0x03 0xA0080000 0x040000 0x00 0x00 0x00 /end SECTOR /begin SECTOR "Sector" 0x04 0xA00C0000 0x040000 0x00 0x00 0x00 /end SECTOR /begin SECTOR "Sector" 0x05 0xA0100000 0x040000 0x00 0x00 0x00 /end SECTOR /begin SECTOR "Sector" 0x06 0xA0140000 0x040000 0x00 0x00 0x00 /end SECTOR /begin SECTOR "Sector" 0x07 0xA0180000 0x040000 0x00 0x00 0x00 /end SECTOR /begin SECTOR "Sector" 0x08 0xA01C0000 0x040000 0x00 0x00 0x00 /end SECTOR /begin SECTOR "Sector" 0x09 0xA01C0000 0x040000 0x00 0x00 0x00 /end SECTOR /begin SECTOR "Sector" 0x0A 0xA0200000 0x010000 0x00 0x00 0x00 /end SECTOR /begin SECTOR "Sector" 0x0B 0xA0210000 0x010000 0x00 0x00 0x00 /end SECTOR /begin SECTOR "Sector" 0x0C 0xA0220000 0x020000 0x00 0x00 0x00 /end SECTOR /begin SECTOR "Sector" 0x0D 0xA0240000 0x040000 0x00 0x00 0x00 /end SECTOR /begin SECTOR "Sector" 0x0E 0xA0280000 0x040000 0x00 0x00 0x00 /end SECTOR /begin SECTOR "Sector" 0x0F 0xA02C0000 0x040000 0x00 0x00 0x00 /end SECTOR /begin SECTOR "Sector" 0x10 0xA0300000 0x040000 0x00 0x00 0x00 /end SECTOR /begin SECTOR "Sector" 0x11 0xA0340000 0x040000 0x00 0x00 0x00 /end SECTOR /begin SECTOR "Sector" 0x12 0xA0380000 0x040000 0x00 0x00 0x00 /end SECTOR /begin SECTOR "Sector" 0x13 0xA03C0000 0x040000 0x00 0x00 0x00 /end SECTOR /end PGM
 /begin XCP_ON_TCP_IP 0x0100 0x15B3 ADDRESS "192.168.1.2" /end XCP_ON_TCP_IP
 /begin XCP_ON_UDP_IP 0x0100 0x15B3 ADDRESS "192.168.1.2" /end XCP_ON_UDP_IP
/end IF_DATA
/begin MOD_PAR ""
 /begin MEMORY_SEGMENT CALRAM "" DATA FLASH INTERN 0xA0080000 0x4000 -1 -1 -1 -1 -1
  /begin IF_DATA XCP
   /begin SEGMENT 0x00 0x02 0x00 0x00 0x00
    /begin CHECKSUM XCP_CRC_16_CITT MAX_BLOCK_SIZE 0xFFFFFFFF EXTERNAL_FUNCTION "" /end CHECKSUM
    /begin PAGE 0x00 ECU_ACCESS_DONT_CARE XCP_READ_ACCESS_DONT_CARE XCP_WRITE_ACCESS_NOT_ALLOWED /end PAGE
    /begin PAGE 0x01 ECU_ACCESS_DONT_CARE XCP_READ_ACCESS_DONT_CARE XCP_WRITE_ACCESS_NOT_ALLOWED /end PAGE
    /begin ADDRESS_MAPPING 0xA0080000 0xA0080000 0x4000 /end ADDRESS_MAPPING
   /end SEGMENT
  /end IF_DATA
 /end MEMORY_SEGMENT
/end MOD_PAR
/begin COMPU_METHOD COMPU_METHOD_1 "Q = V" IDENTICAL "%0.6f" "" /end COMPU_METHOD
/begin COMPU_METHOD SYSTEM_TIMER0_33MHz "Für 30ns / 133 Mhz" LINEAR "%3.1" "us" COEFFS_LINEAR 0.03333333333 0 /end COMPU_METHOD
/begin COMPU_METHOD SYSTEM_TIMER0_45MHz "Für 22.222ns / 180 Mhz" LINEAR "%3.1" "us" COEFFS_LINEAR 0.0222222222222 0 /end COMPU_METHOD
/begin MEASUREMENT BypassInput_1 "" FLOAT32_IEEE NO_COMPU_METHOD 0 0 -3.4e+038 3.4e+038 READ_WRITE ECU_ADDRESS 0xD0001014 FORMAT "%.15" /end MEASUREMENT
/begin MEASUREMENT BypassInput_10 "" UBYTE NO_COMPU_METHOD 0 0 0 255 ECU_ADDRESS 0xD0001646 FORMAT "%.15" /end MEASUREMENT
/begin MEASUREMENT BypassInput_100 "" UBYTE NO_COMPU_METHOD 0 0 0 255 ECU_ADDRESS 0xD0001674 FORMAT "%.15" /end MEASUREMENT
/begin MEASUREMENT BypassInput_101 "" UBYTE NO_COMPU_METHOD 0 0 0 255 ECU_ADDRESS 0xD0001675 FORMAT "%.15" /end MEASUREMENT
/begin MEASUREMENT BypassInput_102 "" UWORD NO_COMPU_METHOD 0 0 0 65535 ECU_ADDRESS 0xD00010AA FORMAT "%.15" /end MEASUREMENT
/begin MEASUREMENT BypassInput_103 "" FLOAT32_IEEE NO_COMPU_METHOD 0 0 -3.4e+038 3.4e+038 ECU_ADDRESS 0xD00010AC FORMAT "%.15" /end MEASUREMENT
/begin MEASUREMENT BypassInput_104 "" UBYTE NO_COMPU_METHOD 0 0 0 255 ECU_ADDRESS 0xD0001676 FORMAT "%.15" /end MEASUREMENT
/begin MEASUREMENT BypassInput_105 "" UBYTE NO_COMPU_METHOD 0 0 0 255 ECU_ADDRESS 0xD0001677 FORMAT "%.15" /end MEASUREMENT
/begin MEASUREMENT BypassInput_106 "" FLOAT32_IEEE NO_COMPU_METHOD 0 0 -3.4e+038 3.4e+038 ECU_ADDRESS 0xD00010B0 FORMAT "%.15" /end MEASUREMENT
/begin MEASUREMENT BypassInput_107 "" UWORD NO_COMPU_METHOD 0 0 0 65535 ECU_ADDRESS 0xD00010B4 FORMAT "%.15" /end MEASUREMENT
/begin MEASUREMENT BypassInput_108 "" UBYTE NO_COMPU_METHOD 0 0 0 255 ECU_ADDRESS 0xD0001678 FORMAT "%.15" /end MEASUREMENT
/begin MEASUREMENT BypassInput_109 "" FLOAT32_IEEE NO_COMPU_METHOD 0 0 -3.4e+038 3.4e+038 ECU_ADDRESS 0xD00010B6 FORMAT "%.15" /end MEASUREMENT
/begin MEASUREMENT BypassInput_11 "" UBYTE NO_COMPU_METHOD 0 0 0 255 ECU_ADDRESS 0xD0001647 FORMAT "%.15" /end MEASUREMENT
/begin MEASUREMENT BypassInput_110 "" UWORD NO_COMPU_METHOD 0 0 0 65535 ECU_ADDRESS 0xD00010BA FORMAT "%.15" /end MEASUREMENT
/begin MEASUREMENT BypassInput_111 "" UBYTE NO_COMPU_METHOD 0 0 0 255 ECU_ADDRESS 0xD0001679 FORMAT "%.15" /end MEASUREMENT
/begin MEASUREMENT BypassInput_112 "" FLOAT32_IEEE NO_COMPU_METHOD 0 0 -3.4e+038 3.4e+038 ECU_ADDRESS 0xD00010BC FORMAT "%.15" /end MEASUREMENT
/begin MEASUREMENT BypassInput_113 "" UBYTE NO_COMPU_METHOD 0 0 0 255 ECU_ADDRESS 0xD000167A FORMAT "%.15" /end MEASUREMENT
/begin MEASUREMENT BypassInput_114 "" UBYTE NO_COMPU_METHOD 0 0 0 255 ECU_ADDRESS 0xD000167B FORMAT "%.15" /end MEASUREMENT
/begin MEASUREMENT BypassInput_115 "" UBYTE NO_COMPU_METHOD 0 0 0 255 ECU_ADDRESS 0xD000167C FORMAT "%.15" /end MEASUREMENT
/begin MEASUREMENT BypassInput_116 "" UBYTE NO_COMPU_METHOD 0 0 0 255 ECU_ADDRESS 0xD000167D FORMAT "%.15" /end MEASUREMENT
/begin MEASUREMENT BypassInput_117 "" UBYTE NO_COMPU_METHOD 0 0 0 255 ECU_ADDRESS 0xD000167E FORMAT "%.15" /end MEASUREMENT
/begin MEASUREMENT BypassInput_118 "" UWORD NO_COMPU_METHOD 0 0 0 65535 ECU_ADDRESS 0xD00010C0 FORMAT "%.15" /end MEASUREMENT
/begin MEASUREMENT BypassInput_119 "" UBYTE NO_COMPU_METHOD 0 0 0 255 ECU_ADDRESS 0xD000167F FORMAT "%.15" /end MEASUREMENT
/begin MEASUREMENT BypassInput_12 "" UWORD NO_COMPU_METHOD 0 0 0 65535 ECU_ADDRESS 0xD0001028 FORMAT "%.15" /end MEASUREMENT
/begin MEASUREMENT BypassInput_120 "" UBYTE NO_COMPU_METHOD 0 0 0 255 ECU_ADDRESS 0xD0001680 FORMAT "%.15" /end MEASUREMENT
/begin MEASUREMENT BypassInput_121 "" UBYTE NO_COMPU_METHOD 0 0 0 255 ECU_ADDRESS 0xD0001681 FORMAT "%.15" /end MEASUREMENT
/begin MEASUREMENT BypassInput_122 "" UWORD NO_COMPU_METHOD 0 0 0 65535 ECU_ADDRESS 0xD00010C2 FORMAT "%.15" /end MEASUREMENT
/begin MEASUREMENT BypassInput_123 "" UWORD NO_COMPU_METHOD 0 0 0 65535 ECU_ADDRESS 0xD00010C4 FORMAT "%.15" /end MEASUREMENT
/begin MEASUREMENT BypassInput_124 "" UBYTE NO_COMPU_METHOD 0 0 0 255 ECU_ADDRESS 0xD0001682 FORMAT "%.15" /end MEASUREMENT
/begin MEASUREMENT BypassInput_125 "" FLOAT32_IEEE NO_COMPU_METHOD 0 0 -3.4e+038 3.4e+038 ECU_ADDRESS 0xD00010C6 FORMAT "%.15" /end MEASUREMENT
/begin MEASUREMENT BypassInput_126 "" UBYTE NO_COMPU_METHOD 0 0 0 255 ECU_ADDRESS 0xD0001683 FORMAT "%.15" /end MEASUREMENT
/begin MEASUREMENT BypassInput_127 "" UBYTE NO_COMPU_METHOD 0 0 0 255 ECU_ADDRESS 0xD0001684 FORMAT "%.15" /end MEASUREMENT
/begin MEASUREMENT BypassInput_128 "" FLOAT32_IEEE NO_COMPU_METHOD 0 0 -3.4e+038 3.4e+038 ECU_ADDRESS 0xD00010CA FORMAT "%.15" /end MEASUREMENT
/begin MEASUREMENT BypassInput_129 "" FLOAT32_IEEE NO_COMPU_METHOD 0 0 -3.4e+038 3.4e+038 ECU_ADDRESS 0xD00010CE FORMAT "%.15" /end MEASUREMENT
/begin MEASUREMENT BypassInput_13 "" FLOAT32_IEEE NO_COMPU_METHOD 0 0 -3.4e+038 3.4e+038 ECU_ADDRESS 0xD000102A FORMAT "%.15" /end MEASUREMENT
/begin MEASUREMENT BypassInput_130 "" UBYTE NO_COMPU_METHOD 0 0 0 255 ECU_ADDRESS 0xD0001685 FORMAT "%.15" /end MEASUREMENT
/begin MEASUREMENT BypassInput_131 "" UBYTE NO_COMPU_METHOD 0 0 0 255 ECU_ADDRESS 0xD0001686 FORMAT "%.15" /end MEASUREMENT
/begin MEASUREMENT BypassInput_132 "" FLOAT32_IEEE NO_COMPU_METHOD 0 0 -3.4e+038 3.4e+038 ECU_ADDRESS 0xD00010D2 FORMAT "%.15" /end MEASUREMENT
/begin MEASUREMENT BypassInput_133 "" UWORD NO_COMPU_METHOD 0 0 0 65535 ECU_ADDRESS 0xD00010D6 FORMAT "%.15" /end MEASUREMENT
/begin MEASUREMENT BypassInput_134 "" UBYTE NO_COMPU_METHOD 0 0 0 255 ECU_ADDRESS 0xD0001687 FORMAT "%.15" /end MEASUREMENT
/begin MEASUREMENT BypassInput_135 "" UBYTE NO_COMPU_METHOD 0 0 0 255 ECU_ADDRESS 0xD0001688 FORMAT "%.15" /end MEASUREMENT
/begin MEASUREMENT BypassInput_136 "" FLOAT32_IEEE NO_COMPU_METHOD 0 0 -3.4e+038 3.4e+038 ECU_ADDRESS 0xD00010D8 FORMAT "%.15" /end MEASUREMENT
/begin MEASUREMENT BypassInput_137 "" UBYTE NO_COMPU_METHOD 0 0 0 255 ECU_ADDRESS 0xD0001689 FORMAT "%.15" /end MEASUREMENT
/begin MEASUREMENT BypassInput_138 "" UBYTE NO_COMPU_METHOD 0 0 0 255 ECU_ADDRESS 0xD000168A FORMAT "%.15" /end MEASUREMENT
/begin MEASUREMENT BypassInput_139 "" UWORD NO_COMPU_METHOD 0 0 0 65535 ECU_ADDRESS 0xD00010DC FORMAT "%.15" /end MEASUREMENT
/begin MEASUREMENT BypassInput_14 "" UBYTE NO_COMPU_METHOD 0 0 0 255 ECU_ADDRESS 0xD0001648 FORMAT "%.15" /end MEASUREMENT
/begin MEASUREMENT BypassInput_140 "" UBYTE NO_COMPU_METHOD 0 0 0 255 ECU_ADDRESS 0xD000168B FORMAT "%.15" /end MEASUREMENT
/begin MEASUREMENT BypassInput_141 "" UBYTE NO_COMPU_METHOD 0 0 0 255 ECU_ADDRESS 0xD000168C FORMAT "%.15" /end MEASUREMENT
/begin MEASUREMENT BypassInput_142 "" UBYTE NO_COMPU_METHOD 0 0 0 255 ECU_ADDRESS 0xD000168D FORMAT "%.15" /end MEASUREMENT
/begin MEASUREMENT BypassInput_143 "" UWORD NO_COMPU_METHOD 0 0 0 65535 ECU_ADDRESS 0xD00010DE FORMAT "%.15" /end MEASUREMENT
/begin MEASUREMENT BypassInput_144 "" FLOAT32_IEEE NO_COMPU_METHOD 0 0 -3.4e+038 3.4e+038 ECU_ADDRESS 0xD00010E0 FORMAT "%.15" /end MEASUREMENT
/begin MEASUREMENT BypassInput_145 "" UWORD NO_COMPU_METHOD 0 0 0 65535 ECU_ADDRESS 0xD00010E4 FORMAT "%.15" /end MEASUREMENT
/begin MEASUREMENT BypassInput_146 "" UBYTE NO_COMPU_METHOD 0 0 0 255 ECU_ADDRESS 0xD000168E FORMAT "%.15" /end MEASUREMENT
/begin MEASUREMENT BypassInput_147 "" FLOAT32_IEEE NO_COMPU_METHOD 0 0 -3.4e+038 3.4e+038 ECU_ADDRESS 0xD00010E6 FORMAT "%.15" /end MEASUREMENT
/begin MEASUREMENT BypassInput_148 "" FLOAT32_IEEE NO_COMPU_METHOD 0 0 -3.4e+038 3.4e+038 ECU_ADDRESS 0xD00010EA FORMAT "%.15" /end MEASUREMENT
/begin MEASUREMENT BypassInput_149 "" UWORD NO_COMPU_METHOD 0 0 0 65535 ECU_ADDRESS 0xD00010EE FORMAT "%.15" /end MEASUREMENT
/begin MEASUREMENT BypassInput_15 "" UBYTE NO_COMPU_METHOD 0 0 0 255 ECU_ADDRESS 0xD0001649 FORMAT "%.15" /end MEASUREMENT
/begin MEASUREMENT BypassInput_150 "" UBYTE NO_COMPU_METHOD 0 0 0 255 ECU_ADDRESS 0xD000168F FORMAT "%.15" /end MEASUREMENT
/begin MEASUREMENT BypassInput_151 "" UBYTE NO_COMPU_METHOD 0 0 0 255 ECU_ADDRESS 0xD0001690 FORMAT "%.15" /end MEASUREMENT
/begin MEASUREMENT BypassInput_152 "" UBYTE NO_COMPU_METHOD 0 0 0 255 ECU_ADDRESS 0xD0001691 FORMAT "%.15" /end MEASUREMENT
/begin MEASUREMENT BypassInput_153 "" UBYTE NO_COMPU_METHOD 0 0 0 255 ECU_ADDRESS 0xD0001692 FORMAT "%.15" /end MEASUREMENT
/begin MEASUREMENT BypassInput_154 "" FLOAT32_IEEE NO_COMPU_METHOD 0 0 -3.4e+038 3.4e+038 ECU_ADDRESS 0xD00010F0 FORMAT "%.15" /end MEASUREMENT
/begin MEASUREMENT BypassInput_155 "" UBYTE NO_COMPU_METHOD 0 0 0 255 ECU_ADDRESS 0xD0001693 FORMAT "%.15" /end MEASUREMENT
/begin MEASUREMENT BypassInput_156 "" UBYTE NO_COMPU_METHOD 0 0 0 255 ECU_ADDRESS 0xD0001694 FORMAT "%.15" /end MEASUREMENT
/begin MEASUREMENT BypassInput_157 "" UBYTE NO_COMPU_METHOD 0 0 0 255 ECU_ADDRESS 0xD0001695 FORMAT "%.15" /end MEASUREMENT
/begin MEASUREMENT BypassInput_158 "" UBYTE NO_COMPU_METHOD 0 0 0 255 ECU_ADDRESS 0xD0001696 FORMAT "%.15" /end MEASUREMENT
/begin MEASUREMENT BypassInput_159 "" UWORD NO_COMPU_METHOD 0 0 0 65535 ECU_ADDRESS 0xD00010F4 FORMAT "%.15" /end MEASUREMENT
/begin MEASUREMENT BypassInput_16 "" UBYTE NO_COMPU_METHOD 0 0 0 255 ECU_ADDRESS 0xD000164A FORMAT "%.15" /end MEASUREMENT
/begin MEASUREMENT BypassInput_160 "" UBYTE NO_COMPU_METHOD 0 0 0 255 ECU_ADDRESS 0xD0001697 FORMAT "%.15" /end MEASUREMENT
/begin MEASUREMENT BypassInput_161 "" FLOAT32_IEEE NO_COMPU_METHOD 0 0 -3.4e+038 3.4e+038 ECU_ADDRESS 0xD00010F6 FORMAT "%.15" /end MEASUREMENT
/begin MEASUREMENT BypassInput_162 "" UWORD NO_COMPU_METHOD 0 0 0 65535 ECU_ADDRESS 0xD00010FA FORMAT "%.15" /end MEASUREMENT
/begin MEASUREMENT BypassInput_163 "" UBYTE NO_COMPU_METHOD 0 0 0 255 ECU_ADDRESS 0xD0001698 FORMAT "%.15" /end MEASUREMENT
/begin MEASUREMENT BypassInput_164 "" FLOAT32_IEEE NO_COMPU_METHOD 0 0 -3.4e+038 3.4e+038 ECU_ADDRESS 0xD00010FC FORMAT "%.15" /end MEASUREMENT
/begin MEASUREMENT BypassInput_165 "" UBYTE NO_COMPU_METHOD 0 0 0 255 ECU_ADDRESS 0xD0001699 FORMAT "%.15" /end MEASUREMENT
/begin MEASUREMENT BypassInput_166 "" UWORD NO_COMPU_METHOD 0 0 0 65535 ECU_ADDRESS 0xD0001100 FORMAT "%.15" /end MEASUREMENT
/begin MEASUREMENT BypassInput_167 "" UBYTE NO_COMPU_METHOD 0 0 0 255 ECU_ADDRESS 0xD000169A FORMAT "%.15" /end MEASUREMENT
/begin MEASUREMENT BypassInput_168 "" UBYTE NO_COMPU_METHOD 0 0 0 255 ECU_ADDRESS 0xD000169B FORMAT "%.15" /end MEASUREMENT
/begin MEASUREMENT BypassInput_169 "" UBYTE NO_COMPU_METHOD 0 0 0 255 ECU_ADDRESS 0xD000169C FORMAT "%.15" /end MEASUREMENT
/begin MEASUREMENT BypassInput_17 "" UBYTE NO_COMPU_METHOD 0 0 0 255 ECU_ADDRESS 0xD000164B FORMAT "%.15" /end MEASUREMENT
/begin MEASUREMENT BypassInput_170 "" UBYTE NO_COMPU_METHOD 0 0 0 255 ECU_ADDRESS 0xD000169D FORMAT "%.15" /end MEASUREMENT
/begin MEASUREMENT BypassInput_171 "" FLOAT32_IEEE NO_COMPU_METHOD 0 0 -3.4e+038 3.4e+038 ECU_ADDRESS 0xD0001102 FORMAT "%.15" /end MEASUREMENT
/begin MEASUREMENT BypassInput_172 "" FLOAT32_IEEE NO_COMPU_METHOD 0 0 -3.4e+038 3.4e+038 ECU_ADDRESS 0xD0001106 FORMAT "%.15" /end MEASUREMENT
/begin MEASUREMENT BypassInput_173 "" UBYTE NO_COMPU_METHOD 0 0 0 255 ECU_ADDRESS 0xD000169E FORMAT "%.15" /end MEASUREMENT
/begin MEASUREMENT BypassInput_174 "" UBYTE NO_COMPU_METHOD 0 0 0 255 ECU_ADDRESS 0xD000169F FORMAT "%.15" /end MEASUREMENT
/begin MEASUREMENT BypassInput_175 "" UWORD NO_COMPU_METHOD 0 0 0 65535 ECU_ADDRESS 0xD000110A FORMAT "%.15" /end MEASUREMENT
/begin MEASUREMENT BypassInput_176 "" UBYTE NO_COMPU_METHOD 0 0 0 255 ECU_ADDRESS 0xD00016A0 FORMAT "%.15" /end MEASUREMENT
/begin MEASUREMENT BypassInput_177 "" UWORD NO_COMPU_METHOD 0 0 0 65535 ECU_ADDRESS 0xD000110C FORMAT "%.15" /end MEASUREMENT
/begin MEASUREMENT BypassInput_178 "" UBYTE NO_COMPU_METHOD 0 0 0 255 ECU_ADDRESS 0xD00016A1 FORMAT "%.15" /end MEASUREMENT
/begin MEASUREMENT BypassInput_179 "" UBYTE NO_COMPU_METHOD 0 0 0 255 ECU_ADDRESS 0xD00016A2 FORMAT "%.15" /end MEASUREMENT
/begin MEASUREMENT BypassInput_18 "" UBYTE NO_COMPU_METHOD 0 0 0 255 ECU_ADDRESS 0xD000164C FORMAT "%.15" /end MEASUREMENT
/begin MEASUREMENT BypassInput_180 "" UBYTE NO_COMPU_METHOD 0 0 0 255 ECU_ADDRESS 0xD00016A3 FORMAT "%.15" /end MEASUREMENT
/begin MEASUREMENT BypassInput_181 "" UBYTE NO_COMPU_METHOD 0 0 0 255 ECU_ADDRESS 0xD00016A4 FORMAT "%.15" /end MEASUREMENT
/begin MEASUREMENT BypassInput_182 "" UBYTE NO_COMPU_METHOD 0 0 0 255 ECU_ADDRESS 0xD00016A5 FORMAT "%.15" /end MEASUREMENT
/begin MEASUREMENT BypassInput_183 "" UBYTE NO_COMPU_METHOD 0 0 0 255 ECU_ADDRESS 0xD00016A6 FORMAT "%.15" /end MEASUREMENT
/begin MEASUREMENT BypassInput_184 "" FLOAT32_IEEE NO_COMPU_METHOD 0 0 -3.4e+038 3.4e+038 ECU_ADDRESS 0xD000110E FORMAT "%.15" /end MEASUREMENT
/begin MEASUREMENT BypassInput_185 "" UBYTE NO_COMPU_METHOD 0 0 0 255 ECU_ADDRESS 0xD00016A7 FORMAT "%.15" /end MEASUREMENT
/begin MEASUREMENT BypassInput_186 "" UBYTE NO_COMPU_METHOD 0 0 0 255 ECU_ADDRESS 0xD00016A8 FORMAT "%.15" /end MEASUREMENT
/begin MEASUREMENT BypassInput_187 "" UBYTE NO_COMPU_METHOD 0 0 0 255 ECU_ADDRESS 0xD00016A9 FORMAT "%.15" /end MEASUREMENT
/begin MEASUREMENT BypassInput_188 "" UWORD NO_COMPU_METHOD 0 0 0 65535 ECU_ADDRESS 0xD0001112 FORMAT "%.15" /end MEASUREMENT
/begin MEASUREMENT BypassInput_189 "" FLOAT32_IEEE NO_COMPU_METHOD 0 0 -3.4e+038 3.4e+038 ECU_ADDRESS 0xD0001114 FORMAT "%.15" /end MEASUREMENT
/begin MEASUREMENT BypassInput_19 "" UWORD NO_COMPU_METHOD 0 0 0 65535 ECU_ADDRESS 0xD000102E FORMAT "%.15" /end MEASUREMENT
/begin MEASUREMENT BypassInput_190 "" UBYTE NO_COMPU_METHOD 0 0 0 255 ECU_ADDRESS 0xD00016AA FORMAT "%.15" /end MEASUREMENT
/begin MEASUREMENT BypassInput_191 "" UBYTE NO_COMPU_METHOD 0 0 0 255 ECU_ADDRESS 0xD00016AB FORMAT "%.15" /end MEASUREMENT
/begin MEASUREMENT BypassInput_192 "" UBYTE NO_COMPU_METHOD 0 0 0 255 ECU_ADDRESS 0xD00016AC FORMAT "%.15" /end MEASUREMENT
/begin MEASUREMENT BypassInput_193 "" FLOAT32_IEEE NO_COMPU_METHOD 0 0 -3.4e+038 3.4e+038 ECU_ADDRESS 0xD0001118 FORMAT "%.15" /end MEASUREMENT
/begin MEASUREMENT BypassInput_194 "" FLOAT32_IEEE NO_COMPU_METHOD 0 0 -3.4e+038 3.4e+038 ECU_ADDRESS 0xD000111C FORMAT "%.15" /end MEASUREMENT
/begin MEASUREMENT BypassInput_195 "" UBYTE NO_COMPU_METHOD 0 0 0 255 ECU_ADDRESS 0xD00016AD FORMAT "%.15" /end MEASUREMENT
/begin MEASUREMENT BypassInput_196 "" UWORD NO_COMPU_METHOD 0 0 0 65535 ECU_ADDRESS 0xD0001120 FORMAT "%.15" /end MEASUREMENT
/begin MEASUREMENT BypassInput_197 "" FLOAT32_IEEE NO_COMPU_METHOD 0 0 -3.4e+038 3.4e+038 ECU_ADDRESS 0xD0001122 FORMAT "%.15" /end MEASUREMENT
/begin MEASUREMENT BypassInput_198 "" UBYTE NO_COMPU_METHOD 0 0 0 255 ECU_ADDRESS 0xD00016AE FORMAT "%.15" /end MEASUREMENT
/begin MEASUREMENT BypassInput_199 "" FLOAT32_IEEE NO_COMPU_METHOD 0 0 -3.4e+038 3.4e+038 ECU_ADDRESS 0xD0001126 FORMAT "%.15" /end MEASUREMENT
/begin MEASUREMENT BypassInput_2 "" UWORD NO_COMPU_METHOD 0 0 0 65535 ECU_ADDRESS 0xD0001018 FORMAT "%.15" /end MEASUREMENT
/begin MEASUREMENT BypassInput_20 "" UBYTE NO_COMPU_METHOD 0 0 0 255 ECU_ADDRESS 0xD000164D FORMAT "%.15" /end MEASUREMENT
/begin MEASUREMENT BypassInput_200 "" UBYTE NO_COMPU_METHOD 0 0 0 255 ECU_ADDRESS 0xD00016AF FORMAT "%.15" /end MEASUREMENT
/begin MEASUREMENT BypassInput_201 "" UWORD NO_COMPU_METHOD 0 0 0 65535 ECU_ADDRESS 0xD000112A FORMAT "%.15" /end MEASUREMENT
/begin MEASUREMENT BypassInput_202 "" FLOAT32_IEEE NO_COMPU_METHOD 0 0 -3.4e+038 3.4e+038 ECU_ADDRESS 0xD000112C FORMAT "%.15" /end MEASUREMENT
/begin MEASUREMENT BypassInput_203 "" UBYTE NO_COMPU_METHOD 0 0 0 255 ECU_ADDRESS 0xD00016B0 FORMAT "%.15" /end MEASUREMENT
/begin MEASUREMENT BypassInput_204 "" FLOAT32_IEEE NO_COMPU_METHOD 0 0 -3.4e+038 3.4e+038 ECU_ADDRESS 0xD0001130 FORMAT "%.15" /end MEASUREMENT
/begin MEASUREMENT BypassInput_205 "" FLOAT32_IEEE NO_COMPU_METHOD 0 0 -3.4e+038 3.4e+038 ECU_ADDRESS 0xD0001134 FORMAT "%.15" /end MEASUREMENT
/begin MEASUREMENT BypassInput_206 "" UWORD NO_COMPU_METHOD 0 0 0 65535 ECU_ADDRESS 0xD0001138 FORMAT "%.15" /end MEASUREMENT
/begin MEASUREMENT BypassInput_207 "" FLOAT32_IEEE NO_COMPU_METHOD 0 0 -3.4e+038 3.4e+038 ECU_ADDRESS 0xD000113A FORMAT "%.15" /end MEASUREMENT
/begin MEASUREMENT BypassInput_208 "" UBYTE NO_COMPU_METHOD 0 0 0 255 ECU_ADDRESS 0xD00016B1 FORMAT "%.15" /end MEASUREMENT
/begin MEASUREMENT BypassInput_209 "" UWORD NO_COMPU_METHOD 0 0 0 65535 ECU_ADDRESS 0xD000113E FORMAT "%.15" /end MEASUREMENT
/begin MEASUREMENT BypassInput_21 "" UBYTE NO_COMPU_METHOD 0 0 0 255 ECU_ADDRESS 0xD000164E FORMAT "%.15" /end MEASUREMENT
/begin MEASUREMENT BypassInput_210 "" UBYTE NO_COMPU_METHOD 0 0 0 255 ECU_ADDRESS 0xD00016B2 FORMAT "%.15" /end MEASUREMENT
/begin MEASUREMENT BypassInput_211 "" UWORD NO_COMPU_METHOD 0 0 0 65535 ECU_ADDRESS 0xD0001140 FORMAT "%.15" /end MEASUREMENT
/begin MEASUREMENT BypassInput_212 "" UBYTE NO_COMPU_METHOD 0 0 0 255 ECU_ADDRESS 0xD00016B3 FORMAT "%.15" /end MEASUREMENT
/begin MEASUREMENT BypassInput_213 "" UBYTE NO_COMPU_METHOD 0 0 0 255 ECU_ADDRESS 0xD00016B4 FORMAT "%.15" /end MEASUREMENT
/begin MEASUREMENT BypassInput_214 "" FLOAT32_IEEE NO_COMPU_METHOD 0 0 -3.4e+038 3.4e+038 ECU_ADDRESS 0xD0001142 FORMAT "%.15" /end MEASUREMENT
/begin MEASUREMENT BypassInput_215 "" UBYTE NO_COMPU_METHOD 0 0 0 255 ECU_ADDRESS 0xD00016B5 FORMAT "%.15" /end MEASUREMENT
/begin MEASUREMENT BypassInput_216 "" FLOAT32_IEEE NO_COMPU_METHOD 0 0 -3.4e+038 3.4e+038 ECU_ADDRESS 0xD0001146 FORMAT "%.15" /end MEASUREMENT
/begin MEASUREMENT BypassInput_217 "" UBYTE NO_COMPU_METHOD 0 0 0 255 ECU_ADDRESS 0xD00016B6 FORMAT "%.15" /end MEASUREMENT
/begin MEASUREMENT BypassInput_218 "" FLOAT32_IEEE NO_COMPU_METHOD 0 0 -3.4e+038 3.4e+038 ECU_ADDRESS 0xD000114A FORMAT "%.15" /end MEASUREMENT
/begin MEASUREMENT BypassInput_219 "" UWORD NO_COMPU_METHOD 0 0 0 65535 ECU_ADDRESS 0xD000114E FORMAT "%.15" /end MEASUREMENT
/begin MEASUREMENT BypassInput_22 "" UWORD NO_COMPU_METHOD 0 0 0 65535 ECU_ADDRESS 0xD0001030 FORMAT "%.15" /end MEASUREMENT
/begin MEASUREMENT BypassInput_220 "" UWORD NO_COMPU_METHOD 0 0 0 65535 ECU_ADDRESS 0xD0001150 FORMAT "%.15" /end MEASUREMENT
/begin MEASUREMENT BypassInput_221 "" FLOAT32_IEEE NO_COMPU_METHOD 0 0 -3.4e+038 3.4e+038 ECU_ADDRESS 0xD0001152 FORMAT "%.15" /end MEASUREMENT
/begin MEASUREMENT BypassInput_222 "" UBYTE NO_COMPU_METHOD 0 0 0 255 ECU_ADDRESS 0xD00016B7 FORMAT "%.15" /end MEASUREMENT
/begin MEASUREMENT BypassInput_223 "" FLOAT32_IEEE NO_COMPU_METHOD 0 0 -3.4e+038 3.4e+038 ECU_ADDRESS 0xD0001156 FORMAT "%.15" /end MEASUREMENT
/begin MEASUREMENT BypassInput_224 "" UBYTE NO_COMPU_METHOD 0 0 0 255 ECU_ADDRESS 0xD00016B8 FORMAT "%.15" /end MEASUREMENT
/begin MEASUREMENT BypassInput_225 "" UBYTE NO_COMPU_METHOD 0 0 0 255 ECU_ADDRESS 0xD00016B9 FORMAT "%.15" /end MEASUREMENT
/begin MEASUREMENT BypassInput_226 "" FLOAT32_IEEE NO_COMPU_METHOD 0 0 -3.4e+038 3.4e+038 ECU_ADDRESS 0xD000115A FORMAT "%.15" /end MEASUREMENT
/begin MEASUREMENT BypassInput_227 "" UBYTE NO_COMPU_METHOD 0 0 0 255 ECU_ADDRESS 0xD00016BA FORMAT "%.15" /end MEASUREMENT
/begin MEASUREMENT BypassInput_228 "" UWORD NO_COMPU_METHOD 0 0 0 65535 ECU_ADDRESS 0xD000115E FORMAT "%.15" /end MEASUREMENT
/begin MEASUREMENT BypassInput_229 "" UBYTE NO_COMPU_METHOD 0 0 0 255 ECU_ADDRESS 0xD00016BB FORMAT "%.15" /end MEASUREMENT
/begin MEASUREMENT BypassInput_23 "" FLOAT32_IEEE NO_COMPU_METHOD 0 0 -3.4e+038 3.4e+038 ECU_ADDRESS 0xD0001032 FORMAT "%.15" /end MEASUREMENT
/begin MEASUREMENT BypassInput_230 "" UBYTE NO_COMPU_METHOD 0 0 0 255 ECU_ADDRESS 0xD00016BC FORMAT "%.15" /end MEASUREMENT
/begin MEASUREMENT BypassInput_231 "" FLOAT32_IEEE NO_COMPU_METHOD 0 0 -3.4e+038 3.4e+038 ECU_ADDRESS 0xD0001160 FORMAT "%.15" /end MEASUREMENT
/begin MEASUREMENT BypassInput_232 "" UWORD NO_COMPU_METHOD 0 0 0 65535 ECU_ADDRESS 0xD0001164 FORMAT "%.15" /end MEASUREMENT
/begin MEASUREMENT BypassInput_233 "" UBYTE NO_COMPU_METHOD 0 0 0 255 ECU_ADDRESS 0xD00016BD FORMAT "%.15" /end MEASUREMENT
/begin MEASUREMENT BypassInput_234 "" UWORD NO_COMPU_METHOD 0 0 0 65535 ECU_ADDRESS 0xD0001166 FORMAT "%.15" /end MEASUREMENT
/begin MEASUREMENT BypassInput_235 "" FLOAT32_IEEE NO_COMPU_METHOD 0 0 -3.4e+038 3.4e+038 ECU_ADDRESS 0xD0001168 FORMAT "%.15" /end MEASUREMENT
/begin MEASUREMENT BypassInput_236 "" UBYTE NO_COMPU_METHOD 0 0 0 255 ECU_ADDRESS 0xD00016BE FORMAT "%.15" /end MEASUREMENT
/begin MEASUREMENT BypassInput_237 "" UWORD NO_COMPU_METHOD 0 0 0 65535 ECU_ADDRESS 0xD000116C FORMAT "%.15" /end MEASUREMENT
/begin MEASUREMENT BypassInput_238 "" UBYTE NO_COMPU_METHOD 0 0 0 255 ECU_ADDRESS 0xD00016BF FORMAT "%.15" /end MEASUREMENT
/begin MEASUREMENT BypassInput_239 "" UBYTE NO_COMPU_METHOD 0 0 0 255 ECU_ADDRESS 0xD00016C0 FORMAT "%.15" /end MEASUREMENT
/begin MEASUREMENT BypassInput_24 "" UWORD NO_COMPU_METHOD 0 0 0 65535 ECU_ADDRESS 0xD0001036 FORMAT "%.15" /end MEASUREMENT
/begin MEASUREMENT BypassInput_240 "" UBYTE NO_COMPU_METHOD 0 0 0 255 ECU_ADDRESS 0xD00016C1 FORMAT "%.15" /end MEASUREMENT
/begin MEASUREMENT BypassInput_241 "" FLOAT32_IEEE NO_COMPU_METHOD 0 0 -3.4e+038 3.4e+038 ECU_ADDRESS 0xD000116E FORMAT "%.15" /end MEASUREMENT
/begin MEASUREMENT BypassInput_242 "" UBYTE NO_COMPU_METHOD 0 0 0 255 ECU_ADDRESS 0xD00016C2 FORMAT "%.15" /end MEASUREMENT
/begin MEASUREMENT BypassInput_243 "" UWORD NO_COMPU_METHOD 0 0 0 65535 ECU_ADDRESS 0xD0001172 FORMAT "%.15" /end MEASUREMENT
/begin MEASUREMENT BypassInput_244 "" UBYTE NO_COMPU_METHOD 0 0 0 255 ECU_ADDRESS 0xD00016C3 FORMAT "%.15" /end MEASUREMENT
/begin MEASUREMENT BypassInput_245 "" UWORD NO_COMPU_METHOD 0 0 0 65535 ECU_ADDRESS 0xD0001174 FORMAT "%.15" /end MEASUREMENT
/begin MEASUREMENT BypassInput_246 "" UWORD NO_COMPU_METHOD 0 0 0 65535 ECU_ADDRESS 0xD0001176 FORMAT "%.15" /end MEASUREMENT
/begin MEASUREMENT BypassInput_247 "" UBYTE NO_COMPU_METHOD 0 0 0 255 ECU_ADDRESS 0xD00016C4 FORMAT "%.15" /end MEASUREMENT
/begin MEASUREMENT BypassInput_248 "" UBYTE NO_COMPU_METHOD 0 0 0 255 ECU_ADDRESS 0xD00016C5 FORMAT "%.15" /end MEASUREMENT
/begin MEASUREMENT BypassInput_249 "" FLOAT32_IEEE NO_COMPU_METHOD 0 0 -3.4e+038 3.4e+038 ECU_ADDRESS 0xD0001178 FORMAT "%.15" /end MEASUREMENT
/begin MEASUREMENT BypassInput_25 "" UBYTE NO_COMPU_METHOD 0 0 0 255 ECU_ADDRESS 0xD000164F FORMAT "%.15" /end MEASUREMENT
/begin MEASUREMENT BypassInput_250 "" UBYTE NO_COMPU_METHOD 0 0 0 255 ECU_ADDRESS 0xD00016C6 FORMAT "%.15" /end MEASUREMENT
/begin MEASUREMENT BypassInput_251 "" UBYTE NO_COMPU_METHOD 0 0 0 255 ECU_ADDRESS 0xD00016C7 FORMAT "%.15" /end MEASUREMENT
/begin MEASUREMENT BypassInput_252 "" FLOAT32_IEEE NO_COMPU_METHOD 0 0 -3.4e+038 3.4e+038 ECU_ADDRESS 0xD000117C FORMAT "%.15" /end MEASUREMENT
/begin MEASUREMENT BypassInput_253 "" UWORD NO_COMPU_METHOD 0 0 0 65535 ECU_ADDRESS 0xD0001180 FORMAT "%.15" /end MEASUREMENT
/begin MEASUREMENT BypassInput_254 "" FLOAT32_IEEE NO_COMPU_METHOD 0 0 -3.4e+038 3.4e+038 ECU_ADDRESS 0xD0001182 FORMAT "%.15" /end MEASUREMENT
/begin MEASUREMENT BypassInput_255 "" UWORD NO_COMPU_METHOD 0 0 0 65535 ECU_ADDRESS 0xD0001186 FORMAT "%.15" /end MEASUREMENT
/begin MEASUREMENT BypassInput_256 "" UBYTE NO_COMPU_METHOD 0 0 0 255 ECU_ADDRESS 0xD00016C8 FORMAT "%.15" /end MEASUREMENT
/begin MEASUREMENT BypassInput_257 "" UWORD NO_COMPU_METHOD 0 0 0 65535 ECU_ADDRESS 0xD0001188 FORMAT "%.15" /end MEASUREMENT
/begin MEASUREMENT BypassInput_258 "" UWORD NO_COMPU_METHOD 0 0 0 65535 ECU_ADDRESS 0xD000118A FORMAT "%.15" /end MEASUREMENT
/begin MEASUREMENT BypassInput_259 "" UBYTE NO_COMPU_METHOD 0 0 0 255 ECU_ADDRESS 0xD00016C9 FORMAT "%.15" /end MEASUREMENT
/begin MEASUREMENT BypassInput_26 "" UBYTE NO_COMPU_METHOD 0 0 0 255 ECU_ADDRESS 0xD0001650 FORMAT "%.15" /end MEASUREMENT
/begin MEASUREMENT BypassInput_260 "" FLOAT32_IEEE NO_COMPU_METHOD 0 0 -3.4e+038 3.4e+038 ECU_ADDRESS 0xD000118C FORMAT "%.15" /end MEASUREMENT
/begin MEASUREMENT BypassInput_261 "" UBYTE NO_COMPU_METHOD 0 0 0 255 ECU_ADDRESS 0xD00016CA FORMAT "%.15" /end MEASUREMENT
/begin MEASUREMENT BypassInput_262 "" FLOAT32_IEEE NO_COMPU_METHOD 0 0 -3.4e+038 3.4e+038 ECU_ADDRESS 0xD0001190 FORMAT "%.15" /end MEASUREMENT
/begin MEASUREMENT BypassInput_263 "" UBYTE NO_COMPU_METHOD 0 0 0 255 ECU_ADDRESS 0xD00016CB FORMAT "%.15" /end MEASUREMENT
/begin MEASUREMENT BypassInput_264 "" UWORD NO_COMPU_METHOD 0 0 0 65535 ECU_ADDRESS 0xD0001194 FORMAT "%.15" /end MEASUREMENT
/begin MEASUREMENT BypassInput_265 "" FLOAT32_IEEE NO_COMPU_METHOD 0 0 -3.4e+038 3.4e+038 ECU_ADDRESS 0xD0001196 FORMAT "%.15" /end MEASUREMENT
/begin MEASUREMENT BypassInput_266 "" UWORD NO_COMPU_METHOD 0 0 0 65535 ECU_ADDRESS 0xD000119A FORMAT "%.15" /end MEASUREMENT
/begin MEASUREMENT BypassInput_267 "" UBYTE NO_COMPU_METHOD 0 0 0 255 ECU_ADDRESS 0xD00016CC FORMAT "%.15" /end MEASUREMENT
/begin MEASUREMENT BypassInput_268 "" UWORD NO_COMPU_METHOD 0 0 0 65535 ECU_ADDRESS 0xD000119C FORMAT "%.15" /end MEASUREMENT
/begin MEASUREMENT BypassInput_269 "" FLOAT32_IEEE NO_COMPU_METHOD 0 0 -3.4e+038 3.4e+038 ECU_ADDRESS 0xD000119E FORMAT "%.15" /end MEASUREMENT
/begin MEASUREMENT BypassInput_27 "" UBYTE NO_COMPU_METHOD 0 0 0 255 ECU_ADDRESS 0xD0001651 FORMAT "%.15" /end MEASUREMENT
/begin MEASUREMENT BypassInput_270 "" UWORD NO_COMPU_METHOD 0 0 0 65535 ECU_ADDRESS 0xD00011A2 FORMAT "%.15" /end MEASUREMENT
/begin MEASUREMENT BypassInput_271 "" UWORD NO_COMPU_METHOD 0 0 0 65535 ECU_ADDRESS 0xD00011A4 FORMAT "%.15" /end MEASUREMENT
/begin MEASUREMENT BypassInput_272 "" FLOAT32_IEEE NO_COMPU_METHOD 0 0 -3.4e+038 3.4e+038 ECU_ADDRESS 0xD00011A6 FORMAT "%.15" /end MEASUREMENT
/begin MEASUREMENT BypassInput_273 "" FLOAT32_IEEE NO_COMPU_METHOD 0 0 -3.4e+038 3.4e+038 ECU_ADDRESS 0xD00011AA FORMAT "%.15" /end MEASUREMENT
/begin MEASUREMENT BypassInput_274 "" UBYTE NO_COMPU_METHOD 0 0 0 255 ECU_ADDRESS 0xD00016CD FORMAT "%.15" /end MEASUREMENT
/begin MEASUREMENT BypassInput_275 "" FLOAT32_IEEE NO_COMPU_METHOD 0 0 -3.4e+038 3.4e+038 ECU_ADDRESS 0xD00011AE FORMAT "%.15" /end MEASUREMENT
/begin MEASUREMENT BypassInput_276 "" UWORD NO_COMPU_METHOD 0 0 0 65535 ECU_ADDRESS 0xD00011B2 FORMAT "%.15" /end MEASUREMENT
/begin MEASUREMENT BypassInput_277 "" UWORD NO_COMPU_METHOD 0 0 0 65535 ECU_ADDRESS 0xD00011B4 FORMAT "%.15" /end MEASUREMENT
/begin MEASUREMENT BypassInput_278 "" UBYTE NO_COMPU_METHOD 0 0 0 255 ECU_ADDRESS 0xD00016CE FORMAT "%.15" /end MEASUREMENT
/begin MEASUREMENT BypassInput_279 "" UBYTE NO_COMPU_METHOD 0 0 0 255 ECU_ADDRESS 0xD00016CF FORMAT "%.15" /end MEASUREMENT
/begin MEASUREMENT BypassInput_28 "" UBYTE NO_COMPU_METHOD 0 0 0 255 ECU_ADDRESS 0xD0001652 FORMAT "%.15" /end MEASUREMENT
/begin MEASUREMENT BypassInput_280 "" UBYTE NO_COMPU_METHOD 0 0 0 255 ECU_ADDRESS 0xD00016D0 FORMAT "%.15" /end MEASUREMENT
/begin MEASUREMENT BypassInput_281 "" UBYTE NO_COMPU_METHOD 0 0 0 255 ECU_ADDRESS 0xD00016D1 FORMAT "%.15" /end MEASUREMENT
/begin MEASUREMENT BypassInput_282 "" UBYTE NO_COMPU_METHOD 0 0 0 255 ECU_ADDRESS 0xD00016D2 FORMAT "%.15" /end MEASUREMENT
/begin MEASUREMENT BypassInput_283 "" UWORD NO_COMPU_METHOD 0 0 0 65535 ECU_ADDRESS 0xD00011B6 FORMAT "%.15" /end MEASUREMENT
/begin MEASUREMENT BypassInput_284 "" FLOAT32_IEEE NO_COMPU_METHOD 0 0 -3.4e+038 3.4e+038 ECU_ADDRESS 0xD00011B8 FORMAT "%.15" /end MEASUREMENT
/begin MEASUREMENT BypassInput_285 "" UBYTE NO_COMPU_METHOD 0 0 0 255 ECU_ADDRESS 0xD00016D3 FORMAT "%.15" /end MEASUREMENT
/begin MEASUREMENT BypassInput_286 "" FLOAT32_IEEE NO_COMPU_METHOD 0 0 -3.4e+038 3.4e+038 ECU_ADDRESS 0xD00011BC FORMAT "%.15" /end MEASUREMENT
/begin MEASUREMENT BypassInput_287 "" UWORD NO_COMPU_METHOD 0 0 0 65535 ECU_ADDRESS 0xD00011C0 FORMAT "%.15" /end MEASUREMENT
/begin MEASUREMENT BypassInput_288 "" UBYTE NO_COMPU_METHOD 0 0 0 255 ECU_ADDRESS 0xD00016D4 FORMAT "%.15" /end MEASUREMENT
/begin MEASUREMENT BypassInput_289 "" UWORD NO_COMPU_METHOD 0 0 0 65535 ECU_ADDRESS 0xD00011C2 FORMAT "%.15" /end MEASUREMENT
/begin MEASUREMENT BypassInput_29 "" FLOAT32_IEEE NO_COMPU_METHOD 0 0 -3.4e+038 3.4e+038 ECU_ADDRESS 0xD0001038 FORMAT "%.15" /end MEASUREMENT
/begin MEASUREMENT BypassInput_290 "" FLOAT32_IEEE NO_COMPU_METHOD 0 0 -3.4e+038 3.4e+038 ECU_ADDRESS 0xD00011C4 FORMAT "%.15" /end MEASUREMENT
/begin MEASUREMENT BypassInput_291 "" UWORD NO_COMPU_METHOD 0 0 0 65535 ECU_ADDRESS 0xD00011C8 FORMAT "%.15" /end MEASUREMENT
/begin MEASUREMENT BypassInput_292 "" UBYTE NO_COMPU_METHOD 0 0 0 255 ECU_ADDRESS 0xD00016D5 FORMAT "%.15" /end MEASUREMENT
/begin MEASUREMENT BypassInput_293 "" UBYTE NO_COMPU_METHOD 0 0 0 255 ECU_ADDRESS 0xD00016D6 FORMAT "%.15" /end MEASUREMENT
/begin MEASUREMENT BypassInput_294 "" FLOAT32_IEEE NO_COMPU_METHOD 0 0 -3.4e+038 3.4e+038 ECU_ADDRESS 0xD00011CA FORMAT "%.15" /end MEASUREMENT
/begin MEASUREMENT BypassInput_295 "" UBYTE NO_COMPU_METHOD 0 0 0 255 ECU_ADDRESS 0xD00016D7 FORMAT "%.15" /end MEASUREMENT
/begin MEASUREMENT BypassInput_296 "" UBYTE NO_COMPU_METHOD 0 0 0 255 ECU_ADDRESS 0xD00016D8 FORMAT "%.15" /end MEASUREMENT
/begin MEASUREMENT BypassInput_297 "" UBYTE NO_COMPU_METHOD 0 0 0 255 ECU_ADDRESS 0xD00016D9 FORMAT "%.15" /end MEASUREMENT
/begin MEASUREMENT BypassInput_298 "" UBYTE NO_COMPU_METHOD 0 0 0 255 ECU_ADDRESS 0xD00016DA FORMAT "%.15" /end MEASUREMENT
/begin MEASUREMENT BypassInput_299 "" UBYTE NO_COMPU_METHOD 0 0 0 255 ECU_ADDRESS 0xD00016DB FORMAT "%.15" /end MEASUREMENT
/begin MEASUREMENT BypassInput_3 "" UWORD NO_COMPU_METHOD 0 0 0 65535 ECU_ADDRESS 0xD000101A FORMAT "%.15" /end MEASUREMENT
/begin MEASUREMENT BypassInput_30 "" UBYTE NO_COMPU_METHOD 0 0 0 255 ECU_ADDRESS 0xD0001653 FORMAT "%.15" /end MEASUREMENT
/begin MEASUREMENT BypassInput_300 "" UBYTE NO_COMPU_METHOD 0 0 0 255 ECU_ADDRESS 0xD00016DC FORMAT "%.15" /end MEASUREMENT
/begin MEASUREMENT BypassInput_301 "" UBYTE NO_COMPU_METHOD 0 0 0 255 ECU_ADDRESS 0xD00016DD FORMAT "%.15" /end MEASUREMENT
/begin MEASUREMENT BypassInput_302 "" UWORD NO_COMPU_METHOD 0 0 0 65535 ECU_ADDRESS 0xD00011CE FORMAT "%.15" /end MEASUREMENT
/begin MEASUREMENT BypassInput_303 "" FLOAT32_IEEE NO_COMPU_METHOD 0 0 -3.4e+038 3.4e+038 ECU_ADDRESS 0xD00011D0 FORMAT "%.15" /end MEASUREMENT
/begin MEASUREMENT BypassInput_304 "" UWORD NO_COMPU_METHOD 0 0 0 65535 ECU_ADDRESS 0xD00011D4 FORMAT "%.15" /end MEASUREMENT
/begin MEASUREMENT BypassInput_305 "" FLOAT32_IEEE NO_COMPU_METHOD 0 0 -3.4e+038 3.4e+038 ECU_ADDRESS 0xD00011D6 FORMAT "%.15" /end MEASUREMENT
/begin MEASUREMENT BypassInput_306 "" UWORD NO_COMPU_METHOD 0 0 0 65535 ECU_ADDRESS 0xD00011DA FORMAT "%.15" /end MEASUREMENT
/begin MEASUREMENT BypassInput_307 "" UWORD NO_COMPU_METHOD 0 0 0 65535 ECU_ADDRESS 0xD00011DC FORMAT "%.15" /end MEASUREMENT
/begin MEASUREMENT BypassInput_308 "" UBYTE NO_COMPU_METHOD 0 0 0 255 ECU_ADDRESS 0xD00016DE FORMAT "%.15" /end MEASUREMENT
/begin MEASUREMENT BypassInput_309 "" UWORD NO_COMPU_METHOD 0 0 0 65535 ECU_ADDRESS 0xD00011DE FORMAT "%.15" /end MEASUREMENT
/begin MEASUREMENT BypassInput_31 "" UBYTE NO_COMPU_METHOD 0 0 0 255 ECU_ADDRESS 0xD0001654 FORMAT "%.15" /end MEASUREMENT
/begin MEASUREMENT BypassInput_310 "" FLOAT32_IEEE NO_COMPU_METHOD 0 0 -3.4e+038 3.4e+038 ECU_ADDRESS 0xD00011E0 FORMAT "%.15" /end MEASUREMENT
/begin MEASUREMENT BypassInput_311 "" UWORD NO_COMPU_METHOD 0 0 0 65535 ECU_ADDRESS 0xD00011E4 FORMAT "%.15" /end MEASUREMENT
/begin MEASUREMENT BypassInput_312 "" FLOAT32_IEEE NO_COMPU_METHOD 0 0 -3.4e+038 3.4e+038 ECU_ADDRESS 0xD00011E6 FORMAT "%.15" /end MEASUREMENT
/begin MEASUREMENT BypassInput_313 "" UWORD NO_COMPU_METHOD 0 0 0 65535 ECU_ADDRESS 0xD00011EA FORMAT "%.15" /end MEASUREMENT
/begin MEASUREMENT BypassInput_314 "" UBYTE NO_COMPU_METHOD 0 0 0 255 ECU_ADDRESS 0xD00016DF FORMAT "%.15" /end MEASUREMENT
/begin MEASUREMENT BypassInput_315 "" UWORD NO_COMPU_METHOD 0 0 0 65535 ECU_ADDRESS 0xD00011EC FORMAT "%.15" /end MEASUREMENT
/begin MEASUREMENT BypassInput_316 "" UWORD NO_COMPU_METHOD 0 0 0 65535 ECU_ADDRESS 0xD00011EE FORMAT "%.15" /end MEASUREMENT
/begin MEASUREMENT BypassInput_317 "" UWORD NO_COMPU_METHOD 0 0 0 65535 ECU_ADDRESS 0xD00011F0 FORMAT "%.15" /end MEASUREMENT
/begin MEASUREMENT BypassInput_318 "" UBYTE NO_COMPU_METHOD 0 0 0 255 ECU_ADDRESS 0xD00016E0 FORMAT "%.15" /end MEASUREMENT
/begin MEASUREMENT BypassInput_319 "" FLOAT32_IEEE NO_COMPU_METHOD 0 0 -3.4e+038 3.4e+038 ECU_ADDRESS 0xD00011F2 FORMAT "%.15" /end MEASUREMENT
/begin MEASUREMENT BypassInput_32 "" UBYTE NO_COMPU_METHOD 0 0 0 255 ECU_ADDRESS 0xD0001655 FORMAT "%.15" /end MEASUREMENT
/begin MEASUREMENT BypassInput_320 "" UBYTE NO_COMPU_METHOD 0 0 0 255 ECU_ADDRESS 0xD00016E1 FORMAT "%.15" /end MEASUREMENT
/begin MEASUREMENT BypassInput_321 "" UBYTE NO_COMPU_METHOD 0 0 0 255 ECU_ADDRESS 0xD00016E2 FORMAT "%.15" /end MEASUREMENT
/begin MEASUREMENT BypassInput_322 "" FLOAT32_IEEE NO_COMPU_METHOD 0 0 -3.4e+038 3.4e+038 ECU_ADDRESS 0xD00011F6 FORMAT "%.15" /end MEASUREMENT
/begin MEASUREMENT BypassInput_323 "" FLOAT32_IEEE NO_COMPU_METHOD 0 0 -3.4e+038 3.4e+038 ECU_ADDRESS 0xD00011FA FORMAT "%.15" /end MEASUREMENT
/begin MEASUREMENT BypassInput_324 "" FLOAT32_IEEE NO_COMPU_METHOD 0 0 -3.4e+038 3.4e+038 ECU_ADDRESS 0xD00011FE FORMAT "%.15" /end MEASUREMENT
/begin MEASUREMENT BypassInput_325 "" FLOAT32_IEEE NO_COMPU_METHOD 0 0 -3.4e+038 3.4e+038 ECU_ADDRESS 0xD0001202 FORMAT "%.15" /end MEASUREMENT
/begin MEASUREMENT BypassInput_326 "" UBYTE NO_COMPU_METHOD 0 0 0 255 ECU_ADDRESS 0xD00016E3 FORMAT "%.15" /end MEASUREMENT
/begin MEASUREMENT BypassInput_327 "" UBYTE NO_COMPU_METHOD 0 0 0 255 ECU_ADDRESS 0xD00016E4 FORMAT "%.15" /end MEASUREMENT
/begin MEASUREMENT BypassInput_328 "" UBYTE NO_COMPU_METHOD 0 0 0 255 ECU_ADDRESS 0xD00016E5 FORMAT "%.15" /end MEASUREMENT
/begin MEASUREMENT BypassInput_329 "" UBYTE NO_COMPU_METHOD 0 0 0 255 ECU_ADDRESS 0xD00016E6 FORMAT "%.15" /end MEASUREMENT
/begin MEASUREMENT BypassInput_33 "" UBYTE NO_COMPU_METHOD 0 0 0 255 ECU_ADDRESS 0xD0001656 FORMAT "%.15" /end MEASUREMENT
/begin MEASUREMENT BypassInput_330 "" UBYTE NO_COMPU_METHOD 0 0 0 255 ECU_ADDRESS 0xD00016E7 FORMAT "%.15" /end MEASUREMENT
/begin MEASUREMENT BypassInput_331 "" UBYTE NO_COMPU_METHOD 0 0 0 255 ECU_ADDRESS 0xD00016E8 FORMAT "%.15" /end MEASUREMENT
/begin MEASUREMENT BypassInput_332 "" FLOAT32_IEEE NO_COMPU_METHOD 0 0 -3.4e+038 3.4e+038 ECU_ADDRESS 0xD0001206 FORMAT "%.15" /end MEASUREMENT
/begin MEASUREMENT BypassInput_333 "" UBYTE NO_COMPU_METHOD 0 0 0 255 ECU_ADDRESS 0xD00016E9 FORMAT "%.15" /end MEASUREMENT
/begin MEASUREMENT BypassInput_334 "" UWORD NO_COMPU_METHOD 0 0 0 65535 ECU_ADDRESS 0xD000120A FORMAT "%.15" /end MEASUREMENT
/begin MEASUREMENT BypassInput_335 "" FLOAT32_IEEE NO_COMPU_METHOD 0 0 -3.4e+038 3.4e+038 ECU_ADDRESS 0xD000120C FORMAT "%.15" /end MEASUREMENT
/begin MEASUREMENT BypassInput_336 "" UBYTE NO_COMPU_METHOD 0 0 0 255 ECU_ADDRESS 0xD00016EA FORMAT "%.15" /end MEASUREMENT
/begin MEASUREMENT BypassInput_337 "" FLOAT32_IEEE NO_COMPU_METHOD 0 0 -3.4e+038 3.4e+038 ECU_ADDRESS 0xD0001210 FORMAT "%.15" /end MEASUREMENT
/begin MEASUREMENT BypassInput_338 "" UBYTE NO_COMPU_METHOD 0 0 0 255 ECU_ADDRESS 0xD00016EB FORMAT "%.15" /end MEASUREMENT
/begin MEASUREMENT BypassInput_339 "" UBYTE NO_COMPU_METHOD 0 0 0 255 ECU_ADDRESS 0xD00016EC FORMAT "%.15" /end MEASUREMENT
/begin MEASUREMENT BypassInput_34 "" UWORD NO_COMPU_METHOD 0 0 0 65535 ECU_ADDRESS 0xD000103C FORMAT "%.15" /end MEASUREMENT
/begin MEASUREMENT BypassInput_340 "" UBYTE NO_COMPU_METHOD 0 0 0 255 ECU_ADDRESS 0xD00016ED FORMAT "%.15" /end MEASUREMENT
/begin MEASUREMENT BypassInput_341 "" UWORD NO_COMPU_METHOD 0 0 0 65535 ECU_ADDRESS 0xD0001214 FORMAT "%.15" /end MEASUREMENT
/begin MEASUREMENT BypassInput_342 "" FLOAT32_IEEE NO_COMPU_METHOD 0 0 -3.4e+038 3.4e+038 ECU_ADDRESS 0xD0001216 FORMAT "%.15" /end MEASUREMENT
/begin MEASUREMENT BypassInput_343 "" FLOAT32_IEEE NO_COMPU_METHOD 0 0 -3.4e+038 3.4e+038 ECU_ADDRESS 0xD000121A FORMAT "%.15" /end MEASUREMENT
/begin MEASUREMENT BypassInput_344 "" UWORD NO_COMPU_METHOD 0 0 0 65535 ECU_ADDRESS 0xD000121E FORMAT "%.15" /end MEASUREMENT
/begin MEASUREMENT BypassInput_345 "" UWORD NO_COMPU_METHOD 0 0 0 65535 ECU_ADDRESS 0xD0001220 FORMAT "%.15" /end MEASUREMENT
/begin MEASUREMENT BypassInput_346 "" FLOAT32_IEEE NO_COMPU_METHOD 0 0 -3.4e+038 3.4e+038 ECU_ADDRESS 0xD0001222 FORMAT "%.15" /end MEASUREMENT
/begin MEASUREMENT BypassInput_347 "" FLOAT32_IEEE NO_COMPU_METHOD 0 0 -3.4e+038 3.4e+038 ECU_ADDRESS 0xD0001226 FORMAT "%.15" /end MEASUREMENT
/begin MEASUREMENT BypassInput_348 "" FLOAT32_IEEE NO_COMPU_METHOD 0 0 -3.4e+038 3.4e+038 ECU_ADDRESS 0xD000122A FORMAT "%.15" /end MEASUREMENT
/begin MEASUREMENT BypassInput_349 "" UBYTE NO_COMPU_METHOD 0 0 0 255 ECU_ADDRESS 0xD00016EE FORMAT "%.15" /end MEASUREMENT
/begin MEASUREMENT BypassInput_35 "" UWORD NO_COMPU_METHOD 0 0 0 65535 ECU_ADDRESS 0xD000103E FORMAT "%.15" /end MEASUREMENT
/begin MEASUREMENT BypassInput_350 "" FLOAT32_IEEE NO_COMPU_METHOD 0 0 -3.4e+038 3.4e+038 ECU_ADDRESS 0xD000122E FORMAT "%.15" /end MEASUREMENT
/begin MEASUREMENT BypassInput_351 "" UWORD NO_COMPU_METHOD 0 0 0 65535 ECU_ADDRESS 0xD0001232 FORMAT "%.15" /end MEASUREMENT
/begin MEASUREMENT BypassInput_352 "" UBYTE NO_COMPU_METHOD 0 0 0 255 ECU_ADDRESS 0xD00016EF FORMAT "%.15" /end MEASUREMENT
/begin MEASUREMENT BypassInput_353 "" UWORD NO_COMPU_METHOD 0 0 0 65535 ECU_ADDRESS 0xD0001234 FORMAT "%.15" /end MEASUREMENT
/begin MEASUREMENT BypassInput_354 "" FLOAT32_IEEE NO_COMPU_METHOD 0 0 -3.4e+038 3.4e+038 ECU_ADDRESS 0xD0001236 FORMAT "%.15" /end MEASUREMENT
/begin MEASUREMENT BypassInput_355 "" UWORD NO_COMPU_METHOD 0 0 0 65535 ECU_ADDRESS 0xD000123A FORMAT "%.15" /end MEASUREMENT
/begin MEASUREMENT BypassInput_356 "" UBYTE NO_COMPU_METHOD 0 0 0 255 ECU_ADDRESS 0xD00016F0 FORMAT "%.15" /end MEASUREMENT
/begin MEASUREMENT BypassInput_357 "" UBYTE NO_COMPU_METHOD 0 0 0 255 ECU_ADDRESS 0xD00016F1 FORMAT "%.15" /end MEASUREMENT
/begin MEASUREMENT BypassInput_358 "" UBYTE NO_COMPU_METHOD 0 0 0 255 ECU_ADDRESS 0xD00016F2 FORMAT "%.15" /end MEASUREMENT
/begin MEASUREMENT BypassInput_359 "" FLOAT32_IEEE NO_COMPU_METHOD 0 0 -3.4e+038 3.4e+038 ECU_ADDRESS 0xD000123C FORMAT "%.15" /end MEASUREMENT
/begin MEASUREMENT BypassInput_36 "" FLOAT32_IEEE NO_COMPU_METHOD 0 0 -3.4e+038 3.4e+038 ECU_ADDRESS 0xD0001040 FORMAT "%.15" /end MEASUREMENT
/begin MEASUREMENT BypassInput_360 "" UBYTE NO_COMPU_METHOD 0 0 0 255 ECU_ADDRESS 0xD00016F3 FORMAT "%.15" /end MEASUREMENT
/begin MEASUREMENT BypassInput_361 "" FLOAT32_IEEE NO_COMPU_METHOD 0 0 -3.4e+038 3.4e+038 ECU_ADDRESS 0xD0001240 FORMAT "%.15" /end MEASUREMENT
/begin MEASUREMENT BypassInput_362 "" UWORD NO_COMPU_METHOD 0 0 0 65535 ECU_ADDRESS 0xD0001244 FORMAT "%.15" /end MEASUREMENT
/begin MEASUREMENT BypassInput_363 "" FLOAT32_IEEE NO_COMPU_METHOD 0 0 -3.4e+038 3.4e+038 ECU_ADDRESS 0xD0001246 FORMAT "%.15" /end MEASUREMENT
/begin MEASUREMENT BypassInput_364 "" FLOAT32_IEEE NO_COMPU_METHOD 0 0 -3.4e+038 3.4e+038 ECU_ADDRESS 0xD000124A FORMAT "%.15" /end MEASUREMENT
/begin MEASUREMENT BypassInput_365 "" UBYTE NO_COMPU_METHOD 0 0 0 255 ECU_ADDRESS 0xD00016F4 FORMAT "%.15" /end MEASUREMENT
/begin MEASUREMENT BypassInput_366 "" UWORD NO_COMPU_METHOD 0 0 0 65535 ECU_ADDRESS 0xD000124E FORMAT "%.15" /end MEASUREMENT
/begin MEASUREMENT BypassInput_367 "" UBYTE NO_COMPU_METHOD 0 0 0 255 ECU_ADDRESS 0xD00016F5 FORMAT "%.15" /end MEASUREMENT
/begin MEASUREMENT BypassInput_368 "" UBYTE NO_COMPU_METHOD 0 0 0 255 ECU_ADDRESS 0xD00016F6 FORMAT "%.15" /end MEASUREMENT
/begin MEASUREMENT BypassInput_369 "" UWORD NO_COMPU_METHOD 0 0 0 65535 ECU_ADDRESS 0xD0001250 FORMAT "%.15" /end MEASUREMENT
/begin MEASUREMENT BypassInput_37 "" UBYTE NO_COMPU_METHOD 0 0 0 255 ECU_ADDRESS 0xD0001657 FORMAT "%.15" /end MEASUREMENT
/begin MEASUREMENT BypassInput_370 "" UBYTE NO_COMPU_METHOD 0 0 0 255 ECU_ADDRESS 0xD00016F7 FORMAT "%.15" /end MEASUREMENT
/begin MEASUREMENT BypassInput_371 "" UBYTE NO_COMPU_METHOD 0 0 0 255 ECU_ADDRESS 0xD00016F8 FORMAT "%.15" /end MEASUREMENT
/begin MEASUREMENT BypassInput_372 "" UBYTE NO_COMPU_METHOD 0 0 0 255 ECU_ADDRESS 0xD00016F9 FORMAT "%.15" /end MEASUREMENT
/begin MEASUREMENT BypassInput_373 "" UWORD NO_COMPU_METHOD 0 0 0 65535 ECU_ADDRESS 0xD0001252 FORMAT "%.15" /end MEASUREMENT
/begin MEASUREMENT BypassInput_374 "" UWORD NO_COMPU_METHOD 0 0 0 65535 ECU_ADDRESS 0xD0001254 FORMAT "%.15" /end MEASUREMENT
/begin MEASUREMENT BypassInput_375 "" UBYTE NO_COMPU_METHOD 0 0 0 255 ECU_ADDRESS 0xD00016FA FORMAT "%.15" /end MEASUREMENT
/begin MEASUREMENT BypassInput_376 "" UWORD NO_COMPU_METHOD 0 0 0 65535 ECU_ADDRESS 0xD0001256 FORMAT "%.15" /end MEASUREMENT
/begin MEASUREMENT BypassInput_377 "" UWORD NO_COMPU_METHOD 0 0 0 65535 ECU_ADDRESS 0xD0001258 FORMAT "%.15" /end MEASUREMENT
/begin MEASUREMENT BypassInput_378 "" UBYTE NO_COMPU_METHOD 0 0 0 255 ECU_ADDRESS 0xD00016FB FORMAT "%.15" /end MEASUREMENT
/begin MEASUREMENT BypassInput_379 "" FLOAT32_IEEE NO_COMPU_METHOD 0 0 -3.4e+038 3.4e+038 ECU_ADDRESS 0xD000125A FORMAT "%.15" /end MEASUREMENT
/begin MEASUREMENT BypassInput_38 "" UBYTE NO_COMPU_METHOD 0 0 0 255 ECU_ADDRESS 0xD0001658 FORMAT "%.15" /end MEASUREMENT
/begin MEASUREMENT BypassInput_380 "" UWORD NO_COMPU_METHOD 0 0 0 65535 ECU_ADDRESS 0xD000125E FORMAT "%.15" /end MEASUREMENT
/begin MEASUREMENT BypassInput_381 "" UWORD NO_COMPU_METHOD 0 0 0 65535 ECU_ADDRESS 0xD0001260 FORMAT "%.15" /end MEASUREMENT
/begin MEASUREMENT BypassInput_382 "" UBYTE NO_COMPU_METHOD 0 0 0 255 ECU_ADDRESS 0xD00016FC FORMAT "%.15" /end MEASUREMENT
/begin MEASUREMENT BypassInput_383 "" UBYTE NO_COMPU_METHOD 0 0 0 255 ECU_ADDRESS 0xD00016FD FORMAT "%.15" /end MEASUREMENT
/begin MEASUREMENT BypassInput_384 "" UWORD NO_COMPU_METHOD 0 0 0 65535 ECU_ADDRESS 0xD0001262 FORMAT "%.15" /end MEASUREMENT
/begin MEASUREMENT BypassInput_385 "" UBYTE NO_COMPU_METHOD 0 0 0 255 ECU_ADDRESS 0xD00016FE FORMAT "%.15" /end MEASUREMENT
/begin MEASUREMENT BypassInput_386 "" UBYTE NO_COMPU_METHOD 0 0 0 255 ECU_ADDRESS 0xD00016FF FORMAT "%.15" /end MEASUREMENT
/begin MEASUREMENT BypassInput_387 "" UBYTE NO_COMPU_METHOD 0 0 0 255 ECU_ADDRESS 0xD0001700 FORMAT "%.15" /end MEASUREMENT
/begin MEASUREMENT BypassInput_388 "" UWORD NO_COMPU_METHOD 0 0 0 65535 ECU_ADDRESS 0xD0001264 FORMAT "%.15" /end MEASUREMENT
/begin MEASUREMENT BypassInput_389 "" UBYTE NO_COMPU_METHOD 0 0 0 255 ECU_ADDRESS 0xD0001701 FORMAT "%.15" /end MEASUREMENT
/begin MEASUREMENT BypassInput_39 "" FLOAT32_IEEE NO_COMPU_METHOD 0 0 -3.4e+038 3.4e+038 ECU_ADDRESS 0xD0001044 FORMAT "%.15" /end MEASUREMENT
/begin MEASUREMENT BypassInput_390 "" UBYTE NO_COMPU_METHOD 0 0 0 255 ECU_ADDRESS 0xD0001702 FORMAT "%.15" /end MEASUREMENT
/begin MEASUREMENT BypassInput_391 "" UWORD NO_COMPU_METHOD 0 0 0 65535 ECU_ADDRESS 0xD0001266 FORMAT "%.15" /end MEASUREMENT
/begin MEASUREMENT BypassInput_392 "" UBYTE NO_COMPU_METHOD 0 0 0 255 ECU_ADDRESS 0xD0001703 FORMAT "%.15" /end MEASUREMENT
/begin MEASUREMENT BypassInput_393 "" UBYTE NO_COMPU_METHOD 0 0 0 255 ECU_ADDRESS 0xD0001704 FORMAT "%.15" /end MEASUREMENT
/begin MEASUREMENT BypassInput_394 "" UBYTE NO_COMPU_METHOD 0 0 0 255 ECU_ADDRESS 0xD0001705 FORMAT "%.15" /end MEASUREMENT
/begin MEASUREMENT BypassInput_395 "" UBYTE NO_COMPU_METHOD 0 0 0 255 ECU_ADDRESS 0xD0001706 FORMAT "%.15" /end MEASUREMENT
/begin MEASUREMENT BypassInput_396 "" UWORD NO_COMPU_METHOD 0 0 0 65535 ECU_ADDRESS 0xD0001268 FORMAT "%.15" /end MEASUREMENT
/begin MEASUREMENT BypassInput_397 "" UWORD NO_COMPU_METHOD 0 0 0 65535 ECU_ADDRESS 0xD000126A FORMAT "%.15" /end MEASUREMENT
/begin MEASUREMENT BypassInput_398 "" UBYTE NO_COMPU_METHOD 0 0 0 255 ECU_ADDRESS 0xD0001707 FORMAT "%.15" /end MEASUREMENT
/begin MEASUREMENT BypassInput_399 "" FLOAT32_IEEE NO_COMPU_METHOD 0 0 -3.4e+038 3.4e+038 ECU_ADDRESS 0xD000126C FORMAT "%.15" /end MEASUREMENT
/begin MEASUREMENT BypassInput_4 "" UBYTE NO_COMPU_METHOD 0 0 0 255 ECU_ADDRESS 0xD0001644 FORMAT "%.15" /end MEASUREMENT
/begin MEASUREMENT BypassInput_40 "" UBYTE NO_COMPU_METHOD 0 0 0 255 ECU_ADDRESS 0xD0001659 FORMAT "%.15" /end MEASUREMENT
/begin MEASUREMENT BypassInput_400 "" UBYTE NO_COMPU_METHOD 0 0 0 255 ECU_ADDRESS 0xD0001708 FORMAT "%.15" /end MEASUREMENT
/begin MEASUREMENT BypassInput_401 "" UBYTE NO_COMPU_METHOD 0 0 0 255 ECU_ADDRESS 0xD0001709 FORMAT "%.15" /end MEASUREMENT
/begin MEASUREMENT BypassInput_402 "" UWORD NO_COMPU_METHOD 0 0 0 65535 ECU_ADDRESS 0xD0001270 FORMAT "%.15" /end MEASUREMENT
/begin MEASUREMENT BypassInput_403 "" FLOAT32_IEEE NO_COMPU_METHOD 0 0 -3.4e+038 3.4e+038 ECU_ADDRESS 0xD0001272 FORMAT "%.15" /end MEASUREMENT
/begin MEASUREMENT BypassInput_404 "" UWORD NO_COMPU_METHOD 0 0 0 65535 ECU_ADDRESS 0xD0001276 FORMAT "%.15" /end MEASUREMENT
/begin MEASUREMENT BypassInput_405 "" FLOAT32_IEEE NO_COMPU_METHOD 0 0 -3.4e+038 3.4e+038 ECU_ADDRESS 0xD0001278 FORMAT "%.15" /end MEASUREMENT
/begin MEASUREMENT BypassInput_406 "" UWORD NO_COMPU_METHOD 0 0 0 65535 ECU_ADDRESS 0xD000127C FORMAT "%.15" /end MEASUREMENT
/begin MEASUREMENT BypassInput_407 "" UBYTE NO_COMPU_METHOD 0 0 0 255 ECU_ADDRESS 0xD000170A FORMAT "%.15" /end MEASUREMENT
/begin MEASUREMENT BypassInput_408 "" UBYTE NO_COMPU_METHOD 0 0 0 255 ECU_ADDRESS 0xD000170B FORMAT "%.15" /end MEASUREMENT
/begin MEASUREMENT BypassInput_409 "" UBYTE NO_COMPU_METHOD 0 0 0 255 ECU_ADDRESS 0xD000170C FORMAT "%.15" /end MEASUREMENT
/begin MEASUREMENT BypassInput_41 "" UBYTE NO_COMPU_METHOD 0 0 0 255 ECU_ADDRESS 0xD000165A FORMAT "%.15" /end MEASUREMENT
/begin MEASUREMENT BypassInput_410 "" FLOAT32_IEEE NO_COMPU_METHOD 0 0 -3.4e+038 3.4e+038 ECU_ADDRESS 0xD000127E FORMAT "%.15" /end MEASUREMENT
/begin MEASUREMENT BypassInput_411 "" UBYTE NO_COMPU_METHOD 0 0 0 255 ECU_ADDRESS 0xD000170D FORMAT "%.15" /end MEASUREMENT
/begin MEASUREMENT BypassInput_412 "" UBYTE NO_COMPU_METHOD 0 0 0 255 ECU_ADDRESS 0xD000170E FORMAT "%.15" /end MEASUREMENT
/begin MEASUREMENT BypassInput_413 "" UBYTE NO_COMPU_METHOD 0 0 0 255 ECU_ADDRESS 0xD000170F FORMAT "%.15" /end MEASUREMENT
/begin MEASUREMENT BypassInput_414 "" UBYTE NO_COMPU_METHOD 0 0 0 255 ECU_ADDRESS 0xD0001710 FORMAT "%.15" /end MEASUREMENT
/begin MEASUREMENT BypassInput_415 "" FLOAT32_IEEE NO_COMPU_METHOD 0 0 -3.4e+038 3.4e+038 ECU_ADDRESS 0xD0001282 FORMAT "%.15" /end MEASUREMENT
/begin MEASUREMENT BypassInput_416 "" UBYTE NO_COMPU_METHOD 0 0 0 255 ECU_ADDRESS 0xD0001711 FORMAT "%.15" /end MEASUREMENT
/begin MEASUREMENT BypassInput_417 "" UBYTE NO_COMPU_METHOD 0 0 0 255 ECU_ADDRESS 0xD0001712 FORMAT "%.15" /end MEASUREMENT
/begin MEASUREMENT BypassInput_418 "" UBYTE NO_COMPU_METHOD 0 0 0 255 ECU_ADDRESS 0xD0001713 FORMAT "%.15" /end MEASUREMENT
/begin MEASUREMENT BypassInput_419 "" UBYTE NO_COMPU_METHOD 0 0 0 255 ECU_ADDRESS 0xD0001714 FORMAT "%.15" /end MEASUREMENT
/begin MEASUREMENT BypassInput_42 "" FLOAT32_IEEE NO_COMPU_METHOD 0 0 -3.4e+038 3.4e+038 ECU_ADDRESS 0xD0001048 FORMAT "%.15" /end MEASUREMENT
/begin MEASUREMENT BypassInput_420 "" UBYTE NO_COMPU_METHOD 0 0 0 255 ECU_ADDRESS 0xD0001715 FORMAT "%.15" /end MEASUREMENT
/begin MEASUREMENT BypassInput_421 "" FLOAT32_IEEE NO_COMPU_METHOD 0 0 -3.4e+038 3.4e+038 ECU_ADDRESS 0xD0001286 FORMAT "%.15" /end MEASUREMENT
/begin MEASUREMENT BypassInput_422 "" UWORD NO_COMPU_METHOD 0 0 0 65535 ECU_ADDRESS 0xD000128A FORMAT "%.15" /end MEASUREMENT
/begin MEASUREMENT BypassInput_423 "" UBYTE NO_COMPU_METHOD 0 0 0 255 ECU_ADDRESS 0xD0001716 FORMAT "%.15" /end MEASUREMENT
/begin MEASUREMENT BypassInput_424 "" FLOAT32_IEEE NO_COMPU_METHOD 0 0 -3.4e+038 3.4e+038 ECU_ADDRESS 0xD000128C FORMAT "%.15" /end MEASUREMENT
/begin MEASUREMENT BypassInput_425 "" UWORD NO_COMPU_METHOD 0 0 0 65535 ECU_ADDRESS 0xD0001290 FORMAT "%.15" /end MEASUREMENT
/begin MEASUREMENT BypassInput_426 "" UBYTE NO_COMPU_METHOD 0 0 0 255 ECU_ADDRESS 0xD0001717 FORMAT "%.15" /end MEASUREMENT
/begin MEASUREMENT BypassInput_427 "" FLOAT32_IEEE NO_COMPU_METHOD 0 0 -3.4e+038 3.4e+038 ECU_ADDRESS 0xD0001292 FORMAT "%.15" /end MEASUREMENT
/begin MEASUREMENT BypassInput_428 "" UBYTE NO_COMPU_METHOD 0 0 0 255 ECU_ADDRESS 0xD0001718 FORMAT "%.15" /end MEASUREMENT
/begin MEASUREMENT BypassInput_429 "" FLOAT32_IEEE NO_COMPU_METHOD 0 0 -3.4e+038 3.4e+038 ECU_ADDRESS 0xD0001296 FORMAT "%.15" /end MEASUREMENT
/begin MEASUREMENT BypassInput_43 "" UBYTE NO_COMPU_METHOD 0 0 0 255 ECU_ADDRESS 0xD000165B FORMAT "%.15" /end MEASUREMENT
/begin MEASUREMENT BypassInput_430 "" UBYTE NO_COMPU_METHOD 0 0 0 255 ECU_ADDRESS 0xD0001719 FORMAT "%.15" /end MEASUREMENT
/begin MEASUREMENT BypassInput_431 "" UBYTE NO_COMPU_METHOD 0 0 0 255 ECU_ADDRESS 0xD000171A FORMAT "%.15" /end MEASUREMENT
/begin MEASUREMENT BypassInput_432 "" UWORD NO_COMPU_METHOD 0 0 0 65535 ECU_ADDRESS 0xD000129A FORMAT "%.15" /end MEASUREMENT
/begin MEASUREMENT BypassInput_433 "" FLOAT32_IEEE NO_COMPU_METHOD 0 0 -3.4e+038 3.4e+038 ECU_ADDRESS 0xD000129C FORMAT "%.15" /end MEASUREMENT
/begin MEASUREMENT BypassInput_434 "" UBYTE NO_COMPU_METHOD 0 0 0 255 ECU_ADDRESS 0xD000171B FORMAT "%.15" /end MEASUREMENT
/begin MEASUREMENT BypassInput_435 "" UBYTE NO_COMPU_METHOD 0 0 0 255 ECU_ADDRESS 0xD000171C FORMAT "%.15" /end MEASUREMENT
/begin MEASUREMENT BypassInput_436 "" UBYTE NO_COMPU_METHOD 0 0 0 255 ECU_ADDRESS 0xD000171D FORMAT "%.15" /end MEASUREMENT
/begin MEASUREMENT BypassInput_437 "" UWORD NO_COMPU_METHOD 0 0 0 65535 ECU_ADDRESS 0xD00012A0 FORMAT "%.15" /end MEASUREMENT
/begin MEASUREMENT BypassInput_438 "" UBYTE NO_COMPU_METHOD 0 0 0 255 ECU_ADDRESS 0xD000171E FORMAT "%.15" /end MEASUREMENT
/begin MEASUREMENT BypassInput_439 "" UBYTE NO_COMPU_METHOD 0 0 0 255 ECU_ADDRESS 0xD000171F FORMAT "%.15" /end MEASUREMENT
/begin MEASUREMENT BypassInput_44 "" UBYTE NO_COMPU_METHOD 0 0 0 255 ECU_ADDRESS 0xD000165C FORMAT "%.15" /end MEASUREMENT
/begin MEASUREMENT BypassInput_440 "" UBYTE NO_COMPU_METHOD 0 0 0 255 ECU_ADDRESS 0xD0001720 FORMAT "%.15" /end MEASUREMENT
/begin MEASUREMENT BypassInput_441 "" UBYTE NO_COMPU_METHOD 0 0 0 255 ECU_ADDRESS 0xD0001721 FORMAT "%.15" /end MEASUREMENT
/begin MEASUREMENT BypassInput_442 "" UBYTE NO_COMPU_METHOD 0 0 0 255 ECU_ADDRESS 0xD0001722 FORMAT "%.15" /end MEASUREMENT
/begin MEASUREMENT BypassInput_443 "" FLOAT32_IEEE NO_COMPU_METHOD 0 0 -3.4e+038 3.4e+038 ECU_ADDRESS 0xD00012A2 FORMAT "%.15" /end MEASUREMENT
/begin MEASUREMENT BypassInput_444 "" UWORD NO_COMPU_METHOD 0 0 0 65535 ECU_ADDRESS 0xD00012A6 FORMAT "%.15" /end MEASUREMENT
/begin MEASUREMENT BypassInput_445 "" UBYTE NO_COMPU_METHOD 0 0 0 255 ECU_ADDRESS 0xD0001723 FORMAT "%.15" /end MEASUREMENT
/begin MEASUREMENT BypassInput_446 "" UBYTE NO_COMPU_METHOD 0 0 0 255 ECU_ADDRESS 0xD0001724 FORMAT "%.15" /end MEASUREMENT
/begin MEASUREMENT BypassInput_447 "" UBYTE NO_COMPU_METHOD 0 0 0 255 ECU_ADDRESS 0xD0001725 FORMAT "%.15" /end MEASUREMENT
/begin MEASUREMENT BypassInput_448 "" FLOAT32_IEEE NO_COMPU_METHOD 0 0 -3.4e+038 3.4e+038 ECU_ADDRESS 0xD00012A8 FORMAT "%.15" /end MEASUREMENT
/begin MEASUREMENT BypassInput_449 "" FLOAT32_IEEE NO_COMPU_METHOD 0 0 -3.4e+038 3.4e+038 ECU_ADDRESS 0xD00012AC FORMAT "%.15" /end MEASUREMENT
/begin MEASUREMENT BypassInput_45 "" FLOAT32_IEEE NO_COMPU_METHOD 0 0 -3.4e+038 3.4e+038 ECU_ADDRESS 0xD000104C FORMAT "%.15" /end MEASUREMENT
/begin MEASUREMENT BypassInput_450 "" FLOAT32_IEEE NO_COMPU_METHOD 0 0 -3.4e+038 3.4e+038 ECU_ADDRESS 0xD00012B0 FORMAT "%.15" /end MEASUREMENT
/begin MEASUREMENT BypassInput_451 "" UWORD NO_COMPU_METHOD 0 0 0 65535 ECU_ADDRESS 0xD00012B4 FORMAT "%.15" /end MEASUREMENT
/begin MEASUREMENT BypassInput_452 "" UWORD NO_COMPU_METHOD 0 0 0 65535 ECU_ADDRESS 0xD00012B6 FORMAT "%.15" /end MEASUREMENT
/begin MEASUREMENT BypassInput_453 "" UBYTE NO_COMPU_METHOD 0 0 0 255 ECU_ADDRESS 0xD0001726 FORMAT "%.15" /end MEASUREMENT
/begin MEASUREMENT BypassInput_454 "" UWORD NO_COMPU_METHOD 0 0 0 65535 ECU_ADDRESS 0xD00012B8 FORMAT "%.15" /end MEASUREMENT
/begin MEASUREMENT BypassInput_455 "" UBYTE NO_COMPU_METHOD 0 0 0 255 ECU_ADDRESS 0xD0001727 FORMAT "%.15" /end MEASUREMENT
/begin MEASUREMENT BypassInput_456 "" FLOAT32_IEEE NO_COMPU_METHOD 0 0 -3.4e+038 3.4e+038 ECU_ADDRESS 0xD00012BA FORMAT "%.15" /end MEASUREMENT
/begin MEASUREMENT BypassInput_457 "" UWORD NO_COMPU_METHOD 0 0 0 65535 ECU_ADDRESS 0xD00012BE FORMAT "%.15" /end MEASUREMENT
/begin MEASUREMENT BypassInput_458 "" UWORD NO_COMPU_METHOD 0 0 0 65535 ECU_ADDRESS 0xD00012C0 FORMAT "%.15" /end MEASUREMENT
/begin MEASUREMENT BypassInput_459 "" FLOAT32_IEEE NO_COMPU_METHOD 0 0 -3.4e+038 3.4e+038 ECU_ADDRESS 0xD00012C2 FORMAT "%.15" /end MEASUREMENT
/begin MEASUREMENT BypassInput_46 "" UWORD NO_COMPU_METHOD 0 0 0 65535 ECU_ADDRESS 0xD0001050 FORMAT "%.15" /end MEASUREMENT
/begin MEASUREMENT BypassInput_460 "" UWORD NO_COMPU_METHOD 0 0 0 65535 ECU_ADDRESS 0xD00012C6 FORMAT "%.15" /end MEASUREMENT
/begin MEASUREMENT BypassInput_461 "" UBYTE NO_COMPU_METHOD 0 0 0 255 ECU_ADDRESS 0xD0001728 FORMAT "%.15" /end MEASUREMENT
/begin MEASUREMENT BypassInput_462 "" UWORD NO_COMPU_METHOD 0 0 0 65535 ECU_ADDRESS 0xD00012C8 FORMAT "%.15" /end MEASUREMENT
/begin MEASUREMENT BypassInput_463 "" FLOAT32_IEEE NO_COMPU_METHOD 0 0 -3.4e+038 3.4e+038 ECU_ADDRESS 0xD00012CA FORMAT "%.15" /end MEASUREMENT
/begin MEASUREMENT BypassInput_464 "" UBYTE NO_COMPU_METHOD 0 0 0 255 ECU_ADDRESS 0xD0001729 FORMAT "%.15" /end MEASUREMENT
/begin MEASUREMENT BypassInput_465 "" UBYTE NO_COMPU_METHOD 0 0 0 255 ECU_ADDRESS 0xD000172A FORMAT "%.15" /end MEASUREMENT
/begin MEASUREMENT BypassInput_466 "" FLOAT32_IEEE NO_COMPU_METHOD 0 0 -3.4e+038 3.4e+038 ECU_ADDRESS 0xD00012CE FORMAT "%.15" /end MEASUREMENT
/begin MEASUREMENT BypassInput_467 "" FLOAT32_IEEE NO_COMPU_METHOD 0 0 -3.4e+038 3.4e+038 ECU_ADDRESS 0xD00012D2 FORMAT "%.15" /end MEASUREMENT
/begin MEASUREMENT BypassInput_468 "" UBYTE NO_COMPU_METHOD 0 0 0 255 ECU_ADDRESS 0xD000172B FORMAT "%.15" /end MEASUREMENT
/begin MEASUREMENT BypassInput_469 "" UWORD NO_COMPU_METHOD 0 0 0 65535 ECU_ADDRESS 0xD00012D6 FORMAT "%.15" /end MEASUREMENT
/begin MEASUREMENT BypassInput_47 "" UBYTE NO_COMPU_METHOD 0 0 0 255 ECU_ADDRESS 0xD000165D FORMAT "%.15" /end MEASUREMENT
/begin MEASUREMENT BypassInput_470 "" UWORD NO_COMPU_METHOD 0 0 0 65535 ECU_ADDRESS 0xD00012D8 FORMAT "%.15" /end MEASUREMENT
/begin MEASUREMENT BypassInput_471 "" UBYTE NO_COMPU_METHOD 0 0 0 255 ECU_ADDRESS 0xD000172C FORMAT "%.15" /end MEASUREMENT
/begin MEASUREMENT BypassInput_472 "" UWORD NO_COMPU_METHOD 0 0 0 65535 ECU_ADDRESS 0xD00012DA FORMAT "%.15" /end MEASUREMENT
/begin MEASUREMENT BypassInput_473 "" UBYTE NO_COMPU_METHOD 0 0 0 255 ECU_ADDRESS 0xD000172D FORMAT "%.15" /end MEASUREMENT
/begin MEASUREMENT BypassInput_474 "" FLOAT32_IEEE NO_COMPU_METHOD 0 0 -3.4e+038 3.4e+038 ECU_ADDRESS 0xD00012DC FORMAT "%.15" /end MEASUREMENT
/begin MEASUREMENT BypassInput_475 "" UBYTE NO_COMPU_METHOD 0 0 0 255 ECU_ADDRESS 0xD000172E FORMAT "%.15" /end MEASUREMENT
/begin MEASUREMENT BypassInput_476 "" UBYTE NO_COMPU_METHOD 0 0 0 255 ECU_ADDRESS 0xD000172F FORMAT "%.15" /end MEASUREMENT
/begin MEASUREMENT BypassInput_477 "" UBYTE NO_COMPU_METHOD 0 0 0 255 ECU_ADDRESS 0xD0001730 FORMAT "%.15" /end MEASUREMENT
/begin MEASUREMENT BypassInput_478 "" UWORD NO_COMPU_METHOD 0 0 0 65535 ECU_ADDRESS 0xD00012E0 FORMAT "%.15" /end MEASUREMENT
/begin MEASUREMENT BypassInput_479 "" UBYTE NO_COMPU_METHOD 0 0 0 255 ECU_ADDRESS 0xD0001731 FORMAT "%.15" /end MEASUREMENT
/begin MEASUREMENT BypassInput_48 "" UWORD NO_COMPU_METHOD 0 0 0 65535 ECU_ADDRESS 0xD0001052 FORMAT "%.15" /end MEASUREMENT
/begin MEASUREMENT BypassInput_480 "" UBYTE NO_COMPU_METHOD 0 0 0 255 ECU_ADDRESS 0xD0001732 FORMAT "%.15" /end MEASUREMENT
/begin MEASUREMENT BypassInput_481 "" UBYTE NO_COMPU_METHOD 0 0 0 255 ECU_ADDRESS 0xD0001733 FORMAT "%.15" /end MEASUREMENT
/begin MEASUREMENT BypassInput_482 "" UBYTE NO_COMPU_METHOD 0 0 0 255 ECU_ADDRESS 0xD0001734 FORMAT "%.15" /end MEASUREMENT
/begin MEASUREMENT BypassInput_483 "" UWORD NO_COMPU_METHOD 0 0 0 65535 ECU_ADDRESS 0xD00012E2 FORMAT "%.15" /end MEASUREMENT
/begin MEASUREMENT BypassInput_484 "" FLOAT32_IEEE NO_COMPU_METHOD 0 0 -3.4e+038 3.4e+038 ECU_ADDRESS 0xD00012E4 FORMAT "%.15" /end MEASUREMENT
/begin MEASUREMENT BypassInput_485 "" FLOAT32_IEEE NO_COMPU_METHOD 0 0 -3.4e+038 3.4e+038 ECU_ADDRESS 0xD00012E8 FORMAT "%.15" /end MEASUREMENT
/begin MEASUREMENT BypassInput_486 "" UBYTE NO_COMPU_METHOD 0 0 0 255 ECU_ADDRESS 0xD0001735 FORMAT "%.15" /end MEASUREMENT
/begin MEASUREMENT BypassInput_487 "" UBYTE NO_COMPU_METHOD 0 0 0 255 ECU_ADDRESS 0xD0001736 FORMAT "%.15" /end MEASUREMENT
/begin MEASUREMENT BypassInput_488 "" UBYTE NO_COMPU_METHOD 0 0 0 255 ECU_ADDRESS 0xD0001737 FORMAT "%.15" /end MEASUREMENT
/begin MEASUREMENT BypassInput_489 "" UWORD NO_COMPU_METHOD 0 0 0 65535 ECU_ADDRESS 0xD00012EC FORMAT "%.15" /end MEASUREMENT
/begin MEASUREMENT BypassInput_49 "" UBYTE NO_COMPU_METHOD 0 0 0 255 ECU_ADDRESS 0xD000165E FORMAT "%.15" /end MEASUREMENT
/begin MEASUREMENT BypassInput_490 "" FLOAT32_IEEE NO_COMPU_METHOD 0 0 -3.4e+038 3.4e+038 ECU_ADDRESS 0xD00012EE FORMAT "%.15" /end MEASUREMENT
/begin MEASUREMENT BypassInput_491 "" UWORD NO_COMPU_METHOD 0 0 0 65535 ECU_ADDRESS 0xD00012F2 FORMAT "%.15" /end MEASUREMENT
/begin MEASUREMENT BypassInput_492 "" UBYTE NO_COMPU_METHOD 0 0 0 255 ECU_ADDRESS 0xD0001738 FORMAT "%.15" /end MEASUREMENT
/begin MEASUREMENT BypassInput_493 "" UWORD NO_COMPU_METHOD 0 0 0 65535 ECU_ADDRESS 0xD00012F4 FORMAT "%.15" /end MEASUREMENT
/begin MEASUREMENT BypassInput_494 "" FLOAT32_IEEE NO_COMPU_METHOD 0 0 -3.4e+038 3.4e+038 ECU_ADDRESS 0xD00012F6 FORMAT "%.15" /end MEASUREMENT
/begin MEASUREMENT BypassInput_495 "" UBYTE NO_COMPU_METHOD 0 0 0 255 ECU_ADDRESS 0xD0001739 FORMAT "%.15" /end MEASUREMENT
/begin MEASUREMENT BypassInput_496 "" FLOAT32_IEEE NO_COMPU_METHOD 0 0 -3.4e+038 3.4e+038 ECU_ADDRESS 0xD00012FA FORMAT "%.15" /end MEASUREMENT
/begin MEASUREMENT BypassInput_497 "" UWORD NO_COMPU_METHOD 0 0 0 65535 ECU_ADDRESS 0xD00012FE FORMAT "%.15" /end MEASUREMENT
/begin MEASUREMENT BypassInput_498 "" UBYTE NO_COMPU_METHOD 0 0 0 255 ECU_ADDRESS 0xD000173A FORMAT "%.15" /end MEASUREMENT
/begin MEASUREMENT BypassInput_499 "" UWORD NO_COMPU_METHOD 0 0 0 65535 ECU_ADDRESS 0xD0001300 FORMAT "%.15" /end MEASUREMENT
/begin MEASUREMENT BypassInput_5 "" FLOAT32_IEEE NO_COMPU_METHOD 0 0 -3.4e+038 3.4e+038 ECU_ADDRESS 0xD000101C FORMAT "%.15" /end MEASUREMENT
/begin MEASUREMENT BypassInput_50 "" UBYTE NO_COMPU_METHOD 0 0 0 255 ECU_ADDRESS 0xD000165F FORMAT "%.15" /end MEASUREMENT
/begin MEASUREMENT BypassInput_500 "" FLOAT32_IEEE NO_COMPU_METHOD 0 0 -3.4e+038 3.4e+038 ECU_ADDRESS 0xD0001302 FORMAT "%.15" /end MEASUREMENT
/begin MEASUREMENT BypassInput_501 "" UBYTE NO_COMPU_METHOD 0 0 0 255 ECU_ADDRESS 0xD000173B FORMAT "%.15" /end MEASUREMENT
/begin MEASUREMENT BypassInput_502 "" FLOAT32_IEEE NO_COMPU_METHOD 0 0 -3.4e+038 3.4e+038 ECU_ADDRESS 0xD0001306 FORMAT "%.15" /end MEASUREMENT
/begin MEASUREMENT BypassInput_503 "" UBYTE NO_COMPU_METHOD 0 0 0 255 ECU_ADDRESS 0xD000173C FORMAT "%.15" /end MEASUREMENT
/begin MEASUREMENT BypassInput_504 "" UBYTE NO_COMPU_METHOD 0 0 0 255 ECU_ADDRESS 0xD000173D FORMAT "%.15" /end MEASUREMENT
/begin MEASUREMENT BypassInput_505 "" FLOAT32_IEEE NO_COMPU_METHOD 0 0 -3.4e+038 3.4e+038 ECU_ADDRESS 0xD000130A FORMAT "%.15" /end MEASUREMENT
/begin MEASUREMENT BypassInput_506 "" UBYTE NO_COMPU_METHOD 0 0 0 255 ECU_ADDRESS 0xD000173E FORMAT "%.15" /end MEASUREMENT
/begin MEASUREMENT BypassInput_507 "" UWORD NO_COMPU_METHOD 0 0 0 65535 ECU_ADDRESS 0xD000130E FORMAT "%.15" /end MEASUREMENT
/begin MEASUREMENT BypassInput_508 "" UBYTE NO_COMPU_METHOD 0 0 0 255 ECU_ADDRESS 0xD000173F FORMAT "%.15" /end MEASUREMENT
/begin MEASUREMENT BypassInput_509 "" UBYTE NO_COMPU_METHOD 0 0 0 255 ECU_ADDRESS 0xD0001740 FORMAT "%.15" /end MEASUREMENT
/begin MEASUREMENT BypassInput_51 "" FLOAT32_IEEE NO_COMPU_METHOD 0 0 -3.4e+038 3.4e+038 ECU_ADDRESS 0xD0001054 FORMAT "%.15" /end MEASUREMENT
/begin MEASUREMENT BypassInput_510 "" UWORD NO_COMPU_METHOD 0 0 0 65535 ECU_ADDRESS 0xD0001310 FORMAT "%.15" /end MEASUREMENT
/begin MEASUREMENT BypassInput_511 "" UBYTE NO_COMPU_METHOD 0 0 0 255 ECU_ADDRESS 0xD0001741 FORMAT "%.15" /end MEASUREMENT
/begin MEASUREMENT BypassInput_512 "" FLOAT32_IEEE NO_COMPU_METHOD 0 0 -3.4e+038 3.4e+038 ECU_ADDRESS 0xD0001312 FORMAT "%.15" /end MEASUREMENT
/begin MEASUREMENT BypassInput_513 "" UBYTE NO_COMPU_METHOD 0 0 0 255 ECU_ADDRESS 0xD0001742 FORMAT "%.15" /end MEASUREMENT
/begin MEASUREMENT BypassInput_514 "" UWORD NO_COMPU_METHOD 0 0 0 65535 ECU_ADDRESS 0xD0001316 FORMAT "%.15" /end MEASUREMENT
/begin MEASUREMENT BypassInput_515 "" FLOAT32_IEEE NO_COMPU_METHOD 0 0 -3.4e+038 3.4e+038 ECU_ADDRESS 0xD0001318 FORMAT "%.15" /end MEASUREMENT
/begin MEASUREMENT BypassInput_516 "" UBYTE NO_COMPU_METHOD 0 0 0 255 ECU_ADDRESS 0xD0001743 FORMAT "%.15" /end MEASUREMENT
/begin MEASUREMENT BypassInput_517 "" FLOAT32_IEEE NO_COMPU_METHOD 0 0 -3.4e+038 3.4e+038 ECU_ADDRESS 0xD000131C FORMAT "%.15" /end MEASUREMENT
/begin MEASUREMENT BypassInput_518 "" UWORD NO_COMPU_METHOD 0 0 0 65535 ECU_ADDRESS 0xD0001320 FORMAT "%.15" /end MEASUREMENT
/begin MEASUREMENT BypassInput_519 "" UBYTE NO_COMPU_METHOD 0 0 0 255 ECU_ADDRESS 0xD0001744 FORMAT "%.15" /end MEASUREMENT
/begin MEASUREMENT BypassInput_52 "" UWORD NO_COMPU_METHOD 0 0 0 65535 ECU_ADDRESS 0xD0001058 FORMAT "%.15" /end MEASUREMENT
/begin MEASUREMENT BypassInput_520 "" UWORD NO_COMPU_METHOD 0 0 0 65535 ECU_ADDRESS 0xD0001322 FORMAT "%.15" /end MEASUREMENT
/begin MEASUREMENT BypassInput_521 "" FLOAT32_IEEE NO_COMPU_METHOD 0 0 -3.4e+038 3.4e+038 ECU_ADDRESS 0xD0001324 FORMAT "%.15" /end MEASUREMENT
/begin MEASUREMENT BypassInput_522 "" UBYTE NO_COMPU_METHOD 0 0 0 255 ECU_ADDRESS 0xD0001745 FORMAT "%.15" /end MEASUREMENT
/begin MEASUREMENT BypassInput_523 "" UBYTE NO_COMPU_METHOD 0 0 0 255 ECU_ADDRESS 0xD0001746 FORMAT "%.15" /end MEASUREMENT
/begin MEASUREMENT BypassInput_524 "" FLOAT32_IEEE NO_COMPU_METHOD 0 0 -3.4e+038 3.4e+038 ECU_ADDRESS 0xD0001328 FORMAT "%.15" /end MEASUREMENT
/begin MEASUREMENT BypassInput_525 "" UBYTE NO_COMPU_METHOD 0 0 0 255 ECU_ADDRESS 0xD0001747 FORMAT "%.15" /end MEASUREMENT
/begin MEASUREMENT BypassInput_526 "" UBYTE NO_COMPU_METHOD 0 0 0 255 ECU_ADDRESS 0xD0001748 FORMAT "%.15" /end MEASUREMENT
/begin MEASUREMENT BypassInput_527 "" UBYTE NO_COMPU_METHOD 0 0 0 255 ECU_ADDRESS 0xD0001749 FORMAT "%.15" /end MEASUREMENT
/begin MEASUREMENT BypassInput_528 "" FLOAT32_IEEE NO_COMPU_METHOD 0 0 -3.4e+038 3.4e+038 ECU_ADDRESS 0xD000132C FORMAT "%.15" /end MEASUREMENT
/begin MEASUREMENT BypassInput_529 "" UBYTE NO_COMPU_METHOD 0 0 0 255 ECU_ADDRESS 0xD000174A FORMAT "%.15" /end MEASUREMENT
/begin MEASUREMENT BypassInput_53 "" FLOAT32_IEEE NO_COMPU_METHOD 0 0 -3.4e+038 3.4e+038 ECU_ADDRESS 0xD000105A FORMAT "%.15" /end MEASUREMENT
/begin MEASUREMENT BypassInput_530 "" FLOAT32_IEEE NO_COMPU_METHOD 0 0 -3.4e+038 3.4e+038 ECU_ADDRESS 0xD0001330 FORMAT "%.15" /end MEASUREMENT
/begin MEASUREMENT BypassInput_531 "" UBYTE NO_COMPU_METHOD 0 0 0 255 ECU_ADDRESS 0xD000174B FORMAT "%.15" /end MEASUREMENT
/begin MEASUREMENT BypassInput_532 "" UBYTE NO_COMPU_METHOD 0 0 0 255 ECU_ADDRESS 0xD000174C FORMAT "%.15" /end MEASUREMENT
/begin MEASUREMENT BypassInput_533 "" UWORD NO_COMPU_METHOD 0 0 0 65535 ECU_ADDRESS 0xD0001334 FORMAT "%.15" /end MEASUREMENT
/begin MEASUREMENT BypassInput_534 "" UBYTE NO_COMPU_METHOD 0 0 0 255 ECU_ADDRESS 0xD000174D FORMAT "%.15" /end MEASUREMENT
/begin MEASUREMENT BypassInput_535 "" FLOAT32_IEEE NO_COMPU_METHOD 0 0 -3.4e+038 3.4e+038 ECU_ADDRESS 0xD0001336 FORMAT "%.15" /end MEASUREMENT
/begin MEASUREMENT BypassInput_536 "" UBYTE NO_COMPU_METHOD 0 0 0 255 ECU_ADDRESS 0xD000174E FORMAT "%.15" /end MEASUREMENT
/begin MEASUREMENT BypassInput_537 "" FLOAT32_IEEE NO_COMPU_METHOD 0 0 -3.4e+038 3.4e+038 ECU_ADDRESS 0xD000133A FORMAT "%.15" /end MEASUREMENT
/begin MEASUREMENT BypassInput_538 "" UBYTE NO_COMPU_METHOD 0 0 0 255 ECU_ADDRESS 0xD000174F FORMAT "%.15" /end MEASUREMENT
/begin MEASUREMENT BypassInput_539 "" FLOAT32_IEEE NO_COMPU_METHOD 0 0 -3.4e+038 3.4e+038 ECU_ADDRESS 0xD000133E FORMAT "%.15" /end MEASUREMENT
/begin MEASUREMENT BypassInput_54 "" UBYTE NO_COMPU_METHOD 0 0 0 255 ECU_ADDRESS 0xD0001660 FORMAT "%.15" /end MEASUREMENT
/begin MEASUREMENT BypassInput_540 "" UWORD NO_COMPU_METHOD 0 0 0 65535 ECU_ADDRESS 0xD0001342 FORMAT "%.15" /end MEASUREMENT
/begin MEASUREMENT BypassInput_541 "" UBYTE NO_COMPU_METHOD 0 0 0 255 ECU_ADDRESS 0xD0001750 FORMAT "%.15" /end MEASUREMENT
/begin MEASUREMENT BypassInput_542 "" UBYTE NO_COMPU_METHOD 0 0 0 255 ECU_ADDRESS 0xD0001751 FORMAT "%.15" /end MEASUREMENT
/begin MEASUREMENT BypassInput_543 "" UBYTE NO_COMPU_METHOD 0 0 0 255 ECU_ADDRESS 0xD0001752 FORMAT "%.15" /end MEASUREMENT
/begin MEASUREMENT BypassInput_544 "" UWORD NO_COMPU_METHOD 0 0 0 65535 ECU_ADDRESS 0xD0001344 FORMAT "%.15" /end MEASUREMENT
/begin MEASUREMENT BypassInput_545 "" FLOAT32_IEEE NO_COMPU_METHOD 0 0 -3.4e+038 3.4e+038 ECU_ADDRESS 0xD0001346 FORMAT "%.15" /end MEASUREMENT
/begin MEASUREMENT BypassInput_546 "" UBYTE NO_COMPU_METHOD 0 0 0 255 ECU_ADDRESS 0xD0001753 FORMAT "%.15" /end MEASUREMENT
/begin MEASUREMENT BypassInput_547 "" UWORD NO_COMPU_METHOD 0 0 0 65535 ECU_ADDRESS 0xD000134A FORMAT "%.15" /end MEASUREMENT
/begin MEASUREMENT BypassInput_548 "" UWORD NO_COMPU_METHOD 0 0 0 65535 ECU_ADDRESS 0xD000134C FORMAT "%.15" /end MEASUREMENT
/begin MEASUREMENT BypassInput_549 "" UBYTE NO_COMPU_METHOD 0 0 0 255 ECU_ADDRESS 0xD0001754 FORMAT "%.15" /end MEASUREMENT
/begin MEASUREMENT BypassInput_55 "" UWORD NO_COMPU_METHOD 0 0 0 65535 ECU_ADDRESS 0xD000105E FORMAT "%.15" /end MEASUREMENT
/begin MEASUREMENT BypassInput_550 "" UBYTE NO_COMPU_METHOD 0 0 0 255 ECU_ADDRESS 0xD0001755 FORMAT "%.15" /end MEASUREMENT
/begin MEASUREMENT BypassInput_551 "" UWORD NO_COMPU_METHOD 0 0 0 65535 ECU_ADDRESS 0xD000134E FORMAT "%.15" /end MEASUREMENT
/begin MEASUREMENT BypassInput_552 "" UBYTE NO_COMPU_METHOD 0 0 0 255 ECU_ADDRESS 0xD0001756 FORMAT "%.15" /end MEASUREMENT
/begin MEASUREMENT BypassInput_553 "" FLOAT32_IEEE NO_COMPU_METHOD 0 0 -3.4e+038 3.4e+038 ECU_ADDRESS 0xD0001350 FORMAT "%.15" /end MEASUREMENT
/begin MEASUREMENT BypassInput_554 "" UBYTE NO_COMPU_METHOD 0 0 0 255 ECU_ADDRESS 0xD0001757 FORMAT "%.15" /end MEASUREMENT
/begin MEASUREMENT BypassInput_555 "" FLOAT32_IEEE NO_COMPU_METHOD 0 0 -3.4e+038 3.4e+038 ECU_ADDRESS 0xD0001354 FORMAT "%.15" /end MEASUREMENT
/begin MEASUREMENT BypassInput_556 "" UBYTE NO_COMPU_METHOD 0 0 0 255 ECU_ADDRESS 0xD0001758 FORMAT "%.15" /end MEASUREMENT
/begin MEASUREMENT BypassInput_557 "" UBYTE NO_COMPU_METHOD 0 0 0 255 ECU_ADDRESS 0xD0001759 FORMAT "%.15" /end MEASUREMENT
/begin MEASUREMENT BypassInput_558 "" UWORD NO_COMPU_METHOD 0 0 0 65535 ECU_ADDRESS 0xD0001358 FORMAT "%.15" /end MEASUREMENT
/begin MEASUREMENT BypassInput_559 "" FLOAT32_IEEE NO_COMPU_METHOD 0 0 -3.4e+038 3.4e+038 ECU_ADDRESS 0xD000135A FORMAT "%.15" /end MEASUREMENT
/begin MEASUREMENT BypassInput_56 "" FLOAT32_IEEE NO_COMPU_METHOD 0 0 -3.4e+038 3.4e+038 ECU_ADDRESS 0xD0001060 FORMAT "%.15" /end MEASUREMENT
/begin MEASUREMENT BypassInput_560 "" UWORD NO_COMPU_METHOD 0 0 0 65535 ECU_ADDRESS 0xD000135E FORMAT "%.15" /end MEASUREMENT
/begin MEASUREMENT BypassInput_561 "" UBYTE NO_COMPU_METHOD 0 0 0 255 ECU_ADDRESS 0xD000175A FORMAT "%.15" /end MEASUREMENT
/begin MEASUREMENT BypassInput_562 "" UWORD NO_COMPU_METHOD 0 0 0 65535 ECU_ADDRESS 0xD0001360 FORMAT "%.15" /end MEASUREMENT
/begin MEASUREMENT BypassInput_563 "" UBYTE NO_COMPU_METHOD 0 0 0 255 ECU_ADDRESS 0xD000175B FORMAT "%.15" /end MEASUREMENT
/begin MEASUREMENT BypassInput_564 "" UBYTE NO_COMPU_METHOD 0 0 0 255 ECU_ADDRESS 0xD000175C FORMAT "%.15" /end MEASUREMENT
/begin MEASUREMENT BypassInput_565 "" UBYTE NO_COMPU_METHOD 0 0 0 255 ECU_ADDRESS 0xD000175D FORMAT "%.15" /end MEASUREMENT
/begin MEASUREMENT BypassInput_566 "" UBYTE NO_COMPU_METHOD 0 0 0 255 ECU_ADDRESS 0xD000175E FORMAT "%.15" /end MEASUREMENT
/begin MEASUREMENT BypassInput_567 "" UBYTE NO_COMPU_METHOD 0 0 0 255 ECU_ADDRESS 0xD000175F FORMAT "%.15" /end MEASUREMENT
/begin MEASUREMENT BypassInput_568 "" FLOAT32_IEEE NO_COMPU_METHOD 0 0 -3.4e+038 3.4e+038 ECU_ADDRESS 0xD0001362 FORMAT "%.15" /end MEASUREMENT
/begin MEASUREMENT BypassInput_569 "" FLOAT32_IEEE NO_COMPU_METHOD 0 0 -3.4e+038 3.4e+038 ECU_ADDRESS 0xD0001366 FORMAT "%.15" /end MEASUREMENT
/begin MEASUREMENT BypassInput_57 "" UBYTE NO_COMPU_METHOD 0 0 0 255 ECU_ADDRESS 0xD0001661 FORMAT "%.15" /end MEASUREMENT
/begin MEASUREMENT BypassInput_570 "" UWORD NO_COMPU_METHOD 0 0 0 65535 ECU_ADDRESS 0xD000136A FORMAT "%.15" /end MEASUREMENT
/begin MEASUREMENT BypassInput_571 "" UBYTE NO_COMPU_METHOD 0 0 0 255 ECU_ADDRESS 0xD0001760 FORMAT "%.15" /end MEASUREMENT
/begin MEASUREMENT BypassInput_572 "" FLOAT32_IEEE NO_COMPU_METHOD 0 0 -3.4e+038 3.4e+038 ECU_ADDRESS 0xD000136C FORMAT "%.15" /end MEASUREMENT
/begin MEASUREMENT BypassInput_573 "" UWORD NO_COMPU_METHOD 0 0 0 65535 ECU_ADDRESS 0xD0001370 FORMAT "%.15" /end MEASUREMENT
/begin MEASUREMENT BypassInput_574 "" FLOAT32_IEEE NO_COMPU_METHOD 0 0 -3.4e+038 3.4e+038 ECU_ADDRESS 0xD0001372 FORMAT "%.15" /end MEASUREMENT
/begin MEASUREMENT BypassInput_575 "" UBYTE NO_COMPU_METHOD 0 0 0 255 ECU_ADDRESS 0xD0001761 FORMAT "%.15" /end MEASUREMENT
/begin MEASUREMENT BypassInput_576 "" UBYTE NO_COMPU_METHOD 0 0 0 255 ECU_ADDRESS 0xD0001762 FORMAT "%.15" /end MEASUREMENT
/begin MEASUREMENT BypassInput_577 "" UBYTE NO_COMPU_METHOD 0 0 0 255 ECU_ADDRESS 0xD0001763 FORMAT "%.15" /end MEASUREMENT
/begin MEASUREMENT BypassInput_578 "" FLOAT32_IEEE NO_COMPU_METHOD 0 0 -3.4e+038 3.4e+038 ECU_ADDRESS 0xD0001376 FORMAT "%.15" /end MEASUREMENT
/begin MEASUREMENT BypassInput_579 "" FLOAT32_IEEE NO_COMPU_METHOD 0 0 -3.4e+038 3.4e+038 ECU_ADDRESS 0xD000137A FORMAT "%.15" /end MEASUREMENT
/begin MEASUREMENT BypassInput_58 "" UBYTE NO_COMPU_METHOD 0 0 0 255 ECU_ADDRESS 0xD0001662 FORMAT "%.15" /end MEASUREMENT
/begin MEASUREMENT BypassInput_580 "" UBYTE NO_COMPU_METHOD 0 0 0 255 ECU_ADDRESS 0xD0001764 FORMAT "%.15" /end MEASUREMENT
/begin MEASUREMENT BypassInput_581 "" FLOAT32_IEEE NO_COMPU_METHOD 0 0 -3.4e+038 3.4e+038 ECU_ADDRESS 0xD000137E FORMAT "%.15" /end MEASUREMENT
/begin MEASUREMENT BypassInput_582 "" FLOAT32_IEEE NO_COMPU_METHOD 0 0 -3.4e+038 3.4e+038 ECU_ADDRESS 0xD0001382 FORMAT "%.15" /end MEASUREMENT
/begin MEASUREMENT BypassInput_583 "" UWORD NO_COMPU_METHOD 0 0 0 65535 ECU_ADDRESS 0xD0001386 FORMAT "%.15" /end MEASUREMENT
/begin MEASUREMENT BypassInput_584 "" FLOAT32_IEEE NO_COMPU_METHOD 0 0 -3.4e+038 3.4e+038 ECU_ADDRESS 0xD0001388 FORMAT "%.15" /end MEASUREMENT
/begin MEASUREMENT BypassInput_585 "" UBYTE NO_COMPU_METHOD 0 0 0 255 ECU_ADDRESS 0xD0001765 FORMAT "%.15" /end MEASUREMENT
/begin MEASUREMENT BypassInput_586 "" UBYTE NO_COMPU_METHOD 0 0 0 255 ECU_ADDRESS 0xD0001766 FORMAT "%.15" /end MEASUREMENT
/begin MEASUREMENT BypassInput_587 "" UBYTE NO_COMPU_METHOD 0 0 0 255 ECU_ADDRESS 0xD0001767 FORMAT "%.15" /end MEASUREMENT
/begin MEASUREMENT BypassInput_588 "" FLOAT32_IEEE NO_COMPU_METHOD 0 0 -3.4e+038 3.4e+038 ECU_ADDRESS 0xD000138C FORMAT "%.15" /end MEASUREMENT
/begin MEASUREMENT BypassInput_589 "" FLOAT32_IEEE NO_COMPU_METHOD 0 0 -3.4e+038 3.4e+038 ECU_ADDRESS 0xD0001390 FORMAT "%.15" /end MEASUREMENT
/begin MEASUREMENT BypassInput_59 "" UBYTE NO_COMPU_METHOD 0 0 0 255 ECU_ADDRESS 0xD0001663 FORMAT "%.15" /end MEASUREMENT
/begin MEASUREMENT BypassInput_590 "" UBYTE NO_COMPU_METHOD 0 0 0 255 ECU_ADDRESS 0xD0001768 FORMAT "%.15" /end MEASUREMENT
/begin MEASUREMENT BypassInput_591 "" UWORD NO_COMPU_METHOD 0 0 0 65535 ECU_ADDRESS 0xD0001394 FORMAT "%.15" /end MEASUREMENT
/begin MEASUREMENT BypassInput_592 "" UWORD NO_COMPU_METHOD 0 0 0 65535 ECU_ADDRESS 0xD0001396 FORMAT "%.15" /end MEASUREMENT
/begin MEASUREMENT BypassInput_593 "" UBYTE NO_COMPU_METHOD 0 0 0 255 ECU_ADDRESS 0xD0001769 FORMAT "%.15" /end MEASUREMENT
/begin MEASUREMENT BypassInput_594 "" UBYTE NO_COMPU_METHOD 0 0 0 255 ECU_ADDRESS 0xD000176A FORMAT "%.15" /end MEASUREMENT
/begin MEASUREMENT BypassInput_595 "" UWORD NO_COMPU_METHOD 0 0 0 65535 ECU_ADDRESS 0xD0001398 FORMAT "%.15" /end MEASUREMENT
/begin MEASUREMENT BypassInput_596 "" FLOAT32_IEEE NO_COMPU_METHOD 0 0 -3.4e+038 3.4e+038 ECU_ADDRESS 0xD000139A FORMAT "%.15" /end MEASUREMENT
/begin MEASUREMENT BypassInput_597 "" UWORD NO_COMPU_METHOD 0 0 0 65535 ECU_ADDRESS 0xD000139E FORMAT "%.15" /end MEASUREMENT
/begin MEASUREMENT BypassInput_598 "" FLOAT32_IEEE NO_COMPU_METHOD 0 0 -3.4e+038 3.4e+038 ECU_ADDRESS 0xD00013A0 FORMAT "%.15" /end MEASUREMENT
/begin MEASUREMENT BypassInput_599 "" UWORD NO_COMPU_METHOD 0 0 0 65535 ECU_ADDRESS 0xD00013A4 FORMAT "%.15" /end MEASUREMENT
/begin MEASUREMENT BypassInput_6 "" UWORD NO_COMPU_METHOD 0 0 0 65535 ECU_ADDRESS 0xD0001020 FORMAT "%.15" /end MEASUREMENT
/begin MEASUREMENT BypassInput_60 "" UWORD NO_COMPU_METHOD 0 0 0 65535 ECU_ADDRESS 0xD0001064 FORMAT "%.15" /end MEASUREMENT
/begin MEASUREMENT BypassInput_600 "" UBYTE NO_COMPU_METHOD 0 0 0 255 ECU_ADDRESS 0xD000176B FORMAT "%.15" /end MEASUREMENT
/begin MEASUREMENT BypassInput_601 "" UBYTE NO_COMPU_METHOD 0 0 0 255 ECU_ADDRESS 0xD000176C FORMAT "%.15" /end MEASUREMENT
/begin MEASUREMENT BypassInput_602 "" FLOAT32_IEEE NO_COMPU_METHOD 0 0 -3.4e+038 3.4e+038 ECU_ADDRESS 0xD00013A6 FORMAT "%.15" /end MEASUREMENT
/begin MEASUREMENT BypassInput_603 "" UBYTE NO_COMPU_METHOD 0 0 0 255 ECU_ADDRESS 0xD000176D FORMAT "%.15" /end MEASUREMENT
/begin MEASUREMENT BypassInput_604 "" UBYTE NO_COMPU_METHOD 0 0 0 255 ECU_ADDRESS 0xD000176E FORMAT "%.15" /end MEASUREMENT
/begin MEASUREMENT BypassInput_605 "" FLOAT32_IEEE NO_COMPU_METHOD 0 0 -3.4e+038 3.4e+038 ECU_ADDRESS 0xD00013AA FORMAT "%.15" /end MEASUREMENT
/begin MEASUREMENT BypassInput_606 "" UBYTE NO_COMPU_METHOD 0 0 0 255 ECU_ADDRESS 0xD000176F FORMAT "%.15" /end MEASUREMENT
/begin MEASUREMENT BypassInput_607 "" UWORD NO_COMPU_METHOD 0 0 0 65535 ECU_ADDRESS 0xD00013AE FORMAT "%.15" /end MEASUREMENT
/begin MEASUREMENT BypassInput_608 "" FLOAT32_IEEE NO_COMPU_METHOD 0 0 -3.4e+038 3.4e+038 ECU_ADDRESS 0xD00013B0 FORMAT "%.15" /end MEASUREMENT
/begin MEASUREMENT BypassInput_609 "" UBYTE NO_COMPU_METHOD 0 0 0 255 ECU_ADDRESS 0xD0001770 FORMAT "%.15" /end MEASUREMENT
/begin MEASUREMENT BypassInput_61 "" UBYTE NO_COMPU_METHOD 0 0 0 255 ECU_ADDRESS 0xD0001664 FORMAT "%.15" /end MEASUREMENT
/begin MEASUREMENT BypassInput_610 "" FLOAT32_IEEE NO_COMPU_METHOD 0 0 -3.4e+038 3.4e+038 ECU_ADDRESS 0xD00013B4 FORMAT "%.15" /end MEASUREMENT
/begin MEASUREMENT BypassInput_611 "" UBYTE NO_COMPU_METHOD 0 0 0 255 ECU_ADDRESS 0xD0001771 FORMAT "%.15" /end MEASUREMENT
/begin MEASUREMENT BypassInput_612 "" FLOAT32_IEEE NO_COMPU_METHOD 0 0 -3.4e+038 3.4e+038 ECU_ADDRESS 0xD00013B8 FORMAT "%.15" /end MEASUREMENT
/begin MEASUREMENT BypassInput_613 "" UBYTE NO_COMPU_METHOD 0 0 0 255 ECU_ADDRESS 0xD0001772 FORMAT "%.15" /end MEASUREMENT
/begin MEASUREMENT BypassInput_614 "" UWORD NO_COMPU_METHOD 0 0 0 65535 ECU_ADDRESS 0xD00013BC FORMAT "%.15" /end MEASUREMENT
/begin MEASUREMENT BypassInput_615 "" FLOAT32_IEEE NO_COMPU_METHOD 0 0 -3.4e+038 3.4e+038 ECU_ADDRESS 0xD00013BE FORMAT "%.15" /end MEASUREMENT
/begin MEASUREMENT BypassInput_616 "" UWORD NO_COMPU_METHOD 0 0 0 65535 ECU_ADDRESS 0xD00013C2 FORMAT "%.15" /end MEASUREMENT
/begin MEASUREMENT BypassInput_617 "" UBYTE NO_COMPU_METHOD 0 0 0 255 ECU_ADDRESS 0xD0001773 FORMAT "%.15" /end MEASUREMENT
/begin MEASUREMENT BypassInput_618 "" FLOAT32_IEEE NO_COMPU_METHOD 0 0 -3.4e+038 3.4e+038 ECU_ADDRESS 0xD00013C4 FORMAT "%.15" /end MEASUREMENT
/begin MEASUREMENT BypassInput_619 "" UBYTE NO_COMPU_METHOD 0 0 0 255 ECU_ADDRESS 0xD0001774 FORMAT "%.15" /end MEASUREMENT
/begin MEASUREMENT BypassInput_62 "" UBYTE NO_COMPU_METHOD 0 0 0 255 ECU_ADDRESS 0xD0001665 FORMAT "%.15" /end MEASUREMENT
/begin MEASUREMENT BypassInput_620 "" UBYTE NO_COMPU_METHOD 0 0 0 255 ECU_ADDRESS 0xD0001775 FORMAT "%.15" /end MEASUREMENT
/begin MEASUREMENT BypassInput_621 "" UBYTE NO_COMPU_METHOD 0 0 0 255 ECU_ADDRESS 0xD0001776 FORMAT "%.15" /end MEASUREMENT
/begin MEASUREMENT BypassInput_622 "" FLOAT32_IEEE NO_COMPU_METHOD 0 0 -3.4e+038 3.4e+038 ECU_ADDRESS 0xD00013C8 FORMAT "%.15" /end MEASUREMENT
/begin MEASUREMENT BypassInput_623 "" FLOAT32_IEEE NO_COMPU_METHOD 0 0 -3.4e+038 3.4e+038 ECU_ADDRESS 0xD00013CC FORMAT "%.15" /end MEASUREMENT
/begin MEASUREMENT BypassInput_624 "" FLOAT32_IEEE NO_COMPU_METHOD 0 0 -3.4e+038 3.4e+038 ECU_ADDRESS 0xD00013D0 FORMAT "%.15" /end MEASUREMENT
/begin MEASUREMENT BypassInput_625 "" FLOAT32_IEEE NO_COMPU_METHOD 0 0 -3.4e+038 3.4e+038 ECU_ADDRESS 0xD00013D4 FORMAT "%.15" /end MEASUREMENT
/begin MEASUREMENT BypassInput_626 "" UWORD NO_COMPU_METHOD 0 0 0 65535 ECU_ADDRESS 0xD00013D8 FORMAT "%.15" /end MEASUREMENT
/begin MEASUREMENT BypassInput_627 "" FLOAT32_IEEE NO_COMPU_METHOD 0 0 -3.4e+038 3.4e+038 ECU_ADDRESS 0xD00013DA FORMAT "%.15" /end MEASUREMENT
/begin MEASUREMENT BypassInput_628 "" UWORD NO_COMPU_METHOD 0 0 0 65535 ECU_ADDRESS 0xD00013DE FORMAT "%.15" /end MEASUREMENT
/begin MEASUREMENT BypassInput_629 "" UWORD NO_COMPU_METHOD 0 0 0 65535 ECU_ADDRESS 0xD00013E0 FORMAT "%.15" /end MEASUREMENT
/begin MEASUREMENT BypassInput_63 "" FLOAT32_IEEE NO_COMPU_METHOD 0 0 -3.4e+038 3.4e+038 ECU_ADDRESS 0xD0001066 FORMAT "%.15" /end MEASUREMENT
/begin MEASUREMENT BypassInput_630 "" UWORD NO_COMPU_METHOD 0 0 0 65535 ECU_ADDRESS 0xD00013E2 FORMAT "%.15" /end MEASUREMENT
/begin MEASUREMENT BypassInput_631 "" UWORD NO_COMPU_METHOD 0 0 0 65535 ECU_ADDRESS 0xD00013E4 FORMAT "%.15" /end MEASUREMENT
/begin MEASUREMENT BypassInput_632 "" UWORD NO_COMPU_METHOD 0 0 0 65535 ECU_ADDRESS 0xD00013E6 FORMAT "%.15" /end MEASUREMENT
/begin MEASUREMENT BypassInput_633 "" UWORD NO_COMPU_METHOD 0 0 0 65535 ECU_ADDRESS 0xD00013E8 FORMAT "%.15" /end MEASUREMENT
/begin MEASUREMENT BypassInput_634 "" FLOAT32_IEEE NO_COMPU_METHOD 0 0 -3.4e+038 3.4e+038 ECU_ADDRESS 0xD00013EA FORMAT "%.15" /end MEASUREMENT
/begin MEASUREMENT BypassInput_635 "" FLOAT32_IEEE NO_COMPU_METHOD 0 0 -3.4e+038 3.4e+038 ECU_ADDRESS 0xD00013EE FORMAT "%.15" /end MEASUREMENT
/begin MEASUREMENT BypassInput_636 "" FLOAT32_IEEE NO_COMPU_METHOD 0 0 -3.4e+038 3.4e+038 ECU_ADDRESS 0xD00013F2 FORMAT "%.15" /end MEASUREMENT
/begin MEASUREMENT BypassInput_637 "" FLOAT32_IEEE NO_COMPU_METHOD 0 0 -3.4e+038 3.4e+038 ECU_ADDRESS 0xD00013F6 FORMAT "%.15" /end MEASUREMENT
/begin MEASUREMENT BypassInput_638 "" FLOAT32_IEEE NO_COMPU_METHOD 0 0 -3.4e+038 3.4e+038 ECU_ADDRESS 0xD00013FA FORMAT "%.15" /end MEASUREMENT
/begin MEASUREMENT BypassInput_639 "" FLOAT32_IEEE NO_COMPU_METHOD 0 0 -3.4e+038 3.4e+038 ECU_ADDRESS 0xD00013FE FORMAT "%.15" /end MEASUREMENT
/begin MEASUREMENT BypassInput_64 "" UBYTE NO_COMPU_METHOD 0 0 0 255 ECU_ADDRESS 0xD0001666 FORMAT "%.15" /end MEASUREMENT
/begin MEASUREMENT BypassInput_65 "" UWORD NO_COMPU_METHOD 0 0 0 65535 ECU_ADDRESS 0xD000106A FORMAT "%.15" /end MEASUREMENT
/begin MEASUREMENT BypassInput_66 "" FLOAT32_IEEE NO_COMPU_METHOD 0 0 -3.4e+038 3.4e+038 ECU_ADDRESS 0xD000106C FORMAT "%.15" /end MEASUREMENT
/begin MEASUREMENT BypassInput_67 "" UBYTE NO_COMPU_METHOD 0 0 0 255 ECU_ADDRESS 0xD0001667 FORMAT "%.15" /end MEASUREMENT
/begin MEASUREMENT BypassInput_68 "" UBYTE NO_COMPU_METHOD 0 0 0 255 ECU_ADDRESS 0xD0001668 FORMAT "%.15" /end MEASUREMENT
/begin MEASUREMENT BypassInput_69 "" UBYTE NO_COMPU_METHOD 0 0 0 255 ECU_ADDRESS 0xD0001669 FORMAT "%.15" /end MEASUREMENT
/begin MEASUREMENT BypassInput_7 "" UBYTE NO_COMPU_METHOD 0 0 0 255 ECU_ADDRESS 0xD0001645 FORMAT "%.15" /end MEASUREMENT
/begin MEASUREMENT BypassInput_70 "" UWORD NO_COMPU_METHOD 0 0 0 65535 ECU_ADDRESS 0xD0001070 FORMAT "%.15" /end MEASUREMENT
/begin MEASUREMENT BypassInput_71 "" UBYTE NO_COMPU_METHOD 0 0 0 255 ECU_ADDRESS 0xD000166A FORMAT "%.15" /end MEASUREMENT
/begin MEASUREMENT BypassInput_72 "" UBYTE NO_COMPU_METHOD 0 0 0 255 ECU_ADDRESS 0xD000166B FORMAT "%.15" /end MEASUREMENT
/begin MEASUREMENT BypassInput_73 "" UWORD NO_COMPU_METHOD 0 0 0 65535 ECU_ADDRESS 0xD0001072 FORMAT "%.15" /end MEASUREMENT
/begin MEASUREMENT BypassInput_74 "" UBYTE NO_COMPU_METHOD 0 0 0 255 ECU_ADDRESS 0xD000166C FORMAT "%.15" /end MEASUREMENT
/begin MEASUREMENT BypassInput_75 "" UBYTE NO_COMPU_METHOD 0 0 0 255 ECU_ADDRESS 0xD000166D FORMAT "%.15" /end MEASUREMENT
/begin MEASUREMENT BypassInput_76 "" FLOAT32_IEEE NO_COMPU_METHOD 0 0 -3.4e+038 3.4e+038 ECU_ADDRESS 0xD0001074 FORMAT "%.15" /end MEASUREMENT
/begin MEASUREMENT BypassInput_77 "" UWORD NO_COMPU_METHOD 0 0 0 65535 ECU_ADDRESS 0xD0001078 FORMAT "%.15" /end MEASUREMENT
/begin MEASUREMENT BypassInput_78 "" FLOAT32_IEEE NO_COMPU_METHOD 0 0 -3.4e+038 3.4e+038 ECU_ADDRESS 0xD000107A FORMAT "%.15" /end MEASUREMENT
/begin MEASUREMENT BypassInput_79 "" UBYTE NO_COMPU_METHOD 0 0 0 255 ECU_ADDRESS 0xD000166E FORMAT "%.15" /end MEASUREMENT
/begin MEASUREMENT BypassInput_8 "" UWORD NO_COMPU_METHOD 0 0 0 65535 ECU_ADDRESS 0xD0001022 FORMAT "%.15" /end MEASUREMENT
/begin MEASUREMENT BypassInput_80 "" UBYTE NO_COMPU_METHOD 0 0 0 255 ECU_ADDRESS 0xD000166F FORMAT "%.15" /end MEASUREMENT
/begin MEASUREMENT BypassInput_81 "" UBYTE NO_COMPU_METHOD 0 0 0 255 ECU_ADDRESS 0xD0001670 FORMAT "%.15" /end MEASUREMENT
/begin MEASUREMENT BypassInput_82 "" UWORD NO_COMPU_METHOD 0 0 0 65535 ECU_ADDRESS 0xD000107E FORMAT "%.15" /end MEASUREMENT
/begin MEASUREMENT BypassInput_83 "" FLOAT32_IEEE NO_COMPU_METHOD 0 0 -3.4e+038 3.4e+038 ECU_ADDRESS 0xD0001080 FORMAT "%.15" /end MEASUREMENT
/begin MEASUREMENT BypassInput_84 "" UBYTE NO_COMPU_METHOD 0 0 0 255 ECU_ADDRESS 0xD0001671 FORMAT "%.15" /end MEASUREMENT
/begin MEASUREMENT BypassInput_85 "" FLOAT32_IEEE NO_COMPU_METHOD 0 0 -3.4e+038 3.4e+038 ECU_ADDRESS 0xD0001084 FORMAT "%.15" /end MEASUREMENT
/begin MEASUREMENT BypassInput_86 "" UWORD NO_COMPU_METHOD 0 0 0 65535 ECU_ADDRESS 0xD0001088 FORMAT "%.15" /end MEASUREMENT
/begin MEASUREMENT BypassInput_87 "" UWORD NO_COMPU_METHOD 0 0 0 65535 ECU_ADDRESS 0xD000108A FORMAT "%.15" /end MEASUREMENT
/begin MEASUREMENT BypassInput_88 "" FLOAT32_IEEE NO_COMPU_METHOD 0 0 -3.4e+038 3.4e+038 ECU_ADDRESS 0xD000108C FORMAT "%.15" /end MEASUREMENT
/begin MEASUREMENT BypassInput_89 "" UWORD NO_COMPU_METHOD 0 0 0 65535 ECU_ADDRESS 0xD0001090 FORMAT "%.15" /end MEASUREMENT
/begin MEASUREMENT BypassInput_9 "" FLOAT32_IEEE NO_COMPU_METHOD 0 0 -3.4e+038 3.4e+038 ECU_ADDRESS 0xD0001024 FORMAT "%.15" /end MEASUREMENT
/begin MEASUREMENT BypassInput_90 "" FLOAT32_IEEE NO_COMPU_METHOD 0 0 -3.4e+038 3.4e+038 ECU_ADDRESS 0xD0001092 FORMAT "%.15" /end MEASUREMENT
/begin MEASUREMENT BypassInput_91 "" FLOAT32_IEEE NO_COMPU_METHOD 0 0 -3.4e+038 3.4e+038 ECU_ADDRESS 0xD0001096 FORMAT "%.15" /end MEASUREMENT
/begin MEASUREMENT BypassInput_92 "" FLOAT32_IEEE NO_COMPU_METHOD 0 0 -3.4e+038 3.4e+038 ECU_ADDRESS 0xD000109A FORMAT "%.15" /end MEASUREMENT
/begin MEASUREMENT BypassInput_93 "" UWORD NO_COMPU_METHOD 0 0 0 65535 ECU_ADDRESS 0xD000109E FORMAT "%.15" /end MEASUREMENT
/begin MEASUREMENT BypassInput_94 "" FLOAT32_IEEE NO_COMPU_METHOD 0 0 -3.4e+038 3.4e+038 ECU_ADDRESS 0xD00010A0 FORMAT "%.15" /end MEASUREMENT
/begin MEASUREMENT BypassInput_95 "" UWORD NO_COMPU_METHOD 0 0 0 65535 ECU_ADDRESS 0xD00010A4 FORMAT "%.15" /end MEASUREMENT
/begin MEASUREMENT BypassInput_96 "" UBYTE NO_COMPU_METHOD 0 0 0 255 ECU_ADDRESS 0xD0001672 FORMAT "%.15" /end MEASUREMENT
/begin MEASUREMENT BypassInput_97 "" UWORD NO_COMPU_METHOD 0 0 0 65535 ECU_ADDRESS 0xD00010A6 FORMAT "%.15" /end MEASUREMENT
/begin MEASUREMENT BypassInput_98 "" UWORD NO_COMPU_METHOD 0 0 0 65535 ECU_ADDRESS 0xD00010A8 FORMAT "%.15" /end MEASUREMENT
/begin MEASUREMENT BypassInput_99 "" UBYTE NO_COMPU_METHOD 0 0 0 255 ECU_ADDRESS 0xD0001673 FORMAT "%.15" /end MEASUREMENT
/begin MEASUREMENT BypassOutput_1 "" UBYTE NO_COMPU_METHOD 0 0 0 255 READ_WRITE ECU_ADDRESS 0xD0001777 FORMAT "%.15" /end MEASUREMENT
/begin MEASUREMENT BypassOutput_10 "" FLOAT32_IEEE NO_COMPU_METHOD 0 0 -3.4e+038 3.4e+038 READ_WRITE ECU_ADDRESS 0xD000140A FORMAT "%.15" /end MEASUREMENT
/begin MEASUREMENT BypassOutput_100 "" UWORD NO_COMPU_METHOD 0 0 0 65535 READ_WRITE ECU_ADDRESS 0xD00014A8 FORMAT "%.15" /end MEASUREMENT
/begin MEASUREMENT BypassOutput_101 "" FLOAT32_IEEE NO_COMPU_METHOD 0 0 -3.4e+038 3.4e+038 READ_WRITE ECU_ADDRESS 0xD00014AA FORMAT "%.15" /end MEASUREMENT
/begin MEASUREMENT BypassOutput_102 "" UWORD NO_COMPU_METHOD 0 0 0 65535 READ_WRITE ECU_ADDRESS 0xD00014AE FORMAT "%.15" /end MEASUREMENT
/begin MEASUREMENT BypassOutput_103 "" FLOAT32_IEEE NO_COMPU_METHOD 0 0 -3.4e+038 3.4e+038 READ_WRITE ECU_ADDRESS 0xD00014B0 FORMAT "%.15" /end MEASUREMENT
/begin MEASUREMENT BypassOutput_104 "" UBYTE NO_COMPU_METHOD 0 0 0 255 READ_WRITE ECU_ADDRESS 0xD00017A2 FORMAT "%.15" /end MEASUREMENT
/begin MEASUREMENT BypassOutput_105 "" FLOAT32_IEEE NO_COMPU_METHOD 0 0 -3.4e+038 3.4e+038 READ_WRITE ECU_ADDRESS 0xD00014B4 FORMAT "%.15" /end MEASUREMENT
/begin MEASUREMENT BypassOutput_106 "" UBYTE NO_COMPU_METHOD 0 0 0 255 READ_WRITE ECU_ADDRESS 0xD00017A3 FORMAT "%.15" /end MEASUREMENT
/begin MEASUREMENT BypassOutput_107 "" UBYTE NO_COMPU_METHOD 0 0 0 255 READ_WRITE ECU_ADDRESS 0xD00017A4 FORMAT "%.15" /end MEASUREMENT
/begin MEASUREMENT BypassOutput_108 "" UBYTE NO_COMPU_METHOD 0 0 0 255 READ_WRITE ECU_ADDRESS 0xD00017A5 FORMAT "%.15" /end MEASUREMENT
/begin MEASUREMENT BypassOutput_109 "" UWORD NO_COMPU_METHOD 0 0 0 65535 READ_WRITE ECU_ADDRESS 0xD00014B8 FORMAT "%.15" /end MEASUREMENT
/begin MEASUREMENT BypassOutput_11 "" UBYTE NO_COMPU_METHOD 0 0 0 255 READ_WRITE ECU_ADDRESS 0xD000177D FORMAT "%.15" /end MEASUREMENT
/begin MEASUREMENT BypassOutput_110 "" UBYTE NO_COMPU_METHOD 0 0 0 255 READ_WRITE ECU_ADDRESS 0xD00017A6 FORMAT "%.15" /end MEASUREMENT
/begin MEASUREMENT BypassOutput_111 "" FLOAT32_IEEE NO_COMPU_METHOD 0 0 -3.4e+038 3.4e+038 READ_WRITE ECU_ADDRESS 0xD00014BA FORMAT "%.15" /end MEASUREMENT
/begin MEASUREMENT BypassOutput_112 "" FLOAT32_IEEE NO_COMPU_METHOD 0 0 -3.4e+038 3.4e+038 READ_WRITE ECU_ADDRESS 0xD00014BE FORMAT "%.15" /end MEASUREMENT
/begin MEASUREMENT BypassOutput_113 "" UBYTE NO_COMPU_METHOD 0 0 0 255 READ_WRITE ECU_ADDRESS 0xD00017A7 FORMAT "%.15" /end MEASUREMENT
/begin MEASUREMENT BypassOutput_114 "" UBYTE NO_COMPU_METHOD 0 0 0 255 READ_WRITE ECU_ADDRESS 0xD00017A8 FORMAT "%.15" /end MEASUREMENT
/begin MEASUREMENT BypassOutput_115 "" UBYTE NO_COMPU_METHOD 0 0 0 255 READ_WRITE ECU_ADDRESS 0xD00017A9 FORMAT "%.15" /end MEASUREMENT
/begin MEASUREMENT BypassOutput_116 "" UWORD NO_COMPU_METHOD 0 0 0 65535 READ_WRITE ECU_ADDRESS 0xD00014C2 FORMAT "%.15" /end MEASUREMENT
/begin MEASUREMENT BypassOutput_117 "" UWORD NO_COMPU_METHOD 0 0 0 65535 READ_WRITE ECU_ADDRESS 0xD00014C4 FORMAT "%.15" /end MEASUREMENT
/begin MEASUREMENT BypassOutput_118 "" UWORD NO_COMPU_METHOD 0 0 0 65535 READ_WRITE ECU_ADDRESS 0xD00014C6 FORMAT "%.15" /end MEASUREMENT
/begin MEASUREMENT BypassOutput_119 "" UBYTE NO_COMPU_METHOD 0 0 0 255 READ_WRITE ECU_ADDRESS 0xD00017AA FORMAT "%.15" /end MEASUREMENT
/begin MEASUREMENT BypassOutput_12 "" FLOAT32_IEEE NO_COMPU_METHOD 0 0 -3.4e+038 3.4e+038 READ_WRITE ECU_ADDRESS 0xD000140E FORMAT "%.15" /end MEASUREMENT
/begin MEASUREMENT BypassOutput_120 "" FLOAT32_IEEE NO_COMPU_METHOD 0 0 -3.4e+038 3.4e+038 READ_WRITE ECU_ADDRESS 0xD00014C8 FORMAT "%.15" /end MEASUREMENT
/begin MEASUREMENT BypassOutput_121 "" UBYTE NO_COMPU_METHOD 0 0 0 255 READ_WRITE ECU_ADDRESS 0xD00017AB FORMAT "%.15" /end MEASUREMENT
/begin MEASUREMENT BypassOutput_122 "" UBYTE NO_COMPU_METHOD 0 0 0 255 READ_WRITE ECU_ADDRESS 0xD00017AC FORMAT "%.15" /end MEASUREMENT
/begin MEASUREMENT BypassOutput_123 "" FLOAT32_IEEE NO_COMPU_METHOD 0 0 -3.4e+038 3.4e+038 READ_WRITE ECU_ADDRESS 0xD00014CC FORMAT "%.15" /end MEASUREMENT
/begin MEASUREMENT BypassOutput_124 "" UBYTE NO_COMPU_METHOD 0 0 0 255 READ_WRITE ECU_ADDRESS 0xD00017AD FORMAT "%.15" /end MEASUREMENT
/begin MEASUREMENT BypassOutput_125 "" UBYTE NO_COMPU_METHOD 0 0 0 255 READ_WRITE ECU_ADDRESS 0xD00017AE FORMAT "%.15" /end MEASUREMENT
/begin MEASUREMENT BypassOutput_126 "" UBYTE NO_COMPU_METHOD 0 0 0 255 READ_WRITE ECU_ADDRESS 0xD00017AF FORMAT "%.15" /end MEASUREMENT
/begin MEASUREMENT BypassOutput_127 "" UBYTE NO_COMPU_METHOD 0 0 0 255 READ_WRITE ECU_ADDRESS 0xD00017B0 FORMAT "%.15" /end MEASUREMENT
/begin MEASUREMENT BypassOutput_128 "" FLOAT32_IEEE NO_COMPU_METHOD 0 0 -3.4e+038 3.4e+038 READ_WRITE ECU_ADDRESS 0xD00014D0 FORMAT "%.15" /end MEASUREMENT
/begin MEASUREMENT BypassOutput_129 "" UBYTE NO_COMPU_METHOD 0 0 0 255 READ_WRITE ECU_ADDRESS 0xD00017B1 FORMAT "%.15" /end MEASUREMENT
/begin MEASUREMENT BypassOutput_13 "" UWORD NO_COMPU_METHOD 0 0 0 65535 READ_WRITE ECU_ADDRESS 0xD0001412 FORMAT "%.15" /end MEASUREMENT
/begin MEASUREMENT BypassOutput_130 "" UBYTE NO_COMPU_METHOD 0 0 0 255 READ_WRITE ECU_ADDRESS 0xD00017B2 FORMAT "%.15" /end MEASUREMENT
/begin MEASUREMENT BypassOutput_131 "" FLOAT32_IEEE NO_COMPU_METHOD 0 0 -3.4e+038 3.4e+038 READ_WRITE ECU_ADDRESS 0xD00014D4 FORMAT "%.15" /end MEASUREMENT
/begin MEASUREMENT BypassOutput_132 "" UBYTE NO_COMPU_METHOD 0 0 0 255 READ_WRITE ECU_ADDRESS 0xD00017B3 FORMAT "%.15" /end MEASUREMENT
/begin MEASUREMENT BypassOutput_133 "" UBYTE NO_COMPU_METHOD 0 0 0 255 READ_WRITE ECU_ADDRESS 0xD00017B4 FORMAT "%.15" /end MEASUREMENT
/begin MEASUREMENT BypassOutput_134 "" UBYTE NO_COMPU_METHOD 0 0 0 255 READ_WRITE ECU_ADDRESS 0xD00017B5 FORMAT "%.15" /end MEASUREMENT
/begin MEASUREMENT BypassOutput_135 "" UWORD NO_COMPU_METHOD 0 0 0 65535 READ_WRITE ECU_ADDRESS 0xD00014D8 FORMAT "%.15" /end MEASUREMENT
/begin MEASUREMENT BypassOutput_136 "" FLOAT32_IEEE NO_COMPU_METHOD 0 0 -3.4e+038 3.4e+038 READ_WRITE ECU_ADDRESS 0xD00014DA FORMAT "%.15" /end MEASUREMENT
/begin MEASUREMENT BypassOutput_137 "" UBYTE NO_COMPU_METHOD 0 0 0 255 READ_WRITE ECU_ADDRESS 0xD00017B6 FORMAT "%.15" /end MEASUREMENT
/begin MEASUREMENT BypassOutput_138 "" UWORD NO_COMPU_METHOD 0 0 0 65535 READ_WRITE ECU_ADDRESS 0xD00014DE FORMAT "%.15" /end MEASUREMENT
/begin MEASUREMENT BypassOutput_139 "" FLOAT32_IEEE NO_COMPU_METHOD 0 0 -3.4e+038 3.4e+038 READ_WRITE ECU_ADDRESS 0xD00014E0 FORMAT "%.15" /end MEASUREMENT
/begin MEASUREMENT BypassOutput_14 "" FLOAT32_IEEE NO_COMPU_METHOD 0 0 -3.4e+038 3.4e+038 READ_WRITE ECU_ADDRESS 0xD0001414 FORMAT "%.15" /end MEASUREMENT
/begin MEASUREMENT BypassOutput_140 "" UBYTE NO_COMPU_METHOD 0 0 0 255 READ_WRITE ECU_ADDRESS 0xD00017B7 FORMAT "%.15" /end MEASUREMENT
/begin MEASUREMENT BypassOutput_141 "" UBYTE NO_COMPU_METHOD 0 0 0 255 READ_WRITE ECU_ADDRESS 0xD00017B8 FORMAT "%.15" /end MEASUREMENT
/begin MEASUREMENT BypassOutput_142 "" UWORD NO_COMPU_METHOD 0 0 0 65535 READ_WRITE ECU_ADDRESS 0xD00014E4 FORMAT "%.15" /end MEASUREMENT
/begin MEASUREMENT BypassOutput_143 "" FLOAT32_IEEE NO_COMPU_METHOD 0 0 -3.4e+038 3.4e+038 READ_WRITE ECU_ADDRESS 0xD00014E6 FORMAT "%.15" /end MEASUREMENT
/begin MEASUREMENT BypassOutput_144 "" UBYTE NO_COMPU_METHOD 0 0 0 255 READ_WRITE ECU_ADDRESS 0xD00017B9 FORMAT "%.15" /end MEASUREMENT
/begin MEASUREMENT BypassOutput_145 "" UWORD NO_COMPU_METHOD 0 0 0 65535 READ_WRITE ECU_ADDRESS 0xD00014EA FORMAT "%.15" /end MEASUREMENT
/begin MEASUREMENT BypassOutput_146 "" UWORD NO_COMPU_METHOD 0 0 0 65535 READ_WRITE ECU_ADDRESS 0xD00014EC FORMAT "%.15" /end MEASUREMENT
/begin MEASUREMENT BypassOutput_147 "" UBYTE NO_COMPU_METHOD 0 0 0 255 READ_WRITE ECU_ADDRESS 0xD00017BA FORMAT "%.15" /end MEASUREMENT
/begin MEASUREMENT BypassOutput_148 "" FLOAT32_IEEE NO_COMPU_METHOD 0 0 -3.4e+038 3.4e+038 READ_WRITE ECU_ADDRESS 0xD00014EE FORMAT "%.15" /end MEASUREMENT
/begin MEASUREMENT BypassOutput_149 "" UBYTE NO_COMPU_METHOD 0 0 0 255 READ_WRITE ECU_ADDRESS 0xD00017BB FORMAT "%.15" /end MEASUREMENT
/begin MEASUREMENT BypassOutput_15 "" UBYTE NO_COMPU_METHOD 0 0 0 255 READ_WRITE ECU_ADDRESS 0xD000177E FORMAT "%.15" /end MEASUREMENT
/begin MEASUREMENT BypassOutput_150 "" UWORD NO_COMPU_METHOD 0 0 0 65535 READ_WRITE ECU_ADDRESS 0xD00014F2 FORMAT "%.15" /end MEASUREMENT
/begin MEASUREMENT BypassOutput_151 "" UBYTE NO_COMPU_METHOD 0 0 0 255 READ_WRITE ECU_ADDRESS 0xD00017BC FORMAT "%.15" /end MEASUREMENT
/begin MEASUREMENT BypassOutput_152 "" UWORD NO_COMPU_METHOD 0 0 0 65535 READ_WRITE ECU_ADDRESS 0xD00014F4 FORMAT "%.15" /end MEASUREMENT
/begin MEASUREMENT BypassOutput_153 "" UBYTE NO_COMPU_METHOD 0 0 0 255 READ_WRITE ECU_ADDRESS 0xD00017BD FORMAT "%.15" /end MEASUREMENT
/begin MEASUREMENT BypassOutput_154 "" UBYTE NO_COMPU_METHOD 0 0 0 255 READ_WRITE ECU_ADDRESS 0xD00017BE FORMAT "%.15" /end MEASUREMENT
/begin MEASUREMENT BypassOutput_155 "" UBYTE NO_COMPU_METHOD 0 0 0 255 READ_WRITE ECU_ADDRESS 0xD00017BF FORMAT "%.15" /end MEASUREMENT
/begin MEASUREMENT BypassOutput_156 "" UWORD NO_COMPU_METHOD 0 0 0 65535 READ_WRITE ECU_ADDRESS 0xD00014F6 FORMAT "%.15" /end MEASUREMENT
/begin MEASUREMENT BypassOutput_157 "" FLOAT32_IEEE NO_COMPU_METHOD 0 0 -3.4e+038 3.4e+038 READ_WRITE ECU_ADDRESS 0xD00014F8 FORMAT "%.15" /end MEASUREMENT
/begin MEASUREMENT BypassOutput_158 "" UBYTE NO_COMPU_METHOD 0 0 0 255 READ_WRITE ECU_ADDRESS 0xD00017C0 FORMAT "%.15" /end MEASUREMENT
/begin MEASUREMENT BypassOutput_159 "" FLOAT32_IEEE NO_COMPU_METHOD 0 0 -3.4e+038 3.4e+038 READ_WRITE ECU_ADDRESS 0xD00014FC FORMAT "%.15" /end MEASUREMENT
/begin MEASUREMENT BypassOutput_16 "" UBYTE NO_COMPU_METHOD 0 0 0 255 READ_WRITE ECU_ADDRESS 0xD000177F FORMAT "%.15" /end MEASUREMENT
/begin MEASUREMENT BypassOutput_160 "" UBYTE NO_COMPU_METHOD 0 0 0 255 READ_WRITE ECU_ADDRESS 0xD00017C1 FORMAT "%.15" /end MEASUREMENT
/begin MEASUREMENT BypassOutput_161 "" UWORD NO_COMPU_METHOD 0 0 0 65535 READ_WRITE ECU_ADDRESS 0xD0001500 FORMAT "%.15" /end MEASUREMENT
/begin MEASUREMENT BypassOutput_162 "" UBYTE NO_COMPU_METHOD 0 0 0 255 READ_WRITE ECU_ADDRESS 0xD00017C2 FORMAT "%.15" /end MEASUREMENT
/begin MEASUREMENT BypassOutput_163 "" UBYTE NO_COMPU_METHOD 0 0 0 255 READ_WRITE ECU_ADDRESS 0xD00017C3 FORMAT "%.15" /end MEASUREMENT
/begin MEASUREMENT BypassOutput_164 "" UBYTE NO_COMPU_METHOD 0 0 0 255 READ_WRITE ECU_ADDRESS 0xD00017C4 FORMAT "%.15" /end MEASUREMENT
/begin MEASUREMENT BypassOutput_165 "" FLOAT32_IEEE NO_COMPU_METHOD 0 0 -3.4e+038 3.4e+038 READ_WRITE ECU_ADDRESS 0xD0001502 FORMAT "%.15" /end MEASUREMENT
/begin MEASUREMENT BypassOutput_166 "" UBYTE NO_COMPU_METHOD 0 0 0 255 READ_WRITE ECU_ADDRESS 0xD00017C5 FORMAT "%.15" /end MEASUREMENT
/begin MEASUREMENT BypassOutput_167 "" UWORD NO_COMPU_METHOD 0 0 0 65535 READ_WRITE ECU_ADDRESS 0xD0001506 FORMAT "%.15" /end MEASUREMENT
/begin MEASUREMENT BypassOutput_168 "" FLOAT32_IEEE NO_COMPU_METHOD 0 0 -3.4e+038 3.4e+038 READ_WRITE ECU_ADDRESS 0xD0001508 FORMAT "%.15" /end MEASUREMENT
/begin MEASUREMENT BypassOutput_169 "" UBYTE NO_COMPU_METHOD 0 0 0 255 READ_WRITE ECU_ADDRESS 0xD00017C6 FORMAT "%.15" /end MEASUREMENT
/begin MEASUREMENT BypassOutput_17 "" UBYTE NO_COMPU_METHOD 0 0 0 255 READ_WRITE ECU_ADDRESS 0xD0001780 FORMAT "%.15" /end MEASUREMENT
/begin MEASUREMENT BypassOutput_170 "" UWORD NO_COMPU_METHOD 0 0 0 65535 READ_WRITE ECU_ADDRESS 0xD000150C FORMAT "%.15" /end MEASUREMENT
/begin MEASUREMENT BypassOutput_171 "" FLOAT32_IEEE NO_COMPU_METHOD 0 0 -3.4e+038 3.4e+038 READ_WRITE ECU_ADDRESS 0xD000150E FORMAT "%.15" /end MEASUREMENT
/begin MEASUREMENT BypassOutput_172 "" UBYTE NO_COMPU_METHOD 0 0 0 255 READ_WRITE ECU_ADDRESS 0xD00017C7 FORMAT "%.15" /end MEASUREMENT
/begin MEASUREMENT BypassOutput_173 "" FLOAT32_IEEE NO_COMPU_METHOD 0 0 -3.4e+038 3.4e+038 READ_WRITE ECU_ADDRESS 0xD0001512 FORMAT "%.15" /end MEASUREMENT
/begin MEASUREMENT BypassOutput_174 "" FLOAT32_IEEE NO_COMPU_METHOD 0 0 -3.4e+038 3.4e+038 READ_WRITE ECU_ADDRESS 0xD0001516 FORMAT "%.15" /end MEASUREMENT
/begin MEASUREMENT BypassOutput_175 "" UWORD NO_COMPU_METHOD 0 0 0 65535 READ_WRITE ECU_ADDRESS 0xD000151A FORMAT "%.15" /end MEASUREMENT
/begin MEASUREMENT BypassOutput_176 "" FLOAT32_IEEE NO_COMPU_METHOD 0 0 -3.4e+038 3.4e+038 READ_WRITE ECU_ADDRESS 0xD000151C FORMAT "%.15" /end MEASUREMENT
/begin MEASUREMENT BypassOutput_177 "" FLOAT32_IEEE NO_COMPU_METHOD 0 0 -3.4e+038 3.4e+038 READ_WRITE ECU_ADDRESS 0xD0001520 FORMAT "%.15" /end MEASUREMENT
/begin MEASUREMENT BypassOutput_178 "" FLOAT32_IEEE NO_COMPU_METHOD 0 0 -3.4e+038 3.4e+038 READ_WRITE ECU_ADDRESS 0xD0001524 FORMAT "%.15" /end MEASUREMENT
/begin MEASUREMENT BypassOutput_179 "" UWORD NO_COMPU_METHOD 0 0 0 65535 READ_WRITE ECU_ADDRESS 0xD0001528 FORMAT "%.15" /end MEASUREMENT
/begin MEASUREMENT BypassOutput_18 "" FLOAT32_IEEE NO_COMPU_METHOD 0 0 -3.4e+038 3.4e+038 READ_WRITE ECU_ADDRESS 0xD0001418 FORMAT "%.15" /end MEASUREMENT
/begin MEASUREMENT BypassOutput_180 "" FLOAT32_IEEE NO_COMPU_METHOD 0 0 -3.4e+038 3.4e+038 READ_WRITE ECU_ADDRESS 0xD000152A FORMAT "%.15" /end MEASUREMENT
/begin MEASUREMENT BypassOutput_181 "" FLOAT32_IEEE NO_COMPU_METHOD 0 0 -3.4e+038 3.4e+038 READ_WRITE ECU_ADDRESS 0xD000152E FORMAT "%.15" /end MEASUREMENT
/begin MEASUREMENT BypassOutput_182 "" UWORD NO_COMPU_METHOD 0 0 0 65535 READ_WRITE ECU_ADDRESS 0xD0001532 FORMAT "%.15" /end MEASUREMENT
/begin MEASUREMENT BypassOutput_183 "" FLOAT32_IEEE NO_COMPU_METHOD 0 0 -3.4e+038 3.4e+038 READ_WRITE ECU_ADDRESS 0xD0001534 FORMAT "%.15" /end MEASUREMENT
/begin MEASUREMENT BypassOutput_184 "" UWORD NO_COMPU_METHOD 0 0 0 65535 READ_WRITE ECU_ADDRESS 0xD0001538 FORMAT "%.15" /end MEASUREMENT
/begin MEASUREMENT BypassOutput_185 "" FLOAT32_IEEE NO_COMPU_METHOD 0 0 -3.4e+038 3.4e+038 READ_WRITE ECU_ADDRESS 0xD000153A FORMAT "%.15" /end MEASUREMENT
/begin MEASUREMENT BypassOutput_186 "" FLOAT32_IEEE NO_COMPU_METHOD 0 0 -3.4e+038 3.4e+038 READ_WRITE ECU_ADDRESS 0xD000153E FORMAT "%.15" /end MEASUREMENT
/begin MEASUREMENT BypassOutput_187 "" FLOAT32_IEEE NO_COMPU_METHOD 0 0 -3.4e+038 3.4e+038 READ_WRITE ECU_ADDRESS 0xD0001542 FORMAT "%.15" /end MEASUREMENT
/begin MEASUREMENT BypassOutput_188 "" FLOAT32_IEEE NO_COMPU_METHOD 0 0 -3.4e+038 3.4e+038 READ_WRITE ECU_ADDRESS 0xD0001546 FORMAT "%.15" /end MEASUREMENT
/begin MEASUREMENT BypassOutput_189 "" FLOAT32_IEEE NO_COMPU_METHOD 0 0 -3.4e+038 3.4e+038 READ_WRITE ECU_ADDRESS 0xD000154A FORMAT "%.15" /end MEASUREMENT
/begin MEASUREMENT BypassOutput_19 "" UBYTE NO_COMPU_METHOD 0 0 0 255 READ_WRITE ECU_ADDRESS 0xD0001781 FORMAT "%.15" /end MEASUREMENT
/begin MEASUREMENT BypassOutput_190 "" FLOAT32_IEEE NO_COMPU_METHOD 0 0 -3.4e+038 3.4e+038 READ_WRITE ECU_ADDRESS 0xD000154E FORMAT "%.15" /end MEASUREMENT
/begin MEASUREMENT BypassOutput_191 "" FLOAT32_IEEE NO_COMPU_METHOD 0 0 -3.4e+038 3.4e+038 READ_WRITE ECU_ADDRESS 0xD0001552 FORMAT "%.15" /end MEASUREMENT
/begin MEASUREMENT BypassOutput_192 "" FLOAT32_IEEE NO_COMPU_METHOD 0 0 -3.4e+038 3.4e+038 READ_WRITE ECU_ADDRESS 0xD0001556 FORMAT "%.15" /end MEASUREMENT
/begin MEASUREMENT BypassOutput_193 "" FLOAT32_IEEE NO_COMPU_METHOD 0 0 -3.4e+038 3.4e+038 READ_WRITE ECU_ADDRESS 0xD000155A FORMAT "%.15" /end MEASUREMENT
/begin MEASUREMENT BypassOutput_194 "" UWORD NO_COMPU_METHOD 0 0 0 65535 READ_WRITE ECU_ADDRESS 0xD000155E FORMAT "%.15" /end MEASUREMENT
/begin MEASUREMENT BypassOutput_195 "" UWORD NO_COMPU_METHOD 0 0 0 65535 READ_WRITE ECU_ADDRESS 0xD0001560 FORMAT "%.15" /end MEASUREMENT
/begin MEASUREMENT BypassOutput_196 "" FLOAT32_IEEE NO_COMPU_METHOD 0 0 -3.4e+038 3.4e+038 READ_WRITE ECU_ADDRESS 0xD0001562 FORMAT "%.15" /end MEASUREMENT
/begin MEASUREMENT BypassOutput_197 "" UWORD NO_COMPU_METHOD 0 0 0 65535 READ_WRITE ECU_ADDRESS 0xD0001566 FORMAT "%.15" /end MEASUREMENT
/begin MEASUREMENT BypassOutput_198 "" FLOAT32_IEEE NO_COMPU_METHOD 0 0 -3.4e+038 3.4e+038 READ_WRITE ECU_ADDRESS 0xD0001568 FORMAT "%.15" /end MEASUREMENT
/begin MEASUREMENT BypassOutput_199 "" FLOAT32_IEEE NO_COMPU_METHOD 0 0 -3.4e+038 3.4e+038 READ_WRITE ECU_ADDRESS 0xD000156C FORMAT "%.15" /end MEASUREMENT
/begin MEASUREMENT BypassOutput_2 "" UBYTE NO_COMPU_METHOD 0 0 0 255 READ_WRITE ECU_ADDRESS 0xD0001778 FORMAT "%.15" /end MEASUREMENT
/begin MEASUREMENT BypassOutput_20 "" UWORD NO_COMPU_METHOD 0 0 0 65535 READ_WRITE ECU_ADDRESS 0xD000141C FORMAT "%.15" /end MEASUREMENT
/begin MEASUREMENT BypassOutput_200 "" UWORD NO_COMPU_METHOD 0 0 0 65535 READ_WRITE ECU_ADDRESS 0xD0001570 FORMAT "%.15" /end MEASUREMENT
/begin MEASUREMENT BypassOutput_201 "" FLOAT32_IEEE NO_COMPU_METHOD 0 0 -3.4e+038 3.4e+038 READ_WRITE ECU_ADDRESS 0xD0001572 FORMAT "%.15" /end MEASUREMENT
/begin MEASUREMENT BypassOutput_202 "" UWORD NO_COMPU_METHOD 0 0 0 65535 READ_WRITE ECU_ADDRESS 0xD0001576 FORMAT "%.15" /end MEASUREMENT
/begin MEASUREMENT BypassOutput_203 "" UWORD NO_COMPU_METHOD 0 0 0 65535 READ_WRITE ECU_ADDRESS 0xD0001578 FORMAT "%.15" /end MEASUREMENT
/begin MEASUREMENT BypassOutput_204 "" FLOAT32_IEEE NO_COMPU_METHOD 0 0 -3.4e+038 3.4e+038 READ_WRITE ECU_ADDRESS 0xD000157A FORMAT "%.15" /end MEASUREMENT
/begin MEASUREMENT BypassOutput_205 "" UWORD NO_COMPU_METHOD 0 0 0 65535 READ_WRITE ECU_ADDRESS 0xD000157E FORMAT "%.15" /end MEASUREMENT
/begin MEASUREMENT BypassOutput_206 "" UWORD NO_COMPU_METHOD 0 0 0 65535 READ_WRITE ECU_ADDRESS 0xD0001580 FORMAT "%.15" /end MEASUREMENT
/begin MEASUREMENT BypassOutput_207 "" FLOAT32_IEEE NO_COMPU_METHOD 0 0 -3.4e+038 3.4e+038 READ_WRITE ECU_ADDRESS 0xD0001582 FORMAT "%.15" /end MEASUREMENT
/begin MEASUREMENT BypassOutput_208 "" FLOAT32_IEEE NO_COMPU_METHOD 0 0 -3.4e+038 3.4e+038 READ_WRITE ECU_ADDRESS 0xD0001586 FORMAT "%.15" /end MEASUREMENT
/begin MEASUREMENT BypassOutput_209 "" UWORD NO_COMPU_METHOD 0 0 0 65535 READ_WRITE ECU_ADDRESS 0xD000158A FORMAT "%.15" /end MEASUREMENT
/begin MEASUREMENT BypassOutput_21 "" UBYTE NO_COMPU_METHOD 0 0 0 255 READ_WRITE ECU_ADDRESS 0xD0001782 FORMAT "%.15" /end MEASUREMENT
/begin MEASUREMENT BypassOutput_210 "" UWORD NO_COMPU_METHOD 0 0 0 65535 READ_WRITE ECU_ADDRESS 0xD000158C FORMAT "%.15" /end MEASUREMENT
/begin MEASUREMENT BypassOutput_211 "" FLOAT32_IEEE NO_COMPU_METHOD 0 0 -3.4e+038 3.4e+038 READ_WRITE ECU_ADDRESS 0xD000158E FORMAT "%.15" /end MEASUREMENT
/begin MEASUREMENT BypassOutput_212 "" UWORD NO_COMPU_METHOD 0 0 0 65535 READ_WRITE ECU_ADDRESS 0xD0001592 FORMAT "%.15" /end MEASUREMENT
/begin MEASUREMENT BypassOutput_213 "" UWORD NO_COMPU_METHOD 0 0 0 65535 READ_WRITE ECU_ADDRESS 0xD0001594 FORMAT "%.15" /end MEASUREMENT
/begin MEASUREMENT BypassOutput_214 "" UWORD NO_COMPU_METHOD 0 0 0 65535 READ_WRITE ECU_ADDRESS 0xD0001596 FORMAT "%.15" /end MEASUREMENT
/begin MEASUREMENT BypassOutput_215 "" UWORD NO_COMPU_METHOD 0 0 0 65535 READ_WRITE ECU_ADDRESS 0xD0001598 FORMAT "%.15" /end MEASUREMENT
/begin MEASUREMENT BypassOutput_216 "" FLOAT32_IEEE NO_COMPU_METHOD 0 0 -3.4e+038 3.4e+038 READ_WRITE ECU_ADDRESS 0xD000159A FORMAT "%.15" /end MEASUREMENT
/begin MEASUREMENT BypassOutput_217 "" UWORD NO_COMPU_METHOD 0 0 0 65535 READ_WRITE ECU_ADDRESS 0xD000159E FORMAT "%.15" /end MEASUREMENT
/begin MEASUREMENT BypassOutput_218 "" UWORD NO_COMPU_METHOD 0 0 0 65535 READ_WRITE ECU_ADDRESS 0xD00015A0 FORMAT "%.15" /end MEASUREMENT
/begin MEASUREMENT BypassOutput_219 "" FLOAT32_IEEE NO_COMPU_METHOD 0 0 -3.4e+038 3.4e+038 READ_WRITE ECU_ADDRESS 0xD00015A2 FORMAT "%.15" /end MEASUREMENT
/begin MEASUREMENT BypassOutput_22 "" UBYTE NO_COMPU_METHOD 0 0 0 255 READ_WRITE ECU_ADDRESS 0xD0001783 FORMAT "%.15" /end MEASUREMENT
/begin MEASUREMENT BypassOutput_220 "" UWORD NO_COMPU_METHOD 0 0 0 65535 READ_WRITE ECU_ADDRESS 0xD00015A6 FORMAT "%.15" /end MEASUREMENT
/begin MEASUREMENT BypassOutput_221 "" UWORD NO_COMPU_METHOD 0 0 0 65535 READ_WRITE ECU_ADDRESS 0xD00015A8 FORMAT "%.15" /end MEASUREMENT
/begin MEASUREMENT BypassOutput_222 "" FLOAT32_IEEE NO_COMPU_METHOD 0 0 -3.4e+038 3.4e+038 READ_WRITE ECU_ADDRESS 0xD00015AA FORMAT "%.15" /end MEASUREMENT
/begin MEASUREMENT BypassOutput_223 "" UWORD NO_COMPU_METHOD 0 0 0 65535 READ_WRITE ECU_ADDRESS 0xD00015AE FORMAT "%.15" /end MEASUREMENT
/begin MEASUREMENT BypassOutput_224 "" UWORD NO_COMPU_METHOD 0 0 0 65535 READ_WRITE ECU_ADDRESS 0xD00015B0 FORMAT "%.15" /end MEASUREMENT
/begin MEASUREMENT BypassOutput_225 "" FLOAT32_IEEE NO_COMPU_METHOD 0 0 -3.4e+038 3.4e+038 READ_WRITE ECU_ADDRESS 0xD00015B2 FORMAT "%.15" /end MEASUREMENT
/begin MEASUREMENT BypassOutput_226 "" UWORD NO_COMPU_METHOD 0 0 0 65535 READ_WRITE ECU_ADDRESS 0xD00015B6 FORMAT "%.15" /end MEASUREMENT
/begin MEASUREMENT BypassOutput_227 "" UWORD NO_COMPU_METHOD 0 0 0 65535 READ_WRITE ECU_ADDRESS 0xD00015B8 FORMAT "%.15" /end MEASUREMENT
/begin MEASUREMENT BypassOutput_228 "" UWORD NO_COMPU_METHOD 0 0 0 65535 READ_WRITE ECU_ADDRESS 0xD00015BA FORMAT "%.15" /end MEASUREMENT
/begin MEASUREMENT BypassOutput_229 "" FLOAT32_IEEE NO_COMPU_METHOD 0 0 -3.4e+038 3.4e+038 READ_WRITE ECU_ADDRESS 0xD00015BC FORMAT "%.15" /end MEASUREMENT
/begin MEASUREMENT BypassOutput_23 "" UWORD NO_COMPU_METHOD 0 0 0 65535 READ_WRITE ECU_ADDRESS 0xD000141E FORMAT "%.15" /end MEASUREMENT
/begin MEASUREMENT BypassOutput_230 "" UWORD NO_COMPU_METHOD 0 0 0 65535 READ_WRITE ECU_ADDRESS 0xD00015C0 FORMAT "%.15" /end MEASUREMENT
/begin MEASUREMENT BypassOutput_231 "" UWORD NO_COMPU_METHOD 0 0 0 65535 READ_WRITE ECU_ADDRESS 0xD00015C2 FORMAT "%.15" /end MEASUREMENT
/begin MEASUREMENT BypassOutput_232 "" FLOAT32_IEEE NO_COMPU_METHOD 0 0 -3.4e+038 3.4e+038 READ_WRITE ECU_ADDRESS 0xD00015C4 FORMAT "%.15" /end MEASUREMENT
/begin MEASUREMENT BypassOutput_233 "" FLOAT32_IEEE NO_COMPU_METHOD 0 0 -3.4e+038 3.4e+038 READ_WRITE ECU_ADDRESS 0xD00015C8 FORMAT "%.15" /end MEASUREMENT
/begin MEASUREMENT BypassOutput_234 "" FLOAT32_IEEE NO_COMPU_METHOD 0 0 -3.4e+038 3.4e+038 READ_WRITE ECU_ADDRESS 0xD00015CC FORMAT "%.15" /end MEASUREMENT
/begin MEASUREMENT BypassOutput_235 "" FLOAT32_IEEE NO_COMPU_METHOD 0 0 -3.4e+038 3.4e+038 READ_WRITE ECU_ADDRESS 0xD00015D0 FORMAT "%.15" /end MEASUREMENT
/begin MEASUREMENT BypassOutput_236 "" FLOAT32_IEEE NO_COMPU_METHOD 0 0 -3.4e+038 3.4e+038 READ_WRITE ECU_ADDRESS 0xD00015D4 FORMAT "%.15" /end MEASUREMENT
/begin MEASUREMENT BypassOutput_237 "" UWORD NO_COMPU_METHOD 0 0 0 65535 READ_WRITE ECU_ADDRESS 0xD00015D8 FORMAT "%.15" /end MEASUREMENT
/begin MEASUREMENT BypassOutput_238 "" FLOAT32_IEEE NO_COMPU_METHOD 0 0 -3.4e+038 3.4e+038 READ_WRITE ECU_ADDRESS 0xD00015DA FORMAT "%.15" /end MEASUREMENT
/begin MEASUREMENT BypassOutput_239 "" UWORD NO_COMPU_METHOD 0 0 0 65535 READ_WRITE ECU_ADDRESS 0xD00015DE FORMAT "%.15" /end MEASUREMENT
/begin MEASUREMENT BypassOutput_24 "" FLOAT32_IEEE NO_COMPU_METHOD 0 0 -3.4e+038 3.4e+038 READ_WRITE ECU_ADDRESS 0xD0001420 FORMAT "%.15" /end MEASUREMENT
/begin MEASUREMENT BypassOutput_240 "" FLOAT32_IEEE NO_COMPU_METHOD 0 0 -3.4e+038 3.4e+038 READ_WRITE ECU_ADDRESS 0xD00015E0 FORMAT "%.15" /end MEASUREMENT
/begin MEASUREMENT BypassOutput_241 "" UWORD NO_COMPU_METHOD 0 0 0 65535 READ_WRITE ECU_ADDRESS 0xD00015E4 FORMAT "%.15" /end MEASUREMENT
/begin MEASUREMENT BypassOutput_242 "" FLOAT32_IEEE NO_COMPU_METHOD 0 0 -3.4e+038 3.4e+038 READ_WRITE ECU_ADDRESS 0xD00015E6 FORMAT "%.15" /end MEASUREMENT
/begin MEASUREMENT BypassOutput_243 "" UWORD NO_COMPU_METHOD 0 0 0 65535 READ_WRITE ECU_ADDRESS 0xD00015EA FORMAT "%.15" /end MEASUREMENT
/begin MEASUREMENT BypassOutput_244 "" FLOAT32_IEEE NO_COMPU_METHOD 0 0 -3.4e+038 3.4e+038 READ_WRITE ECU_ADDRESS 0xD00015EC FORMAT "%.15" /end MEASUREMENT
/begin MEASUREMENT BypassOutput_245 "" FLOAT32_IEEE NO_COMPU_METHOD 0 0 -3.4e+038 3.4e+038 READ_WRITE ECU_ADDRESS 0xD00015F0 FORMAT "%.15" /end MEASUREMENT
/begin MEASUREMENT BypassOutput_246 "" FLOAT32_IEEE NO_COMPU_METHOD 0 0 -3.4e+038 3.4e+038 READ_WRITE ECU_ADDRESS 0xD00015F4 FORMAT "%.15" /end MEASUREMENT
/begin MEASUREMENT BypassOutput_247 "" FLOAT32_IEEE NO_COMPU_METHOD 0 0 -3.4e+038 3.4e+038 READ_WRITE ECU_ADDRESS 0xD00015F8 FORMAT "%.15" /end MEASUREMENT
/begin MEASUREMENT BypassOutput_248 "" FLOAT32_IEEE NO_COMPU_METHOD 0 0 -3.4e+038 3.4e+038 READ_WRITE ECU_ADDRESS 0xD00015FC FORMAT "%.15" /end MEASUREMENT
/begin MEASUREMENT BypassOutput_249 "" FLOAT32_IEEE NO_COMPU_METHOD 0 0 -3.4e+038 3.4e+038 READ_WRITE ECU_ADDRESS 0xD0001600 FORMAT "%.15" /end MEASUREMENT
/begin MEASUREMENT BypassOutput_25 "" FLOAT32_IEEE NO_COMPU_METHOD 0 0 -3.4e+038 3.4e+038 READ_WRITE ECU_ADDRESS 0xD0001424 FORMAT "%.15" /end MEASUREMENT
/begin MEASUREMENT BypassOutput_250 "" FLOAT32_IEEE NO_COMPU_METHOD 0 0 -3.4e+038 3.4e+038 READ_WRITE ECU_ADDRESS 0xD0001604 FORMAT "%.15" /end MEASUREMENT
/begin MEASUREMENT BypassOutput_251 "" FLOAT32_IEEE NO_COMPU_METHOD 0 0 -3.4e+038 3.4e+038 READ_WRITE ECU_ADDRESS 0xD0001608 FORMAT "%.15" /end MEASUREMENT
/begin MEASUREMENT BypassOutput_252 "" FLOAT32_IEEE NO_COMPU_METHOD 0 0 -3.4e+038 3.4e+038 READ_WRITE ECU_ADDRESS 0xD000160C FORMAT "%.15" /end MEASUREMENT
/begin MEASUREMENT BypassOutput_253 "" FLOAT32_IEEE NO_COMPU_METHOD 0 0 -3.4e+038 3.4e+038 READ_WRITE ECU_ADDRESS 0xD0001610 FORMAT "%.15" /end MEASUREMENT
/begin MEASUREMENT BypassOutput_254 "" FLOAT32_IEEE NO_COMPU_METHOD 0 0 -3.4e+038 3.4e+038 READ_WRITE ECU_ADDRESS 0xD0001614 FORMAT "%.15" /end MEASUREMENT
/begin MEASUREMENT BypassOutput_255 "" FLOAT32_IEEE NO_COMPU_METHOD 0 0 -3.4e+038 3.4e+038 READ_WRITE ECU_ADDRESS 0xD0001618 FORMAT "%.15" /end MEASUREMENT
/begin MEASUREMENT BypassOutput_256 "" FLOAT32_IEEE NO_COMPU_METHOD 0 0 -3.4e+038 3.4e+038 READ_WRITE ECU_ADDRESS 0xD000161C FORMAT "%.15" /end MEASUREMENT
/begin MEASUREMENT BypassOutput_257 "" FLOAT32_IEEE NO_COMPU_METHOD 0 0 -3.4e+038 3.4e+038 READ_WRITE ECU_ADDRESS 0xD0001620 FORMAT "%.15" /end MEASUREMENT
/begin MEASUREMENT BypassOutput_258 "" FLOAT32_IEEE NO_COMPU_METHOD 0 0 -3.4e+038 3.4e+038 READ_WRITE ECU_ADDRESS 0xD0001624 FORMAT "%.15" /end MEASUREMENT
/begin MEASUREMENT BypassOutput_259 "" FLOAT32_IEEE NO_COMPU_METHOD 0 0 -3.4e+038 3.4e+038 READ_WRITE ECU_ADDRESS 0xD0001628 FORMAT "%.15" /end MEASUREMENT
/begin MEASUREMENT BypassOutput_26 "" UBYTE NO_COMPU_METHOD 0 0 0 255 READ_WRITE ECU_ADDRESS 0xD0001784 FORMAT "%.15" /end MEASUREMENT
/begin MEASUREMENT BypassOutput_260 "" FLOAT32_IEEE NO_COMPU_METHOD 0 0 -3.4e+038 3.4e+038 READ_WRITE ECU_ADDRESS 0xD000162C FORMAT "%.15" /end MEASUREMENT
/begin MEASUREMENT BypassOutput_261 "" FLOAT32_IEEE NO_COMPU_METHOD 0 0 -3.4e+038 3.4e+038 READ_WRITE ECU_ADDRESS 0xD0001630 FORMAT "%.15" /end MEASUREMENT
/begin MEASUREMENT BypassOutput_262 "" FLOAT32_IEEE NO_COMPU_METHOD 0 0 -3.4e+038 3.4e+038 READ_WRITE ECU_ADDRESS 0xD0001634 FORMAT "%.15" /end MEASUREMENT
/begin MEASUREMENT BypassOutput_263 "" FLOAT32_IEEE NO_COMPU_METHOD 0 0 -3.4e+038 3.4e+038 READ_WRITE ECU_ADDRESS 0xD0001638 FORMAT "%.15" /end MEASUREMENT
/begin MEASUREMENT BypassOutput_264 "" FLOAT32_IEEE NO_COMPU_METHOD 0 0 -3.4e+038 3.4e+038 READ_WRITE ECU_ADDRESS 0xD000163C FORMAT "%.15" /end MEASUREMENT
/begin MEASUREMENT BypassOutput_265 "" FLOAT32_IEEE NO_COMPU_METHOD 0 0 -3.4e+038 3.4e+038 READ_WRITE ECU_ADDRESS 0xD0001640 FORMAT "%.15" /end MEASUREMENT
/begin MEASUREMENT BypassOutput_27 "" FLOAT32_IEEE NO_COMPU_METHOD 0 0 -3.4e+038 3.4e+038 READ_WRITE ECU_ADDRESS 0xD0001428 FORMAT "%.15" /end MEASUREMENT
/begin MEASUREMENT BypassOutput_28 "" UWORD NO_COMPU_METHOD 0 0 0 65535 READ_WRITE ECU_ADDRESS 0xD000142C FORMAT "%.15" /end MEASUREMENT
/begin MEASUREMENT BypassOutput_29 "" UBYTE NO_COMPU_METHOD 0 0 0 255 READ_WRITE ECU_ADDRESS 0xD0001785 FORMAT "%.15" /end MEASUREMENT
/begin MEASUREMENT BypassOutput_3 "" UBYTE NO_COMPU_METHOD 0 0 0 255 READ_WRITE ECU_ADDRESS 0xD0001779 FORMAT "%.15" /end MEASUREMENT
/begin MEASUREMENT BypassOutput_30 "" UWORD NO_COMPU_METHOD 0 0 0 65535 READ_WRITE ECU_ADDRESS 0xD000142E FORMAT "%.15" /end MEASUREMENT
/begin MEASUREMENT BypassOutput_31 "" UBYTE NO_COMPU_METHOD 0 0 0 255 READ_WRITE ECU_ADDRESS 0xD0001786 FORMAT "%.15" /end MEASUREMENT
/begin MEASUREMENT BypassOutput_32 "" UWORD NO_COMPU_METHOD 0 0 0 65535 READ_WRITE ECU_ADDRESS 0xD0001430 FORMAT "%.15" /end MEASUREMENT
/begin MEASUREMENT BypassOutput_33 "" FLOAT32_IEEE NO_COMPU_METHOD 0 0 -3.4e+038 3.4e+038 READ_WRITE ECU_ADDRESS 0xD0001432 FORMAT "%.15" /end MEASUREMENT
/begin MEASUREMENT BypassOutput_34 "" UWORD NO_COMPU_METHOD 0 0 0 65535 READ_WRITE ECU_ADDRESS 0xD0001436 FORMAT "%.15" /end MEASUREMENT
/begin MEASUREMENT BypassOutput_35 "" UBYTE NO_COMPU_METHOD 0 0 0 255 READ_WRITE ECU_ADDRESS 0xD0001787 FORMAT "%.15" /end MEASUREMENT
/begin MEASUREMENT BypassOutput_36 "" UBYTE NO_COMPU_METHOD 0 0 0 255 READ_WRITE ECU_ADDRESS 0xD0001788 FORMAT "%.15" /end MEASUREMENT
/begin MEASUREMENT BypassOutput_37 "" UBYTE NO_COMPU_METHOD 0 0 0 255 READ_WRITE ECU_ADDRESS 0xD0001789 FORMAT "%.15" /end MEASUREMENT
/begin MEASUREMENT BypassOutput_38 "" UWORD NO_COMPU_METHOD 0 0 0 65535 READ_WRITE ECU_ADDRESS 0xD0001438 FORMAT "%.15" /end MEASUREMENT
/begin MEASUREMENT BypassOutput_39 "" FLOAT32_IEEE NO_COMPU_METHOD 0 0 -3.4e+038 3.4e+038 READ_WRITE ECU_ADDRESS 0xD000143A FORMAT "%.15" /end MEASUREMENT
/begin MEASUREMENT BypassOutput_4 "" UBYTE NO_COMPU_METHOD 0 0 0 255 READ_WRITE ECU_ADDRESS 0xD000177A FORMAT "%.15" /end MEASUREMENT
/begin MEASUREMENT BypassOutput_40 "" UBYTE NO_COMPU_METHOD 0 0 0 255 READ_WRITE ECU_ADDRESS 0xD000178A FORMAT "%.15" /end MEASUREMENT
/begin MEASUREMENT BypassOutput_41 "" FLOAT32_IEEE NO_COMPU_METHOD 0 0 -3.4e+038 3.4e+038 READ_WRITE ECU_ADDRESS 0xD000143E FORMAT "%.15" /end MEASUREMENT
/begin MEASUREMENT BypassOutput_42 "" UWORD NO_COMPU_METHOD 0 0 0 65535 READ_WRITE ECU_ADDRESS 0xD0001442 FORMAT "%.15" /end MEASUREMENT
/begin MEASUREMENT BypassOutput_43 "" UBYTE NO_COMPU_METHOD 0 0 0 255 READ_WRITE ECU_ADDRESS 0xD000178B FORMAT "%.15" /end MEASUREMENT
/begin MEASUREMENT BypassOutput_44 "" UBYTE NO_COMPU_METHOD 0 0 0 255 READ_WRITE ECU_ADDRESS 0xD000178C FORMAT "%.15" /end MEASUREMENT
/begin MEASUREMENT BypassOutput_45 "" UWORD NO_COMPU_METHOD 0 0 0 65535 READ_WRITE ECU_ADDRESS 0xD0001444 FORMAT "%.15" /end MEASUREMENT
/begin MEASUREMENT BypassOutput_46 "" UWORD NO_COMPU_METHOD 0 0 0 65535 READ_WRITE ECU_ADDRESS 0xD0001446 FORMAT "%.15" /end MEASUREMENT
/begin MEASUREMENT BypassOutput_47 "" UBYTE NO_COMPU_METHOD 0 0 0 255 READ_WRITE ECU_ADDRESS 0xD000178D FORMAT "%.15" /end MEASUREMENT
/begin MEASUREMENT BypassOutput_48 "" UWORD NO_COMPU_METHOD 0 0 0 65535 READ_WRITE ECU_ADDRESS 0xD0001448 FORMAT "%.15" /end MEASUREMENT
/begin MEASUREMENT BypassOutput_49 "" UWORD NO_COMPU_METHOD 0 0 0 65535 READ_WRITE ECU_ADDRESS 0xD000144A FORMAT "%.15" /end MEASUREMENT
/begin MEASUREMENT BypassOutput_5 "" UWORD NO_COMPU_METHOD 0 0 0 65535 READ_WRITE ECU_ADDRESS 0xD0001402 FORMAT "%.15" /end MEASUREMENT
/begin MEASUREMENT BypassOutput_50 "" UBYTE NO_COMPU_METHOD 0 0 0 255 READ_WRITE ECU_ADDRESS 0xD000178E FORMAT "%.15" /end MEASUREMENT
/begin MEASUREMENT BypassOutput_51 "" FLOAT32_IEEE NO_COMPU_METHOD 0 0 -3.4e+038 3.4e+038 READ_WRITE ECU_ADDRESS 0xD000144C FORMAT "%.15" /end MEASUREMENT
/begin MEASUREMENT BypassOutput_52 "" UWORD NO_COMPU_METHOD 0 0 0 65535 READ_WRITE ECU_ADDRESS 0xD0001450 FORMAT "%.15" /end MEASUREMENT
/begin MEASUREMENT BypassOutput_53 "" UBYTE NO_COMPU_METHOD 0 0 0 255 READ_WRITE ECU_ADDRESS 0xD000178F FORMAT "%.15" /end MEASUREMENT
/begin MEASUREMENT BypassOutput_54 "" FLOAT32_IEEE NO_COMPU_METHOD 0 0 -3.4e+038 3.4e+038 READ_WRITE ECU_ADDRESS 0xD0001452 FORMAT "%.15" /end MEASUREMENT
/begin MEASUREMENT BypassOutput_55 "" UWORD NO_COMPU_METHOD 0 0 0 65535 READ_WRITE ECU_ADDRESS 0xD0001456 FORMAT "%.15" /end MEASUREMENT
/begin MEASUREMENT BypassOutput_56 "" FLOAT32_IEEE NO_COMPU_METHOD 0 0 -3.4e+038 3.4e+038 READ_WRITE ECU_ADDRESS 0xD0001458 FORMAT "%.15" /end MEASUREMENT
/begin MEASUREMENT BypassOutput_57 "" UWORD NO_COMPU_METHOD 0 0 0 65535 READ_WRITE ECU_ADDRESS 0xD000145C FORMAT "%.15" /end MEASUREMENT
/begin MEASUREMENT BypassOutput_58 "" UBYTE NO_COMPU_METHOD 0 0 0 255 READ_WRITE ECU_ADDRESS 0xD0001790 FORMAT "%.15" /end MEASUREMENT
/begin MEASUREMENT BypassOutput_59 "" UBYTE NO_COMPU_METHOD 0 0 0 255 READ_WRITE ECU_ADDRESS 0xD0001791 FORMAT "%.15" /end MEASUREMENT
/begin MEASUREMENT BypassOutput_6 "" UBYTE NO_COMPU_METHOD 0 0 0 255 READ_WRITE ECU_ADDRESS 0xD000177B FORMAT "%.15" /end MEASUREMENT
/begin MEASUREMENT BypassOutput_60 "" UBYTE NO_COMPU_METHOD 0 0 0 255 READ_WRITE ECU_ADDRESS 0xD0001792 FORMAT "%.15" /end MEASUREMENT
/begin MEASUREMENT BypassOutput_61 "" UWORD NO_COMPU_METHOD 0 0 0 65535 READ_WRITE ECU_ADDRESS 0xD000145E FORMAT "%.15" /end MEASUREMENT
/begin MEASUREMENT BypassOutput_62 "" UWORD NO_COMPU_METHOD 0 0 0 65535 READ_WRITE ECU_ADDRESS 0xD0001460 FORMAT "%.15" /end MEASUREMENT
/begin MEASUREMENT BypassOutput_63 "" FLOAT32_IEEE NO_COMPU_METHOD 0 0 -3.4e+038 3.4e+038 READ_WRITE ECU_ADDRESS 0xD0001462 FORMAT "%.15" /end MEASUREMENT
/begin MEASUREMENT BypassOutput_64 "" FLOAT32_IEEE NO_COMPU_METHOD 0 0 -3.4e+038 3.4e+038 READ_WRITE ECU_ADDRESS 0xD0001466 FORMAT "%.15" /end MEASUREMENT
/begin MEASUREMENT BypassOutput_65 "" UBYTE NO_COMPU_METHOD 0 0 0 255 READ_WRITE ECU_ADDRESS 0xD0001793 FORMAT "%.15" /end MEASUREMENT
/begin MEASUREMENT BypassOutput_66 "" UBYTE NO_COMPU_METHOD 0 0 0 255 READ_WRITE ECU_ADDRESS 0xD0001794 FORMAT "%.15" /end MEASUREMENT
/begin MEASUREMENT BypassOutput_67 "" UWORD NO_COMPU_METHOD 0 0 0 65535 READ_WRITE ECU_ADDRESS 0xD000146A FORMAT "%.15" /end MEASUREMENT
/begin MEASUREMENT BypassOutput_68 "" FLOAT32_IEEE NO_COMPU_METHOD 0 0 -3.4e+038 3.4e+038 READ_WRITE ECU_ADDRESS 0xD000146C FORMAT "%.15" /end MEASUREMENT
/begin MEASUREMENT BypassOutput_69 "" FLOAT32_IEEE NO_COMPU_METHOD 0 0 -3.4e+038 3.4e+038 READ_WRITE ECU_ADDRESS 0xD0001470 FORMAT "%.15" /end MEASUREMENT
/begin MEASUREMENT BypassOutput_7 "" UWORD NO_COMPU_METHOD 0 0 0 65535 READ_WRITE ECU_ADDRESS 0xD0001404 FORMAT "%.15" /end MEASUREMENT
/begin MEASUREMENT BypassOutput_70 "" UBYTE NO_COMPU_METHOD 0 0 0 255 READ_WRITE ECU_ADDRESS 0xD0001795 FORMAT "%.15" /end MEASUREMENT
/begin MEASUREMENT BypassOutput_71 "" UBYTE NO_COMPU_METHOD 0 0 0 255 READ_WRITE ECU_ADDRESS 0xD0001796 FORMAT "%.15" /end MEASUREMENT
/begin MEASUREMENT BypassOutput_72 "" FLOAT32_IEEE NO_COMPU_METHOD 0 0 -3.4e+038 3.4e+038 READ_WRITE ECU_ADDRESS 0xD0001474 FORMAT "%.15" /end MEASUREMENT
/begin MEASUREMENT BypassOutput_73 "" UBYTE NO_COMPU_METHOD 0 0 0 255 READ_WRITE ECU_ADDRESS 0xD0001797 FORMAT "%.15" /end MEASUREMENT
/begin MEASUREMENT BypassOutput_74 "" FLOAT32_IEEE NO_COMPU_METHOD 0 0 -3.4e+038 3.4e+038 READ_WRITE ECU_ADDRESS 0xD0001478 FORMAT "%.15" /end MEASUREMENT
/begin MEASUREMENT BypassOutput_75 "" UWORD NO_COMPU_METHOD 0 0 0 65535 READ_WRITE ECU_ADDRESS 0xD000147C FORMAT "%.15" /end MEASUREMENT
/begin MEASUREMENT BypassOutput_76 "" FLOAT32_IEEE NO_COMPU_METHOD 0 0 -3.4e+038 3.4e+038 READ_WRITE ECU_ADDRESS 0xD000147E FORMAT "%.15" /end MEASUREMENT
/begin MEASUREMENT BypassOutput_77 "" UWORD NO_COMPU_METHOD 0 0 0 65535 READ_WRITE ECU_ADDRESS 0xD0001482 FORMAT "%.15" /end MEASUREMENT
/begin MEASUREMENT BypassOutput_78 "" UBYTE NO_COMPU_METHOD 0 0 0 255 READ_WRITE ECU_ADDRESS 0xD0001798 FORMAT "%.15" /end MEASUREMENT
/begin MEASUREMENT BypassOutput_79 "" FLOAT32_IEEE NO_COMPU_METHOD 0 0 -3.4e+038 3.4e+038 READ_WRITE ECU_ADDRESS 0xD0001484 FORMAT "%.15" /end MEASUREMENT
/begin MEASUREMENT BypassOutput_8 "" FLOAT32_IEEE NO_COMPU_METHOD 0 0 -3.4e+038 3.4e+038 READ_WRITE ECU_ADDRESS 0xD0001406 FORMAT "%.15" /end MEASUREMENT
/begin MEASUREMENT BypassOutput_80 "" UBYTE NO_COMPU_METHOD 0 0 0 255 READ_WRITE ECU_ADDRESS 0xD0001799 FORMAT "%.15" /end MEASUREMENT
/begin MEASUREMENT BypassOutput_81 "" UWORD NO_COMPU_METHOD 0 0 0 65535 READ_WRITE ECU_ADDRESS 0xD0001488 FORMAT "%.15" /end MEASUREMENT
/begin MEASUREMENT BypassOutput_82 "" UBYTE NO_COMPU_METHOD 0 0 0 255 READ_WRITE ECU_ADDRESS 0xD000179A FORMAT "%.15" /end MEASUREMENT
/begin MEASUREMENT BypassOutput_83 "" UWORD NO_COMPU_METHOD 0 0 0 65535 READ_WRITE ECU_ADDRESS 0xD000148A FORMAT "%.15" /end MEASUREMENT
/begin MEASUREMENT BypassOutput_84 "" UWORD NO_COMPU_METHOD 0 0 0 65535 READ_WRITE ECU_ADDRESS 0xD000148C FORMAT "%.15" /end MEASUREMENT
/begin MEASUREMENT BypassOutput_85 "" UBYTE NO_COMPU_METHOD 0 0 0 255 READ_WRITE ECU_ADDRESS 0xD000179B FORMAT "%.15" /end MEASUREMENT
/begin MEASUREMENT BypassOutput_86 "" UBYTE NO_COMPU_METHOD 0 0 0 255 READ_WRITE ECU_ADDRESS 0xD000179C FORMAT "%.15" /end MEASUREMENT
/begin MEASUREMENT BypassOutput_87 "" UBYTE NO_COMPU_METHOD 0 0 0 255 READ_WRITE ECU_ADDRESS 0xD000179D FORMAT "%.15" /end MEASUREMENT
/begin MEASUREMENT BypassOutput_88 "" UBYTE NO_COMPU_METHOD 0 0 0 255 READ_WRITE ECU_ADDRESS 0xD000179E FORMAT "%.15" /end MEASUREMENT
/begin MEASUREMENT BypassOutput_89 "" FLOAT32_IEEE NO_COMPU_METHOD 0 0 -3.4e+038 3.4e+038 READ_WRITE ECU_ADDRESS 0xD000148E FORMAT "%.15" /end MEASUREMENT
/begin MEASUREMENT BypassOutput_9 "" UBYTE NO_COMPU_METHOD 0 0 0 255 READ_WRITE ECU_ADDRESS 0xD000177C FORMAT "%.15" /end MEASUREMENT
/begin MEASUREMENT BypassOutput_90 "" UWORD NO_COMPU_METHOD 0 0 0 65535 READ_WRITE ECU_ADDRESS 0xD0001492 FORMAT "%.15" /end MEASUREMENT
/begin MEASUREMENT BypassOutput_91 "" FLOAT32_IEEE NO_COMPU_METHOD 0 0 -3.4e+038 3.4e+038 READ_WRITE ECU_ADDRESS 0xD0001494 FORMAT "%.15" /end MEASUREMENT
/begin MEASUREMENT BypassOutput_92 "" FLOAT32_IEEE NO_COMPU_METHOD 0 0 -3.4e+038 3.4e+038 READ_WRITE ECU_ADDRESS 0xD0001498 FORMAT "%.15" /end MEASUREMENT
/begin MEASUREMENT BypassOutput_93 "" UWORD NO_COMPU_METHOD 0 0 0 65535 READ_WRITE ECU_ADDRESS 0xD000149C FORMAT "%.15" /end MEASUREMENT
/begin MEASUREMENT BypassOutput_94 "" FLOAT32_IEEE NO_COMPU_METHOD 0 0 -3.4e+038 3.4e+038 READ_WRITE ECU_ADDRESS 0xD000149E FORMAT "%.15" /end MEASUREMENT
/begin MEASUREMENT BypassOutput_95 "" FLOAT32_IEEE NO_COMPU_METHOD 0 0 -3.4e+038 3.4e+038 READ_WRITE ECU_ADDRESS 0xD00014A2 FORMAT "%.15" /end MEASUREMENT
/begin MEASUREMENT BypassOutput_96 "" UBYTE NO_COMPU_METHOD 0 0 0 255 READ_WRITE ECU_ADDRESS 0xD000179F FORMAT "%.15" /end MEASUREMENT
/begin MEASUREMENT BypassOutput_97 "" UWORD NO_COMPU_METHOD 0 0 0 65535 READ_WRITE ECU_ADDRESS 0xD00014A6 FORMAT "%.15" /end MEASUREMENT
/begin MEASUREMENT BypassOutput_98 "" UBYTE NO_COMPU_METHOD 0 0 0 255 READ_WRITE ECU_ADDRESS 0xD00017A0 FORMAT "%.15" /end MEASUREMENT
/begin MEASUREMENT BypassOutput_99 "" UBYTE NO_COMPU_METHOD 0 0 0 255 READ_WRITE ECU_ADDRESS 0xD00017A1 FORMAT "%.15" /end MEASUREMENT
/begin CHARACTERISTIC Test_D8000000 "Test value in external RAM.\n\n" VALUE 0xD8000000 __ULONG_S 0 NO_COMPU_METHOD 0 4294967295 FORMAT "%.15" /end CHARACTERISTIC
/begin MEASUREMENT TraceLoad "VX1000 trace load in %" UBYTE NO_COMPU_METHOD 0 0 0 100 ECU_ADDRESS 0x92000080 ECU_ADDRESS_EXTENSION 0xFD FORMAT "%.15" PHYS_UNIT "%" /end MEASUREMENT
/begin MEASUREMENT adc "" FLOAT32_IEEE NO_COMPU_METHOD 0 0 0 1 READ_WRITE ECU_ADDRESS 0xD00017DA FORMAT "%.15" /end MEASUREMENT
/begin CHARACTERISTIC adc_ampl "Amplification for adc " VALUE 0xA0080010 __FLOAT32_IEEE_S 0 NO_COMPU_METHOD 0 1 FORMAT "%.15" /end CHARACTERISTIC
/begin CHARACTERISTIC adc_filter "Filter strength for adc" VALUE 0xA0080014 __FLOAT32_IEEE_S 0 NO_COMPU_METHOD 0 1 FORMAT "%.15" /end CHARACTERISTIC
/begin MEASUREMENT adc_raw "" UWORD NO_COMPU_METHOD 0 0 0 4096 ECU_ADDRESS 0xD00017D8 FORMAT "%.15" /end MEASUREMENT
/begin MEASUREMENT adc_task_counter "" ULONG NO_COMPU_METHOD 0 0 0 4294967295 ECU_ADDRESS 0xD00017D4 FORMAT "%.15"
 /begin IF_DATA XCP
  /begin DAQ_EVENT FIXED_EVENT_LIST EVENT 0x0 /end DAQ_EVENT
 /end IF_DATA
/end MEASUREMENT
/begin MEASUREMENT adc_task_cycle "Cycletime for ADC Task\n\nDefault is 10ms" ULONG NO_COMPU_METHOD 0 0 20 1000000 READ_WRITE ECU_ADDRESS 0xD00017CC FORMAT "%.15"
 /begin IF_DATA XCP
  /begin DAQ_EVENT FIXED_EVENT_LIST EVENT 0x0 /end DAQ_EVENT
 /end IF_DATA
/end MEASUREMENT
/begin CHARACTERISTIC adc_task_timeout "Timeout for ADC Task\n\nUsed as Bypass timeout" VALUE 0xD00017D0 __ULONG_S 0 NO_COMPU_METHOD 0 4294967295 FORMAT "%.15" /end CHARACTERISTIC
/begin MEASUREMENT clock "" ULONG NO_COMPU_METHOD 0 0 0 4294967295 ECU_ADDRESS 0xD0001000 FORMAT "%.15" /end MEASUREMENT
/begin MEASUREMENT clock_adc "" ULONG NO_COMPU_METHOD 0 0 0 4294967295 ECU_ADDRESS 0xD0001004 FORMAT "%.15"
 /begin IF_DATA XCP
  /begin DAQ_EVENT FIXED_EVENT_LIST EVENT 0x0 /end DAQ_EVENT
 /end IF_DATA
/end MEASUREMENT
/begin MEASUREMENT clock_background "" ULONG NO_COMPU_METHOD 0 0 0 4294967295 ECU_ADDRESS 0xD0001008 FORMAT "%.15"
 /begin IF_DATA XCP
  /begin DAQ_EVENT FIXED_EVENT_LIST EVENT 0x1 /end DAQ_EVENT
 /end IF_DATA
/end MEASUREMENT
/begin MEASUREMENT gVX1000.Stim.Enable "" UWORD NO_COMPU_METHOD 0 0 0 65535 ECU_ADDRESS 0xD00021B8 FORMAT "%.15" /end MEASUREMENT
/begin MEASUREMENT gVX1000.Stim.TimeoutCtr "" UWORD NO_COMPU_METHOD 0 0 0 65535 ECU_ADDRESS 0xD00021BA FORMAT "%.15" /end MEASUREMENT
/begin MEASUREMENT gVX1000.Stim.TimeoutCtr2 "" UWORD NO_COMPU_METHOD 0 0 0 65535 ECU_ADDRESS 0xD00021BC FORMAT "%.15" /end MEASUREMENT
/begin MEASUREMENT gVX1000.ToolCtrlState "" ULONG NO_COMPU_METHOD 0 0 0 4294967295 ECU_ADDRESS 0xD0002104 FORMAT "%.15" /end MEASUREMENT
/begin MEASUREMENT gVX1000.ToolDetectState "" ULONG NO_COMPU_METHOD 0 0 0 4294967295 ECU_ADDRESS 0xD00020F4 FORMAT "%.15" /end MEASUREMENT
/begin MEASUREMENT gVX1000_OLDA_Duration._0_ "" ULONG SYSTEM_TIMER0_45MHz 0 0 0 10 ECU_ADDRESS 0xD00021C0 /end MEASUREMENT
/begin MEASUREMENT gVX1000_OLDA_Duration._1_ "" ULONG SYSTEM_TIMER0_45MHz 0 0 0 10 ECU_ADDRESS 0xD00021C4 /end MEASUREMENT
/begin MEASUREMENT gVX1000_OLDA_Duration._2_ "" ULONG SYSTEM_TIMER0_45MHz 0 0 0 10 ECU_ADDRESS 0xD00021C8 /end MEASUREMENT
/begin MEASUREMENT gVX1000_OLDA_Duration._3_ "" ULONG SYSTEM_TIMER0_45MHz 0 0 0 10 ECU_ADDRESS 0xD00021CC /end MEASUREMENT
/begin MEASUREMENT gVX1000_OLDA_TransferCount._0_ "" ULONG NO_COMPU_METHOD 0 0 0 4294967295 ECU_ADDRESS 0xD00022B8 FORMAT "%.15" /end MEASUREMENT
/begin MEASUREMENT gVX1000_OLDA_TransferCount._1_ "" ULONG NO_COMPU_METHOD 0 0 0 4294967295 ECU_ADDRESS 0xD00022BC FORMAT "%.15" /end MEASUREMENT
/begin MEASUREMENT gVX1000_OLDA_TransferCount._2_ "" ULONG NO_COMPU_METHOD 0 0 0 4294967295 ECU_ADDRESS 0xD00022C0 FORMAT "%.15" /end MEASUREMENT
/begin MEASUREMENT gVX1000_OLDA_TransferCount._3_ "" ULONG NO_COMPU_METHOD 0 0 0 4294967295 ECU_ADDRESS 0xD00022C4 FORMAT "%.15" /end MEASUREMENT
/begin MEASUREMENT gVX1000_OLDA_TransferSize._0_ "" ULONG NO_COMPU_METHOD 0 0 0 4294967295 ECU_ADDRESS 0xD000223C FORMAT "%.15" /end MEASUREMENT
/begin MEASUREMENT gVX1000_OLDA_TransferSize._1_ "" ULONG NO_COMPU_METHOD 0 0 0 4294967295 ECU_ADDRESS 0xD0002240 FORMAT "%.15" /end MEASUREMENT
/begin MEASUREMENT gVX1000_OLDA_TransferSize._2_ "" ULONG NO_COMPU_METHOD 0 0 0 4294967295 ECU_ADDRESS 0xD0002244 FORMAT "%.15" /end MEASUREMENT
/begin MEASUREMENT gVX1000_OLDA_TransferSize._3_ "" ULONG NO_COMPU_METHOD 0 0 0 4294967295 ECU_ADDRESS 0xD0002248 FORMAT "%.15" /end MEASUREMENT
/begin MEASUREMENT gVX1000_STIM_Duration._0_ "" ULONG SYSTEM_TIMER0_45MHz 0 0 0 5000 ECU_ADDRESS 0xD0002334 /end MEASUREMENT
/begin MEASUREMENT gVX1000_STIM_Duration._1_ "" ULONG SYSTEM_TIMER0_45MHz 0 0 0 5000 ECU_ADDRESS 0xD0002338 /end MEASUREMENT
/begin MEASUREMENT gVX1000_STIM_Duration._2_ "" ULONG SYSTEM_TIMER0_45MHz 0 0 0 5000 ECU_ADDRESS 0xD000233C /end MEASUREMENT
/begin MEASUREMENT gVX1000_STIM_Duration._3_ "" ULONG SYSTEM_TIMER0_45MHz 0 0 0 5000 ECU_ADDRESS 0xD0002340 /end MEASUREMENT
/begin CHARACTERISTIC gVX1000_STIM_Histogram "" CURVE 0xD00023B4 __ULONG_Z 0 NO_COMPU_METHOD 0 1000
 /begin AXIS_DESCR FIX_AXIS NO_INPUT_QUANTITY NO_COMPU_METHOD 256 0 5100 READ_ONLY FORMAT "%.15" FIX_AXIS_PAR_DIST 0 20 256 /end AXIS_DESCR
 FORMAT "%.15" /end CHARACTERISTIC
/begin CHARACTERISTIC gVX1000_STIM_Histogram2 "" CURVE 0xD00027B4 __ULONG_Z 0 NO_COMPU_METHOD 0 1000
 /begin AXIS_DESCR FIX_AXIS NO_INPUT_QUANTITY NO_COMPU_METHOD 256 0 255 READ_ONLY FORMAT "%.15" FIX_AXIS_PAR_DIST 0 1 256 /end AXIS_DESCR
 FORMAT "%.15" /end CHARACTERISTIC
/begin MEASUREMENT led_counter "" ULONG NO_COMPU_METHOD 0 0 0 4294967295 ECU_ADDRESS 0xD00017C8 FORMAT "%.15"
 /begin IF_DATA XCP
  /begin DAQ_EVENT VARIABLE /begin AVAILABLE_EVENT_LIST EVENT 0x0 EVENT 0x1 /end AVAILABLE_EVENT_LIST /begin DEFAULT_EVENT_LIST EVENT 0x1 /end DEFAULT_EVENT_LIST /end DAQ_EVENT
 /end IF_DATA
/end MEASUREMENT
/begin CHARACTERISTIC led_pattern "Pattern for Evaluation Board LEDs" CURVE 0xA0080000 __UBYTE_Z 0 NO_COMPU_METHOD 0 255
 /begin AXIS_DESCR FIX_AXIS NO_INPUT_QUANTITY NO_COMPU_METHOD 16 0 15 READ_ONLY FORMAT "%.15" FIX_AXIS_PAR_DIST 0 1 16 /end AXIS_DESCR
 FORMAT "%.15" /end CHARACTERISTIC
/begin MEASUREMENT led_value "" UBYTE NO_COMPU_METHOD 0 0 0 255 ECU_ADDRESS 0xD0001826 FORMAT "%.15"
 /begin IF_DATA XCP
  /begin DAQ_EVENT VARIABLE /begin AVAILABLE_EVENT_LIST EVENT 0x0 EVENT 0x1 /end AVAILABLE_EVENT_LIST /begin DEFAULT_EVENT_LIST EVENT 0x1 /end DEFAULT_EVENT_LIST /end DAQ_EVENT
 /end IF_DATA
/end MEASUREMENT
/begin CHARACTERISTIC map0 "" MAP 0xA0080018 Map_16_8 0 NO_COMPU_METHOD 0 4294967295
 /begin AXIS_DESCR FIX_AXIS NO_INPUT_QUANTITY NO_COMPU_METHOD 8 0 7 READ_ONLY FORMAT "%.15" FIX_AXIS_PAR_DIST 0 1 8 /end AXIS_DESCR
 /begin AXIS_DESCR FIX_AXIS NO_INPUT_QUANTITY NO_COMPU_METHOD 8 0 7 READ_ONLY FORMAT "%.15" FIX_AXIS_PAR_DIST 0 1 8 /end AXIS_DESCR
 FORMAT "%.15" /end CHARACTERISTIC
/begin CHARACTERISTIC map1 "" MAP 0xA0080218 Map_16_8 0 NO_COMPU_METHOD 0 4294967295
 /begin AXIS_DESCR FIX_AXIS NO_INPUT_QUANTITY NO_COMPU_METHOD 8 0 7 READ_ONLY FORMAT "%.15" FIX_AXIS_PAR_DIST 0 1 8 /end AXIS_DESCR
 /begin AXIS_DESCR FIX_AXIS NO_INPUT_QUANTITY NO_COMPU_METHOD 8 0 7 READ_ONLY FORMAT "%.15" FIX_AXIS_PAR_DIST 0 1 8 /end AXIS_DESCR
 FORMAT "%.15" /end CHARACTERISTIC
/begin CHARACTERISTIC map10 "" MAP 0xA0081418 Map_16_8 0 NO_COMPU_METHOD 0 4294967295
 /begin AXIS_DESCR FIX_AXIS NO_INPUT_QUANTITY NO_COMPU_METHOD 8 0 7 READ_ONLY FORMAT "%.15" FIX_AXIS_PAR_DIST 0 1 8 /end AXIS_DESCR
 /begin AXIS_DESCR FIX_AXIS NO_INPUT_QUANTITY NO_COMPU_METHOD 8 0 7 READ_ONLY FORMAT "%.15" FIX_AXIS_PAR_DIST 0 1 8 /end AXIS_DESCR
 FORMAT "%.15" /end CHARACTERISTIC
/begin CHARACTERISTIC map11 "" MAP 0xA0081618 Map_16_8 0 NO_COMPU_METHOD 0 4294967295
 /begin AXIS_DESCR FIX_AXIS NO_INPUT_QUANTITY NO_COMPU_METHOD 8 0 7 READ_ONLY FORMAT "%.15" FIX_AXIS_PAR_DIST 0 1 8 /end AXIS_DESCR
 /begin AXIS_DESCR FIX_AXIS NO_INPUT_QUANTITY NO_COMPU_METHOD 8 0 7 READ_ONLY FORMAT "%.15" FIX_AXIS_PAR_DIST 0 1 8 /end AXIS_DESCR
 FORMAT "%.15" /end CHARACTERISTIC
/begin CHARACTERISTIC map12 "" MAP 0xA0081818 Map_16_8 0 NO_COMPU_METHOD 0 4294967295
 /begin AXIS_DESCR FIX_AXIS NO_INPUT_QUANTITY NO_COMPU_METHOD 8 0 7 READ_ONLY FORMAT "%.15" FIX_AXIS_PAR_DIST 0 1 8 /end AXIS_DESCR
 /begin AXIS_DESCR FIX_AXIS NO_INPUT_QUANTITY NO_COMPU_METHOD 8 0 7 READ_ONLY FORMAT "%.15" FIX_AXIS_PAR_DIST 0 1 8 /end AXIS_DESCR
 FORMAT "%.15" /end CHARACTERISTIC
/begin CHARACTERISTIC map13 "" MAP 0xA0081A18 Map_16_8 0 NO_COMPU_METHOD 0 4294967295
 /begin AXIS_DESCR FIX_AXIS NO_INPUT_QUANTITY NO_COMPU_METHOD 8 0 7 READ_ONLY FORMAT "%.15" FIX_AXIS_PAR_DIST 0 1 8 /end AXIS_DESCR
 /begin AXIS_DESCR FIX_AXIS NO_INPUT_QUANTITY NO_COMPU_METHOD 8 0 7 READ_ONLY FORMAT "%.15" FIX_AXIS_PAR_DIST 0 1 8 /end AXIS_DESCR
 FORMAT "%.15" /end CHARACTERISTIC
/begin CHARACTERISTIC map14 "" MAP 0xA0081C18 Map_16_8 0 NO_COMPU_METHOD 0 4294967295
 /begin AXIS_DESCR FIX_AXIS NO_INPUT_QUANTITY NO_COMPU_METHOD 8 0 7 READ_ONLY FORMAT "%.15" FIX_AXIS_PAR_DIST 0 1 8 /end AXIS_DESCR
 /begin AXIS_DESCR FIX_AXIS NO_INPUT_QUANTITY NO_COMPU_METHOD 8 0 7 READ_ONLY FORMAT "%.15" FIX_AXIS_PAR_DIST 0 1 8 /end AXIS_DESCR
 FORMAT "%.15" /end CHARACTERISTIC
/begin CHARACTERISTIC map15 "" MAP 0xA0081E18 Map_16_8 0 NO_COMPU_METHOD 0 4294967295
 /begin AXIS_DESCR FIX_AXIS NO_INPUT_QUANTITY NO_COMPU_METHOD 8 0 7 READ_ONLY FORMAT "%.15" FIX_AXIS_PAR_DIST 0 1 8 /end AXIS_DESCR
 /begin AXIS_DESCR FIX_AXIS NO_INPUT_QUANTITY NO_COMPU_METHOD 8 0 7 READ_ONLY FORMAT "%.15" FIX_AXIS_PAR_DIST 0 1 8 /end AXIS_DESCR
 FORMAT "%.15" /end CHARACTERISTIC
/begin CHARACTERISTIC map16 "" MAP 0xA0082018 Map_16_8 0 NO_COMPU_METHOD 0 4294967295
 /begin AXIS_DESCR FIX_AXIS NO_INPUT_QUANTITY NO_COMPU_METHOD 8 0 7 READ_ONLY FORMAT "%.15" FIX_AXIS_PAR_DIST 0 1 8 /end AXIS_DESCR
 /begin AXIS_DESCR FIX_AXIS NO_INPUT_QUANTITY NO_COMPU_METHOD 8 0 7 READ_ONLY FORMAT "%.15" FIX_AXIS_PAR_DIST 0 1 8 /end AXIS_DESCR
 FORMAT "%.15" /end CHARACTERISTIC
/begin CHARACTERISTIC map2 "" MAP 0xA0080418 Map_16_8 0 NO_COMPU_METHOD 0 4294967295
 /begin AXIS_DESCR FIX_AXIS NO_INPUT_QUANTITY NO_COMPU_METHOD 8 0 7 READ_ONLY FORMAT "%.15" FIX_AXIS_PAR_DIST 0 1 8 /end AXIS_DESCR
 /begin AXIS_DESCR FIX_AXIS NO_INPUT_QUANTITY NO_COMPU_METHOD 8 0 7 READ_ONLY FORMAT "%.15" FIX_AXIS_PAR_DIST 0 1 8 /end AXIS_DESCR
 FORMAT "%.15" /end CHARACTERISTIC
/begin CHARACTERISTIC map3 "" MAP 0xA0080618 Map_16_8 0 NO_COMPU_METHOD 0 4294967295
 /begin AXIS_DESCR FIX_AXIS NO_INPUT_QUANTITY NO_COMPU_METHOD 8 0 7 READ_ONLY FORMAT "%.15" FIX_AXIS_PAR_DIST 0 1 8 /end AXIS_DESCR
 /begin AXIS_DESCR FIX_AXIS NO_INPUT_QUANTITY NO_COMPU_METHOD 8 0 7 READ_ONLY FORMAT "%.15" FIX_AXIS_PAR_DIST 0 1 8 /end AXIS_DESCR
 FORMAT "%.15" /end CHARACTERISTIC
/begin CHARACTERISTIC map4 "" MAP 0xA0080818 Map_16_8 0 NO_COMPU_METHOD 0 4294967295
 /begin AXIS_DESCR FIX_AXIS NO_INPUT_QUANTITY NO_COMPU_METHOD 8 0 7 READ_ONLY FORMAT "%.15" FIX_AXIS_PAR_DIST 0 1 8 /end AXIS_DESCR
 /begin AXIS_DESCR FIX_AXIS NO_INPUT_QUANTITY NO_COMPU_METHOD 8 0 7 READ_ONLY FORMAT "%.15" FIX_AXIS_PAR_DIST 0 1 8 /end AXIS_DESCR
 FORMAT "%.15" /end CHARACTERISTIC
/begin CHARACTERISTIC map5 "" MAP 0xA0080A18 Map_16_8 0 NO_COMPU_METHOD 0 4294967295
 /begin AXIS_DESCR FIX_AXIS NO_INPUT_QUANTITY NO_COMPU_METHOD 8 0 7 READ_ONLY FORMAT "%.15" FIX_AXIS_PAR_DIST 0 1 8 /end AXIS_DESCR
 /begin AXIS_DESCR FIX_AXIS NO_INPUT_QUANTITY NO_COMPU_METHOD 8 0 7 READ_ONLY FORMAT "%.15" FIX_AXIS_PAR_DIST 0 1 8 /end AXIS_DESCR
 FORMAT "%.15" /end CHARACTERISTIC
/begin CHARACTERISTIC map6 "" MAP 0xA0080C18 Map_16_8 0 NO_COMPU_METHOD 0 4294967295
 /begin AXIS_DESCR FIX_AXIS NO_INPUT_QUANTITY NO_COMPU_METHOD 8 0 7 READ_ONLY FORMAT "%.15" FIX_AXIS_PAR_DIST 0 1 8 /end AXIS_DESCR
 /begin AXIS_DESCR FIX_AXIS NO_INPUT_QUANTITY NO_COMPU_METHOD 8 0 7 READ_ONLY FORMAT "%.15" FIX_AXIS_PAR_DIST 0 1 8 /end AXIS_DESCR
 FORMAT "%.15" /end CHARACTERISTIC
/begin CHARACTERISTIC map7 "" MAP 0xA0080E18 Map_16_8 0 NO_COMPU_METHOD 0 4294967295
 /begin AXIS_DESCR FIX_AXIS NO_INPUT_QUANTITY NO_COMPU_METHOD 8 0 7 READ_ONLY FORMAT "%.15" FIX_AXIS_PAR_DIST 0 1 8 /end AXIS_DESCR
 /begin AXIS_DESCR FIX_AXIS NO_INPUT_QUANTITY NO_COMPU_METHOD 8 0 7 READ_ONLY FORMAT "%.15" FIX_AXIS_PAR_DIST 0 1 8 /end AXIS_DESCR
 FORMAT "%.15" /end CHARACTERISTIC
/begin CHARACTERISTIC map8 "" MAP 0xA0081018 Map_16_8 0 NO_COMPU_METHOD 0 4294967295
 /begin AXIS_DESCR FIX_AXIS NO_INPUT_QUANTITY NO_COMPU_METHOD 8 0 7 READ_ONLY FORMAT "%.15" FIX_AXIS_PAR_DIST 0 1 8 /end AXIS_DESCR
 /begin AXIS_DESCR FIX_AXIS NO_INPUT_QUANTITY NO_COMPU_METHOD 8 0 7 READ_ONLY FORMAT "%.15" FIX_AXIS_PAR_DIST 0 1 8 /end AXIS_DESCR
 FORMAT "%.15" /end CHARACTERISTIC
/begin CHARACTERISTIC map9 "" MAP 0xA0081218 Map_16_8 0 NO_COMPU_METHOD 0 4294967295
 /begin AXIS_DESCR FIX_AXIS NO_INPUT_QUANTITY NO_COMPU_METHOD 8 0 7 READ_ONLY FORMAT "%.15" FIX_AXIS_PAR_DIST 0 1 8 /end AXIS_DESCR
 /begin AXIS_DESCR FIX_AXIS NO_INPUT_QUANTITY NO_COMPU_METHOD 8 0 7 READ_ONLY FORMAT "%.15" FIX_AXIS_PAR_DIST 0 1 8 /end AXIS_DESCR
 FORMAT "%.15" /end CHARACTERISTIC
/begin CHARACTERISTIC test_array "" VAL_BLK 0xD00027F4 __UWORD_Z 0 NO_COMPU_METHOD 0 65535 READ_ONLY MATRIX_DIM 16 1 1 FORMAT "%.0" /end CHARACTERISTIC
/begin MEASUREMENT test_bits.b1 "<a href=\"www.google.de\">Test</a>" UBYTE NO_COMPU_METHOD 0 0 0 7 READ_WRITE BIT_MASK 0x7 ECU_ADDRESS 0xD00017DE FORMAT "%.15" /end MEASUREMENT
/begin MEASUREMENT test_bits.b2 "" UWORD NO_COMPU_METHOD 0 0 0 255 READ_WRITE BIT_MASK 0x7F8 ECU_ADDRESS 0xD00017DE FORMAT "%.15" /end MEASUREMENT
/begin MEASUREMENT test_bits.b3 "" UBYTE NO_COMPU_METHOD 0 0 0 31 READ_WRITE BIT_MASK 0xF8 ECU_ADDRESS 0xD00017DF FORMAT "%.15" /end MEASUREMENT
/begin MEASUREMENT test_byte "" UBYTE NO_COMPU_METHOD 0 0 0 255 READ_WRITE ECU_ADDRESS 0xD0001827 FORMAT "%.15" /end MEASUREMENT
/begin MEASUREMENT test_byte_1 "" UBYTE NO_COMPU_METHOD 0 0 0 255 READ_WRITE ECU_ADDRESS 0xD0001829 FORMAT "%.15" /end MEASUREMENT
/begin MEASUREMENT test_byte_2 "" UBYTE NO_COMPU_METHOD 0 0 0 255 READ_WRITE ECU_ADDRESS 0xD000182A FORMAT "%.15" /end MEASUREMENT
/begin MEASUREMENT test_byte_3 "" UBYTE NO_COMPU_METHOD 0 0 0 255 READ_WRITE ECU_ADDRESS 0xD000182B FORMAT "%.15" /end MEASUREMENT
/begin MEASUREMENT test_byte_4 "" UBYTE NO_COMPU_METHOD 0 0 0 255 READ_WRITE ECU_ADDRESS 0xD0001828 FORMAT "%.15" /end MEASUREMENT
/begin MEASUREMENT test_double "" FLOAT32_IEEE NO_COMPU_METHOD 0 0 -3.4e+038 3.4e+038 READ_WRITE ECU_ADDRESS 0xD00017EA FORMAT "%.15" /end MEASUREMENT
/begin MEASUREMENT test_double_1 "" FLOAT32_IEEE NO_COMPU_METHOD 0 0 -3.4e+038 3.4e+038 READ_WRITE ECU_ADDRESS 0xD00017F0 FORMAT "%.15" /end MEASUREMENT
/begin MEASUREMENT test_double_2 "" FLOAT32_IEEE NO_COMPU_METHOD 0 0 -3.4e+038 3.4e+038 READ_WRITE ECU_ADDRESS 0xD000180E FORMAT "%.15" /end MEASUREMENT
/begin MEASUREMENT test_double_3 "" FLOAT32_IEEE NO_COMPU_METHOD 0 0 -3.4e+038 3.4e+038 READ_WRITE ECU_ADDRESS 0xD000181E FORMAT "%.15" /end MEASUREMENT
/begin MEASUREMENT test_double_4 "" FLOAT32_IEEE NO_COMPU_METHOD 0 0 -3.4e+038 3.4e+038 READ_WRITE ECU_ADDRESS 0xD0001816 FORMAT "%.15" /end MEASUREMENT
/begin MEASUREMENT test_dword "" ULONG NO_COMPU_METHOD 0 0 0 4294967295 READ_WRITE ECU_ADDRESS 0xD00017E2 FORMAT "%.15" /end MEASUREMENT
/begin MEASUREMENT test_dword_1 "" ULONG NO_COMPU_METHOD 0 0 0 4294967295 READ_WRITE ECU_ADDRESS 0xD00017F6 FORMAT "%.15" /end MEASUREMENT
/begin MEASUREMENT test_dword_2 "" ULONG NO_COMPU_METHOD 0 0 0 4294967295 READ_WRITE ECU_ADDRESS 0xD000181A FORMAT "%.15" /end MEASUREMENT
/begin MEASUREMENT test_dword_3 "" ULONG NO_COMPU_METHOD 0 0 0 4294967295 READ_WRITE ECU_ADDRESS 0xD0001806 FORMAT "%.15" /end MEASUREMENT
/begin MEASUREMENT test_dword_4 "" ULONG NO_COMPU_METHOD 0 0 0 4294967295 READ_WRITE ECU_ADDRESS 0xD00017FE FORMAT "%.15" /end MEASUREMENT
/begin MEASUREMENT test_float "" FLOAT32_IEEE NO_COMPU_METHOD 0 0 -3.4e+038 3.4e+038 READ_WRITE ECU_ADDRESS 0xD00017E6 FORMAT "%.15" /end MEASUREMENT
/begin MEASUREMENT test_float_1 "" FLOAT32_IEEE NO_COMPU_METHOD 0 0 -3.4e+038 3.4e+038 READ_WRITE ECU_ADDRESS 0xD0001802 FORMAT "%.15" /end MEASUREMENT
/begin MEASUREMENT test_float_2 "" FLOAT32_IEEE NO_COMPU_METHOD 0 0 -3.4e+038 3.4e+038 READ_WRITE ECU_ADDRESS 0xD0001822 FORMAT "%.15" /end MEASUREMENT
/begin MEASUREMENT test_float_3 "" FLOAT32_IEEE NO_COMPU_METHOD 0 0 -3.4e+038 3.4e+038 READ_WRITE ECU_ADDRESS 0xD000180A FORMAT "%.15" /end MEASUREMENT
/begin MEASUREMENT test_float_4 "" FLOAT32_IEEE NO_COMPU_METHOD 0 0 -3.4e+038 3.4e+038 READ_WRITE ECU_ADDRESS 0xD0001812 FORMAT "%.15" /end MEASUREMENT
/begin MEASUREMENT test_word "" UWORD NO_COMPU_METHOD 0 0 0 65535 READ_WRITE ECU_ADDRESS 0xD00017E0 FORMAT "%.15" /end MEASUREMENT
/begin MEASUREMENT test_word_1 "" UWORD NO_COMPU_METHOD 0 0 0 65535 READ_WRITE ECU_ADDRESS 0xD00017EE FORMAT "%.15" /end MEASUREMENT
/begin MEASUREMENT test_word_2 "" UWORD NO_COMPU_METHOD 0 0 0 65535 READ_WRITE ECU_ADDRESS 0xD00017FA FORMAT "%.15" /end MEASUREMENT
/begin MEASUREMENT test_word_3 "" UWORD NO_COMPU_METHOD 0 0 0 65535 READ_WRITE ECU_ADDRESS 0xD00017FC FORMAT "%.15" /end MEASUREMENT
/begin MEASUREMENT test_word_4 "" UWORD NO_COMPU_METHOD 0 0 0 65535 READ_WRITE ECU_ADDRESS 0xD00017F4 FORMAT "%.15" /end MEASUREMENT
/begin GROUP Bypass "" ROOT /begin SUB_GROUP Inputs Outputs /end SUB_GROUP /end GROUP
/begin GROUP Calibrations "" ROOT /begin REF_CHARACTERISTIC adc_ampl adc_filter led_pattern /end REF_CHARACTERISTIC /end GROUP
/begin GROUP Inputs "Kommentar"
 /begin REF_MEASUREMENT BypassInput_1 BypassInput_10 BypassInput_100 BypassInput_101 BypassInput_102 BypassInput_103 BypassInput_104 BypassInput_105 BypassInput_106 BypassInput_107 BypassInput_108 BypassInput_109 BypassInput_11 BypassInput_110 BypassInput_111 BypassInput_112 BypassInput_113 BypassInput_114 BypassInput_115 BypassInput_116 BypassInput_117 BypassInput_118 BypassInput_119 BypassInput_12 BypassInput_120 BypassInput_121 BypassInput_122 BypassInput_123 BypassInput_124 BypassInput_125 BypassInput_126 BypassInput_127 BypassInput_128 BypassInput_129 BypassInput_13 BypassInput_130 BypassInput_131 BypassInput_132 BypassInput_133 BypassInput_134 BypassInput_135 BypassInput_136 BypassInput_137 BypassInput_138 BypassInput_139 BypassInput_14 BypassInput_140 BypassInput_141 BypassInput_142 BypassInput_143 BypassInput_144 BypassInput_145 BypassInput_146 BypassInput_147 BypassInput_148 BypassInput_149 BypassInput_15 BypassInput_150 BypassInput_151 BypassInput_152 BypassInput_153 BypassInput_154 BypassInput_155 BypassInput_156 BypassInput_157 BypassInput_158 BypassInput_159 BypassInput_16 BypassInput_160 BypassInput_161 BypassInput_162 BypassInput_163 BypassInput_164 BypassInput_165 BypassInput_166 BypassInput_167 BypassInput_168 BypassInput_169 BypassInput_17 BypassInput_170 BypassInput_171 BypassInput_172 BypassInput_173 BypassInput_174 BypassInput_175 BypassInput_176 BypassInput_177 BypassInput_178 BypassInput_179 BypassInput_18 BypassInput_180 BypassInput_181 BypassInput_182 BypassInput_183 BypassInput_184 BypassInput_185 BypassInput_186 BypassInput_187 BypassInput_188 BypassInput_189 BypassInput_19 BypassInput_190 BypassInput_191 BypassInput_192 BypassInput_193 BypassInput_194 BypassInput_195 BypassInput_196 BypassInput_197 BypassInput_198 BypassInput_199 BypassInput_2 BypassInput_20 BypassInput_200 BypassInput_201 BypassInput_202 BypassInput_203 BypassInput_204 BypassInput_205 BypassInput_206 BypassInput_207 BypassInput_208 BypassInput_209 BypassInput_21 BypassInput_210 BypassInput_211 BypassInput_212 BypassInput_213 BypassInput_214 BypassInput_215 BypassInput_216 BypassInput_217 BypassInput_218 BypassInput_219 BypassInput_22 BypassInput_220 BypassInput_221 BypassInput_222 BypassInput_223 BypassInput_224 BypassInput_225 BypassInput_226 BypassInput_227 BypassInput_228 BypassInput_229 BypassInput_23 BypassInput_230 BypassInput_231 BypassInput_232 BypassInput_233 BypassInput_234 BypassInput_235 BypassInput_236 BypassInput_237 BypassInput_238 BypassInput_239 BypassInput_24 BypassInput_240 BypassInput_241 BypassInput_242 BypassInput_243 BypassInput_244 BypassInput_245 BypassInput_246 BypassInput_247 BypassInput_248 BypassInput_249 BypassInput_25 BypassInput_250 BypassInput_251 BypassInput_252 BypassInput_253 BypassInput_254 BypassInput_255 BypassInput_256 BypassInput_257 BypassInput_258 BypassInput_259 BypassInput_26 BypassInput_260 BypassInput_261 BypassInput_262 BypassInput_263 BypassInput_264 BypassInput_265 BypassInput_266 BypassInput_267 BypassInput_268 BypassInput_269 BypassInput_27 BypassInput_270 BypassInput_271 BypassInput_272 BypassInput_273 BypassInput_274 BypassInput_275 BypassInput_276 BypassInput_277 BypassInput_278 BypassInput_279 BypassInput_28 BypassInput_280 BypassInput_281 BypassInput_282 BypassInput_283 BypassInput_284 BypassInput_285 BypassInput_286 BypassInput_287 BypassInput_288 BypassInput_289 BypassInput_29 BypassInput_290 BypassInput_291 BypassInput_292 BypassInput_293 BypassInput_294 BypassInput_295 BypassInput_296 BypassInput_297 BypassInput_298 BypassInput_299 BypassInput_3 BypassInput_30 BypassInput_300 BypassInput_301 BypassInput_302 BypassInput_303 BypassInput_304 BypassInput_305 BypassInput_306 BypassInput_307 BypassInput_308 BypassInput_309 BypassInput_31 BypassInput_310 BypassInput_311 BypassInput_312 BypassInput_313 BypassInput_314 BypassInput_315 BypassInput_316 BypassInput_317 BypassInput_318 BypassInput_319 BypassInput_32 BypassInput_320 BypassInput_321 BypassInput_322 BypassInput_323 BypassInput_324 BypassInput_325 BypassInput_326 BypassInput_327 BypassInput_328 BypassInput_329 BypassInput_33 BypassInput_330 BypassInput_331 BypassInput_332 BypassInput_333 BypassInput_334 BypassInput_335 BypassInput_336 BypassInput_337 BypassInput_338 BypassInput_339 BypassInput_34 BypassInput_340 BypassInput_341 BypassInput_342 BypassInput_343 BypassInput_344 BypassInput_345 BypassInput_346 BypassInput_347 BypassInput_348 BypassInput_349 BypassInput_35 BypassInput_350 BypassInput_351 BypassInput_352 BypassInput_353 BypassInput_354 BypassInput_355 BypassInput_356 BypassInput_357 BypassInput_358 BypassInput_359 BypassInput_36 BypassInput_360 BypassInput_361 BypassInput_362 BypassInput_363 BypassInput_364 BypassInput_365 BypassInput_366 BypassInput_367 BypassInput_368 BypassInput_369 BypassInput_37 BypassInput_370 BypassInput_371 BypassInput_372 BypassInput_373 BypassInput_374 BypassInput_375 BypassInput_376 BypassInput_377 BypassInput_378 BypassInput_379 BypassInput_38 BypassInput_380 BypassInput_381 BypassInput_382 BypassInput_383 BypassInput_384 BypassInput_385 BypassInput_386 BypassInput_387 BypassInput_388 BypassInput_389 BypassInput_39 BypassInput_390 BypassInput_391 BypassInput_392 BypassInput_393 BypassInput_394 BypassInput_395 BypassInput_396 BypassInput_397 BypassInput_398 BypassInput_399 BypassInput_4 BypassInput_40 BypassInput_400 BypassInput_401 BypassInput_402 BypassInput_403 BypassInput_404 BypassInput_405 BypassInput_406 BypassInput_407 BypassInput_408 BypassInput_409 BypassInput_41 BypassInput_410 BypassInput_411 BypassInput_412 BypassInput_413 BypassInput_414 BypassInput_415 BypassInput_416 BypassInput_417 BypassInput_418 BypassInput_419 BypassInput_42 BypassInput_420 BypassInput_421 BypassInput_422 BypassInput_423 BypassInput_424 BypassInput_425 BypassInput_426 BypassInput_427 BypassInput_428 BypassInput_429 BypassInput_43 BypassInput_430 BypassInput_431 BypassInput_432 BypassInput_433 BypassInput_434 BypassInput_435 BypassInput_436 BypassInput_437 BypassInput_438 BypassInput_439 BypassInput_44 BypassInput_440 BypassInput_441 BypassInput_442 BypassInput_443 BypassInput_444 BypassInput_445 BypassInput_446 BypassInput_447 BypassInput_448 BypassInput_449 BypassInput_45 BypassInput_450 BypassInput_451 BypassInput_452 BypassInput_453 BypassInput_454 BypassInput_455 BypassInput_456 BypassInput_457 BypassInput_458 BypassInput_459 BypassInput_46 BypassInput_460 BypassInput_461 BypassInput_462 BypassInput_463 BypassInput_464 BypassInput_465 BypassInput_466 BypassInput_467 BypassInput_468 BypassInput_469 BypassInput_47 BypassInput_470 BypassInput_471 BypassInput_472 BypassInput_473 BypassInput_474 BypassInput_475 BypassInput_476 BypassInput_477 BypassInput_478 BypassInput_479 BypassInput_48 BypassInput_480 BypassInput_481 BypassInput_482 BypassInput_483 BypassInput_484 BypassInput_485 BypassInput_486 BypassInput_487 BypassInput_488 BypassInput_489 BypassInput_49 BypassInput_490 BypassInput_491 BypassInput_492 BypassInput_493 BypassInput_494 BypassInput_495 BypassInput_496 BypassInput_497 BypassInput_498 BypassInput_499 BypassInput_5 BypassInput_50 BypassInput_500 BypassInput_501 BypassInput_502 BypassInput_503 BypassInput_504 BypassInput_505 BypassInput_506 BypassInput_507 BypassInput_508 BypassInput_509 BypassInput_51 BypassInput_510 BypassInput_511 BypassInput_512 BypassInput_513 BypassInput_514 BypassInput_515 BypassInput_516 BypassInput_517 BypassInput_518 BypassInput_519 BypassInput_52 BypassInput_520 BypassInput_521 BypassInput_522 BypassInput_523 BypassInput_524 BypassInput_525 BypassInput_526 BypassInput_527 BypassInput_528 BypassInput_529 BypassInput_53 BypassInput_530 BypassInput_531 BypassInput_532 BypassInput_533 BypassInput_534 BypassInput_535 BypassInput_536 BypassInput_537 BypassInput_538 BypassInput_539 BypassInput_54 BypassInput_540 BypassInput_541 BypassInput_542 BypassInput_543 BypassInput_544 BypassInput_545 BypassInput_546 BypassInput_547 BypassInput_548 BypassInput_549 BypassInput_55 BypassInput_550 BypassInput_551 BypassInput_552 BypassInput_553 BypassInput_554 BypassInput_555 BypassInput_556 BypassInput_557 BypassInput_558 BypassInput_559 BypassInput_56 BypassInput_560 BypassInput_561 BypassInput_562 BypassInput_563 BypassInput_564 BypassInput_565 BypassInput_566 BypassInput_567 BypassInput_568 BypassInput_569 BypassInput_57 BypassInput_570 BypassInput_571 BypassInput_572 BypassInput_573 BypassInput_574 BypassInput_575 BypassInput_576 BypassInput_577 BypassInput_578 BypassInput_579 BypassInput_58 BypassInput_580 BypassInput_581 BypassInput_582 BypassInput_583 BypassInput_584 BypassInput_585 BypassInput_586 BypassInput_587 BypassInput_588 BypassInput_589 BypassInput_59 BypassInput_590 BypassInput_591 BypassInput_592 BypassInput_593 BypassInput_594 BypassInput_595 BypassInput_596 BypassInput_597 BypassInput_598 BypassInput_599 BypassInput_6 BypassInput_60 BypassInput_600 BypassInput_601 BypassInput_602 BypassInput_603 BypassInput_604 BypassInput_605 BypassInput_606 BypassInput_607 BypassInput_608 BypassInput_609 BypassInput_61 BypassInput_610 BypassInput_611 BypassInput_612 BypassInput_613 BypassInput_614 BypassInput_615 BypassInput_616 BypassInput_617 BypassInput_618 BypassInput_619 BypassInput_62 BypassInput_620 BypassInput_621 BypassInput_622 BypassInput_623 BypassInput_624 BypassInput_625 BypassInput_626 BypassInput_627 BypassInput_628 BypassInput_629 BypassInput_63 BypassInput_630 BypassInput_631 BypassInput_632 BypassInput_633 BypassInput_634 BypassInput_635 BypassInput_636 BypassInput_637 BypassInput_638 BypassInput_639 BypassInput_64 BypassInput_65 BypassInput_66 BypassInput_67 BypassInput_68 BypassInput_69 BypassInput_7 BypassInput_70 BypassInput_71 BypassInput_72 BypassInput_73 BypassInput_74 BypassInput_75 BypassInput_76 BypassInput_77 BypassInput_78 BypassInput_79 BypassInput_8 BypassInput_80 BypassInput_81 BypassInput_82 BypassInput_83 BypassInput_84 BypassInput_85 BypassInput_86 BypassInput_87 BypassInput_88 BypassInput_89 BypassInput_9 BypassInput_90 BypassInput_91 BypassInput_92 BypassInput_93 BypassInput_94 BypassInput_95 BypassInput_96 BypassInput_97 BypassInput_98 BypassInput_99 /end REF_MEASUREMENT
/end GROUP
/begin GROUP Measurements "" ROOT
 /begin REF_MEASUREMENT adc adc_raw adc_task_counter clock clock_adc clock_background led_counter led_value /end REF_MEASUREMENT
/end GROUP
/begin GROUP Outputs "Kommentar"
 /begin REF_MEASUREMENT BypassOutput_1 BypassOutput_10 BypassOutput_100 BypassOutput_101 BypassOutput_102 BypassOutput_103 BypassOutput_104 BypassOutput_105 BypassOutput_106 BypassOutput_107 BypassOutput_108 BypassOutput_109 BypassOutput_11 BypassOutput_110 BypassOutput_111 BypassOutput_112 BypassOutput_113 BypassOutput_114 BypassOutput_115 BypassOutput_116 BypassOutput_117 BypassOutput_118 BypassOutput_119 BypassOutput_12 BypassOutput_120 BypassOutput_121 BypassOutput_122 BypassOutput_123 BypassOutput_124 BypassOutput_125 BypassOutput_126 BypassOutput_127 BypassOutput_128 BypassOutput_129 BypassOutput_13 BypassOutput_130 BypassOutput_131 BypassOutput_132 BypassOutput_133 BypassOutput_134 BypassOutput_135 BypassOutput_136 BypassOutput_137 BypassOutput_138 BypassOutput_139 BypassOutput_14 BypassOutput_140 BypassOutput_141 BypassOutput_142 BypassOutput_143 BypassOutput_144 BypassOutput_145 BypassOutput_146 BypassOutput_147 BypassOutput_148 BypassOutput_149 BypassOutput_15 BypassOutput_150 BypassOutput_151 BypassOutput_152 BypassOutput_153 BypassOutput_154 BypassOutput_155 BypassOutput_156 BypassOutput_157 BypassOutput_158 BypassOutput_159 BypassOutput_16 BypassOutput_160 BypassOutput_161 BypassOutput_162 BypassOutput_163 BypassOutput_164 BypassOutput_165 BypassOutput_166 BypassOutput_167 BypassOutput_168 BypassOutput_169 BypassOutput_17 BypassOutput_170 BypassOutput_171 BypassOutput_172 BypassOutput_173 BypassOutput_174 BypassOutput_175 BypassOutput_176 BypassOutput_177 BypassOutput_178 BypassOutput_179 BypassOutput_18 BypassOutput_180 BypassOutput_181 BypassOutput_182 BypassOutput_183 BypassOutput_184 BypassOutput_185 BypassOutput_186 BypassOutput_187 BypassOutput_188 BypassOutput_189 BypassOutput_19 BypassOutput_190 BypassOutput_191 BypassOutput_192 BypassOutput_193 BypassOutput_194 BypassOutput_195 BypassOutput_196 BypassOutput_197 BypassOutput_198 BypassOutput_199 BypassOutput_2 BypassOutput_20 BypassOutput_200 BypassOutput_201 BypassOutput_202 BypassOutput_203 BypassOutput_204 BypassOutput_205 BypassOutput_206 BypassOutput_207 BypassOutput_208 BypassOutput_209 BypassOutput_21 BypassOutput_210 BypassOutput_211 BypassOutput_212 BypassOutput_213 BypassOutput_214 BypassOutput_215 BypassOutput_216 BypassOutput_217 BypassOutput_218 BypassOutput_219 BypassOutput_22 BypassOutput_220 BypassOutput_221 BypassOutput_222 BypassOutput_223 BypassOutput_224 BypassOutput_225 BypassOutput_226 BypassOutput_227 BypassOutput_228 BypassOutput_229 BypassOutput_23 BypassOutput_230 BypassOutput_231 BypassOutput_232 BypassOutput_233 BypassOutput_234 BypassOutput_235 BypassOutput_236 BypassOutput_237 BypassOutput_238 BypassOutput_239 BypassOutput_24 BypassOutput_240 BypassOutput_241 BypassOutput_242 BypassOutput_243 BypassOutput_244 BypassOutput_245 BypassOutput_246 BypassOutput_247 BypassOutput_248 BypassOutput_249 BypassOutput_25 BypassOutput_250 BypassOutput_251 BypassOutput_252 BypassOutput_253 BypassOutput_254 BypassOutput_255 BypassOutput_256 BypassOutput_257 BypassOutput_258 BypassOutput_259 BypassOutput_26 BypassOutput_260 BypassOutput_261 BypassOutput_262 BypassOutput_263 BypassOutput_264 BypassOutput_265 BypassOutput_27 BypassOutput_28 BypassOutput_29 BypassOutput_3 BypassOutput_30 BypassOutput_31 BypassOutput_32 BypassOutput_33 BypassOutput_34 BypassOutput_35 BypassOutput_36 BypassOutput_37 BypassOutput_38 BypassOutput_39 BypassOutput_4 BypassOutput_40 BypassOutput_41 BypassOutput_42 BypassOutput_43 BypassOutput_44 BypassOutput_45 BypassOutput_46 BypassOutput_47 BypassOutput_48 BypassOutput_49 BypassOutput_5 BypassOutput_50 BypassOutput_51 BypassOutput_52 BypassOutput_53 BypassOutput_54 BypassOutput_55 BypassOutput_56 BypassOutput_57 BypassOutput_58 BypassOutput_59 BypassOutput_6 BypassOutput_60 BypassOutput_61 BypassOutput_62 BypassOutput_63 BypassOutput_64 BypassOutput_65 BypassOutput_66 BypassOutput_67 BypassOutput_68 BypassOutput_69 BypassOutput_7 BypassOutput_70 BypassOutput_71 BypassOutput_72 BypassOutput_73 BypassOutput_74 BypassOutput_75 BypassOutput_76 BypassOutput_77 BypassOutput_78 BypassOutput_79 BypassOutput_8 BypassOutput_80 BypassOutput_81 BypassOutput_82 BypassOutput_83 BypassOutput_84 BypassOutput_85 BypassOutput_86 BypassOutput_87 BypassOutput_88 BypassOutput_89 BypassOutput_9 BypassOutput_90 BypassOutput_91 BypassOutput_92 BypassOutput_93 BypassOutput_94 BypassOutput_95 BypassOutput_96 BypassOutput_97 BypassOutput_98 BypassOutput_99 /end REF_MEASUREMENT
/end GROUP
/begin GROUP Test "" ROOT
 /begin REF_CHARACTERISTIC Test_D8000000 map0 map1 map10 map11 map12 map13 map14 map15 map16 map2 map3 map4 map5 map6 map7 map8 map9 test_array /end REF_CHARACTERISTIC
 /begin REF_MEASUREMENT test_bits.b1 test_bits.b2 test_bits.b3 test_byte test_byte_1 test_byte_2 test_byte_3 test_byte_4 test_double test_double_1 test_double_2 test_double_3 test_double_4 test_dword test_dword_1 test_dword_2 test_dword_3 test_dword_4 test_float test_float_1 test_float_2 test_float_3 test_float_4 test_word test_word_1 test_word_2 test_word_3 test_word_4 /end REF_MEASUREMENT
/end GROUP
/begin GROUP VX1000 "Monitoring signals from VX1000" ROOT /begin REF_CHARACTERISTIC gVX1000_STIM_Histogram gVX1000_STIM_Histogram2 /end REF_CHARACTERISTIC
 /begin REF_MEASUREMENT TraceLoad gVX1000.Stim.Enable gVX1000.Stim.TimeoutCtr gVX1000.Stim.TimeoutCtr2 gVX1000.ToolCtrlState gVX1000.ToolDetectState gVX1000_OLDA_Duration._0_ gVX1000_OLDA_Duration._1_ gVX1000_OLDA_Duration._2_ gVX1000_OLDA_Duration._3_ gVX1000_OLDA_TransferCount._0_ gVX1000_OLDA_TransferCount._1_ gVX1000_OLDA_TransferCount._2_ gVX1000_OLDA_TransferCount._3_ gVX1000_OLDA_TransferSize._0_ gVX1000_OLDA_TransferSize._1_ gVX1000_OLDA_TransferSize._2_ gVX1000_OLDA_TransferSize._3_ gVX1000_STIM_Duration._0_ gVX1000_STIM_Duration._1_ gVX1000_STIM_Duration._2_ gVX1000_STIM_Duration._3_ /end REF_MEASUREMENT
/end GROUP
/begin RECORD_LAYOUT Map_16_8 ALIGNMENT_BYTE 1 ALIGNMENT_FLOAT32_IEEE 1 ALIGNMENT_FLOAT64_IEEE 1 ALIGNMENT_INT64 1 ALIGNMENT_LONG 1 ALIGNMENT_WORD 1 FIX_NO_AXIS_PTS_X 16 FIX_NO_AXIS_PTS_Y 8 FNC_VALUES 1 ULONG COLUMN_DIR DIRECT /end RECORD_LAYOUT
/begin RECORD_LAYOUT Scalar_BOOLEAN FNC_VALUES 1 UBYTE COLUMN_DIR DIRECT /end RECORD_LAYOUT
/begin RECORD_LAYOUT Scalar_BYTE FNC_VALUES 1 SBYTE COLUMN_DIR DIRECT /end RECORD_LAYOUT
/begin RECORD_LAYOUT Scalar_FLOAT32_IEEE FNC_VALUES 1 FLOAT32_IEEE COLUMN_DIR DIRECT /end RECORD_LAYOUT
/begin RECORD_LAYOUT Scalar_FLOAT64_IEEE FNC_VALUES 1 FLOAT64_IEEE COLUMN_DIR DIRECT /end RECORD_LAYOUT
/begin RECORD_LAYOUT Scalar_LONG FNC_VALUES 1 SLONG COLUMN_DIR DIRECT /end RECORD_LAYOUT
/begin RECORD_LAYOUT Scalar_SWORD FNC_VALUES 1 SWORD COLUMN_DIR DIRECT /end RECORD_LAYOUT
/begin RECORD_LAYOUT Scalar_UBYTE FNC_VALUES 1 UBYTE COLUMN_DIR DIRECT /end RECORD_LAYOUT
/begin RECORD_LAYOUT Scalar_ULONG FNC_VALUES 1 ULONG COLUMN_DIR DIRECT /end RECORD_LAYOUT
/begin RECORD_LAYOUT Scalar_UWORD FNC_VALUES 1 UWORD COLUMN_DIR DIRECT /end RECORD_LAYOUT
/begin RECORD_LAYOUT __UBYTE_Z FNC_VALUES 1 UBYTE ROW_DIR DIRECT /end RECORD_LAYOUT
/begin RECORD_LAYOUT __UWORD_Z FNC_VALUES 1 UWORD ROW_DIR DIRECT /end RECORD_LAYOUT
/begin RECORD_LAYOUT __ULONG_Z FNC_VALUES 1 ULONG ROW_DIR DIRECT /end RECORD_LAYOUT
/begin RECORD_LAYOUT __SBYTE_Z FNC_VALUES 1 SBYTE ROW_DIR DIRECT /end RECORD_LAYOUT
/begin RECORD_LAYOUT __SWORD_Z FNC_VALUES 1 SWORD ROW_DIR DIRECT /end RECORD_LAYOUT
/begin RECORD_LAYOUT __SLONG_Z FNC_VALUES 1 SLONG ROW_DIR DIRECT /end RECORD_LAYOUT
/begin RECORD_LAYOUT __FLOAT32_IEEE_Z FNC_VALUES 1 FLOAT32_IEEE ROW_DIR DIRECT /end RECORD_LAYOUT
/begin RECORD_LAYOUT __FLOAT64_IEEE_Z FNC_VALUES 1 FLOAT64_IEEE ROW_DIR DIRECT /end RECORD_LAYOUT
/begin RECORD_LAYOUT __UBYTE_S FNC_VALUES 1 UBYTE COLUMN_DIR DIRECT /end RECORD_LAYOUT
/begin RECORD_LAYOUT __UWORD_S FNC_VALUES 1 UWORD COLUMN_DIR DIRECT /end RECORD_LAYOUT
/begin RECORD_LAYOUT __ULONG_S FNC_VALUES 1 ULONG COLUMN_DIR DIRECT /end RECORD_LAYOUT
/begin RECORD_LAYOUT __SBYTE_S FNC_VALUES 1 SBYTE COLUMN_DIR DIRECT /end RECORD_LAYOUT
/begin RECORD_LAYOUT __SWORD_S FNC_VALUES 1 SWORD COLUMN_DIR DIRECT /end RECORD_LAYOUT
/begin RECORD_LAYOUT __SLONG_S FNC_VALUES 1 SLONG COLUMN_DIR DIRECT /end RECORD_LAYOUT
/begin RECORD_LAYOUT __FLOAT32_IEEE_S FNC_VALUES 1 FLOAT32_IEEE COLUMN_DIR DIRECT /end RECORD_LAYOUT
/begin RECORD_LAYOUT __FLOAT64_IEEE_S FNC_VALUES 1 FLOAT64_IEEE COLUMN_DIR DIRECT /end RECORD_LAYOUT
/begin RECORD_LAYOUT SSV__UBYTE_S AXIS_PTS_X 1 UBYTE INDEX_INCR DIRECT /end RECORD_LAYOUT
/begin RECORD_LAYOUT SSV__UWORD_S AXIS_PTS_X 1 UWORD INDEX_INCR DIRECT /end RECORD_LAYOUT
/begin RECORD_LAYOUT SSV__ULONG_S AXIS_PTS_X 1 ULONG INDEX_INCR DIRECT /end RECORD_LAYOUT
/begin RECORD_LAYOUT SSV__SBYTE_S AXIS_PTS_X 1 SBYTE INDEX_INCR DIRECT /end RECORD_LAYOUT
/begin RECORD_LAYOUT SSV__SWORD_S AXIS_PTS_X 1 SWORD INDEX_INCR DIRECT /end RECORD_LAYOUT
/begin RECORD_LAYOUT SSV__SLONG_S AXIS_PTS_X 1 SLONG INDEX_INCR DIRECT /end RECORD_LAYOUT
/begin RECORD_LAYOUT SSV__FLOAT32_IEEE_S AXIS_PTS_X 1 FLOAT32_IEEE INDEX_INCR DIRECT /end RECORD_LAYOUT
/begin RECORD_LAYOUT SSV__FLOAT64_IEEE_S AXIS_PTS_X 1 FLOAT64_IEEE INDEX_INCR DIRECT /end RECORD_LAYOUT
/begin RECORD_LAYOUT __A_UINT64_Z FNC_VALUES 1 A_UINT64 ROW_DIR DIRECT /end RECORD_LAYOUT
/begin RECORD_LAYOUT __A_INT64_Z FNC_VALUES 1 A_INT64 ROW_DIR DIRECT /end RECORD_LAYOUT
/begin RECORD_LAYOUT __A_UINT64_S FNC_VALUES 1 A_UINT64 COLUMN_DIR DIRECT /end RECORD_LAYOUT
/begin RECORD_LAYOUT __A_INT64_S FNC_VALUES 1 A_INT64 COLUMN_DIR DIRECT /end RECORD_LAYOUT
/begin RECORD_LAYOUT SSV__A_UINT64_S AXIS_PTS_X 1 A_UINT64 INDEX_INCR DIRECT /end RECORD_LAYOUT
/begin RECORD_LAYOUT SSV__A_INT64_S AXIS_PTS_X 1 A_INT64 INDEX_INCR DIRECT /end RECORD_LAYOUT
/end MODULE
/end PROJECT
