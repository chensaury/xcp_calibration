VERSION "HIPBNYYYYYYYYYYYYYYYYYYYYYYYYYYY"

NS_ :

BS_:

BU_: SG

BO_ 256 CyclicMessage: 1 SG
 SG_ Counter : 0|8@1+ (1,0) [0|0] "" Vector__XXX
