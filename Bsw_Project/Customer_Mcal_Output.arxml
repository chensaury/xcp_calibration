AUTOSAR XML (schema 4-2-2)
package /ResourceM
  module config ResourceM: implementation-config-variant=VARIANT-PRE-COMPILE
    ResourceMGeneral: ResourceMSubDerivative=TC397x
    ResourceMMcalConfig_0 (ResourceMMcalConfig): ResourceMMasterCore=CORE0
      ResourceMMcalCore_0 (ResourceMMcalCore): ResourceMCoreID=CORE0
package /Dio
  module config Dio: implementation-config-variant=VARIANT-LINK-TIME
    CommonPublishedInformation:
      ArMajorVersion = 4
      ArMinorVersion = 2
      ArPatchVersion = 2
      ModuleId = 120
      Release = _TRICORE_TC397
      SwMajorVersion = 3
      SwMinorVersion = 0
      SwPatchVersion = 0
      VendorId = 17
    DioConfig
      DioPort_13 (DioPort): DioPortId=13
        4 x DioChannel:
          LED{0..3}: DioChannelId={0..3}
      DioPort_23 (DioPort): DioPortId=23
        Tick0 (DioChannel): DioChannelId=4
    DioGeneral: DioDevErrorDetect=1, DioFlipChannelApi=0, DioSafetyEnable=1, DioVersionInfoApi=0
package /McalLib
  module config McalLib: implementation-config-variant=VARIANT-PRE-COMPILE
    CommonPublishedInformation:
      ArMajorVersion = 4
      ArMinorVersion = 2
      ArPatchVersion = 2
      ModuleId = 255
      Release = _TRICORE_TC397
      SwMajorVersion = 3
      SwMinorVersion = 0
      SwPatchVersion = 0
      VendorId = 17
    McalLibGeneral: McalLibSafetyEnable=0
    McalLibPublishedInformation:
      McalLibBackUpClockFreq = 100
      McalLibDsprCore0EndAddr = 1879293951
      McalLibDsprCore0StartAddr = 1879048192
      McalLibDsprCore1EndAddr = 1610858495
      McalLibDsprCore1StartAddr = 1610612736
      McalLibDsprCore2EndAddr = 1342275583
      McalLibDsprCore2StartAddr = 1342177280
      McalLibDsprCore3EndAddr = 1073840127
      McalLibDsprCore3StartAddr = 1073741824
      McalLibDsprCore4EndAddr = 805404671
      McalLibDsprCore4StartAddr = 805306368
      McalLibDsprCore5EndAddr = 268533759
      McalLibDsprCore5StartAddr = 268435456
      McalLibMcalAvailableCores = 6
      McalLibPsprCore0EndAddr = 1880162303
      McalLibPsprCore0StartAddr = 1880096768
      McalLibPsprCore1EndAddr = 1611726847
      McalLibPsprCore1StartAddr = 1611661312
      McalLibPsprCore2EndAddr = 1343291391
      McalLibPsprCore2StartAddr = 1343225856
      McalLibPsprCore3EndAddr = 1074855935
      McalLibPsprCore3StartAddr = 1074790400
      McalLibPsprCore4EndAddr = 806420479
      McalLibPsprCore4StartAddr = 806354944
      McalLibPsprCore5EndAddr = 269549567
      McalLibPsprCore5StartAddr = 269484032
      McalLibSystemClockFreq = 20
package /Mcu
  module config Mcu: implementation-config-variant=VARIANT-POST-BUILD
    CommonPublishedInformation:
      ArMajorVersion = 4
      ArMinorVersion = 2
      ArPatchVersion = 2
      ModuleId = 101
      Release = _TRICORE_TC397
      SwMajorVersion = 4
      SwMinorVersion = 0
      SwPatchVersion = 0
      VendorId = 17
    McuGeneralConfiguration:
      McuClearColdResetStatusApi = 0
      McuClockSourceFailureNotification = 0
      McuDevErrorDetect = 0
      McuGetRamStateApi = 0
      McuGtmSleepModeEnabled = 0
      McuIdleModeCpuCore = INDIVIDUAL_IDLE_CORES_SEL0
      McuIfxCpuCcuconApi = 0
      McuIfxDeInitApi = 0
      McuIfxLpmApi = 0
      McuIfxTrapApi = 0
      McuInitCheckApi = 1
      McuInitClock = 1
      McuInitDeInitApiMode = MCU_MCAL_SUPERVISOR
      McuMainOscillatorFrequency = 20
      McuMultiCoreErrorDetect = 0
      McuNoPll = 0
      McuOscillatorMode = EXT_CRYSTAL_CERAMIC_RES_MODE_SEL0
      McuPerformResetApi = 1
      McuRuntimeApiMode = MCU_MCAL_SUPERVISOR
      McuSafetyEnable = 0
      McuStandbyEntryMode = STANDBY_ENTRY_REQ_SLEEP_SEL0
      McuSystemModeCpuCore = CPU_SYSTEM_CORE0_SEL0
      McuVersionInfoApi = 0
    McuHardwareResourceAllocationConf_0 (McuHardwareResourceAllocationConf)
      12 x McuAscLinAllocationConf:
        McuAscLinAllocationConf_0
          McuAscLinChannelAllocationConf: McuAscLinChannelAllocationConf=ASCLIN_CH_NOT_USED
        McuAscLinAllocationConf_1
          McuAscLinChannelAllocationConf: McuAscLinChannelAllocationConf=ASCLIN_CH_NOT_USED
        McuAscLinAllocationConf_10
          McuAscLinChannelAllocationConf: McuAscLinChannelAllocationConf=ASCLIN_CH_NOT_USED
        McuAscLinAllocationConf_11
          McuAscLinChannelAllocationConf: McuAscLinChannelAllocationConf=ASCLIN_CH_NOT_USED
        McuAscLinAllocationConf_2
          McuAscLinChannelAllocationConf: McuAscLinChannelAllocationConf=ASCLIN_CH_NOT_USED
        McuAscLinAllocationConf_3
          McuAscLinChannelAllocationConf: McuAscLinChannelAllocationConf=ASCLIN_CH_NOT_USED
        McuAscLinAllocationConf_4
          McuAscLinChannelAllocationConf: McuAscLinChannelAllocationConf=ASCLIN_CH_NOT_USED
        McuAscLinAllocationConf_5
          McuAscLinChannelAllocationConf: McuAscLinChannelAllocationConf=ASCLIN_CH_NOT_USED
        McuAscLinAllocationConf_6
          McuAscLinChannelAllocationConf: McuAscLinChannelAllocationConf=ASCLIN_CH_NOT_USED
        McuAscLinAllocationConf_7
          McuAscLinChannelAllocationConf: McuAscLinChannelAllocationConf=ASCLIN_CH_NOT_USED
        McuAscLinAllocationConf_8
          McuAscLinChannelAllocationConf: McuAscLinChannelAllocationConf=ASCLIN_CH_NOT_USED
        McuAscLinAllocationConf_9
          McuAscLinChannelAllocationConf: McuAscLinChannelAllocationConf=ASCLIN_CH_NOT_USED
      McuCcu6ModuleAllocationConf_0 (McuCcu6ModuleAllocationConf): McuCcu6ModuleAllocationConf=CCU6_MODULE_NOT_USED
      McuCcu6ModuleAllocationConf_1 (McuCcu6ModuleAllocationConf): McuCcu6ModuleAllocationConf=CCU6_MODULE_NOT_USED
      McuEruAllocationConf_0 (McuEruAllocationConf)
        8 x McuEruChannelInputLineConf, all with McuEruChannelInputLineConf=ERU_CHANNEL_INP_NOT_USED:
          McuEruChannelInputLineConf_{0..7}
        8 x McuEruChannelOutputUnitConf, all with McuEruChannelOutputUnitConf=ERU_CHANNEL_OUT_NOT_USED:
          McuEruChannelOutputUnitConf_{0..7}
      McuGpt12ModuleAllocationConf_0 (McuGpt12ModuleAllocationConf): McuGpt12ModuleAllocationConf=GPT_BLOCK_NOT_USED
      McuGpt12ModuleAllocationConf_1 (McuGpt12ModuleAllocationConf): McuGpt12ModuleAllocationConf=GPT_BLOCK_NOT_USED
      McuGtmAllocationConf_0 (McuGtmAllocationConf)
        12 x McuGtmAtomAllocationConf:
          McuGtmAtomAllocationConf_0
            8 x McuGtmAtomChannelAllocationConf, all with McuGtmAtomChannelAllocationConf=GTM_ATOM_CHANNEL_NOT_USED:
              McuGtmAtomChannelAllocationConf_{0..7}
          McuGtmAtomAllocationConf_1
            8 x McuGtmAtomChannelAllocationConf, all with McuGtmAtomChannelAllocationConf=GTM_ATOM_CHANNEL_NOT_USED:
              McuGtmAtomChannelAllocationConf_{0..7}
          McuGtmAtomAllocationConf_10
            8 x McuGtmAtomChannelAllocationConf, all with McuGtmAtomChannelAllocationConf=GTM_ATOM_CHANNEL_NOT_USED:
              McuGtmAtomChannelAllocationConf_{0..7}
          McuGtmAtomAllocationConf_11
            8 x McuGtmAtomChannelAllocationConf, all with McuGtmAtomChannelAllocationConf=GTM_ATOM_CHANNEL_NOT_USED:
              McuGtmAtomChannelAllocationConf_{0..7}
          McuGtmAtomAllocationConf_2
            8 x McuGtmAtomChannelAllocationConf, all with McuGtmAtomChannelAllocationConf=GTM_ATOM_CHANNEL_NOT_USED:
              McuGtmAtomChannelAllocationConf_{0..7}
          McuGtmAtomAllocationConf_3
            8 x McuGtmAtomChannelAllocationConf, all with McuGtmAtomChannelAllocationConf=GTM_ATOM_CHANNEL_NOT_USED:
              McuGtmAtomChannelAllocationConf_{0..7}
          McuGtmAtomAllocationConf_4
            8 x McuGtmAtomChannelAllocationConf, all with McuGtmAtomChannelAllocationConf=GTM_ATOM_CHANNEL_NOT_USED:
              McuGtmAtomChannelAllocationConf_{0..7}
          McuGtmAtomAllocationConf_5
            8 x McuGtmAtomChannelAllocationConf, all with McuGtmAtomChannelAllocationConf=GTM_ATOM_CHANNEL_NOT_USED:
              McuGtmAtomChannelAllocationConf_{0..7}
          McuGtmAtomAllocationConf_6
            8 x McuGtmAtomChannelAllocationConf, all with McuGtmAtomChannelAllocationConf=GTM_ATOM_CHANNEL_NOT_USED:
              McuGtmAtomChannelAllocationConf_{0..7}
          McuGtmAtomAllocationConf_7
            8 x McuGtmAtomChannelAllocationConf, all with McuGtmAtomChannelAllocationConf=GTM_ATOM_CHANNEL_NOT_USED:
              McuGtmAtomChannelAllocationConf_{0..7}
          McuGtmAtomAllocationConf_8
            8 x McuGtmAtomChannelAllocationConf, all with McuGtmAtomChannelAllocationConf=GTM_ATOM_CHANNEL_NOT_USED:
              McuGtmAtomChannelAllocationConf_{0..7}
          McuGtmAtomAllocationConf_9
            8 x McuGtmAtomChannelAllocationConf, all with McuGtmAtomChannelAllocationConf=GTM_ATOM_CHANNEL_NOT_USED:
              McuGtmAtomChannelAllocationConf_{0..7}
        8 x McuGtmTimAllocationConf:
          McuGtmTimAllocationConf_0
            8 x McuGtmTimChannelAllocationConf, all with McuGtmTimChannelAllocationConf=GTM_TIM_CHANNEL_NOT_USED:
              McuGtmTimChannelAllocationConf_{0..7}
          McuGtmTimAllocationConf_1
            8 x McuGtmTimChannelAllocationConf, all with McuGtmTimChannelAllocationConf=GTM_TIM_CHANNEL_NOT_USED:
              McuGtmTimChannelAllocationConf_{0..7}
          McuGtmTimAllocationConf_2
            8 x McuGtmTimChannelAllocationConf, all with McuGtmTimChannelAllocationConf=GTM_TIM_CHANNEL_NOT_USED:
              McuGtmTimChannelAllocationConf_{0..7}
          McuGtmTimAllocationConf_3
            8 x McuGtmTimChannelAllocationConf, all with McuGtmTimChannelAllocationConf=GTM_TIM_CHANNEL_NOT_USED:
              McuGtmTimChannelAllocationConf_{0..7}
          McuGtmTimAllocationConf_4
            8 x McuGtmTimChannelAllocationConf, all with McuGtmTimChannelAllocationConf=GTM_TIM_CHANNEL_NOT_USED:
              McuGtmTimChannelAllocationConf_{0..7}
          McuGtmTimAllocationConf_5
            8 x McuGtmTimChannelAllocationConf, all with McuGtmTimChannelAllocationConf=GTM_TIM_CHANNEL_NOT_USED:
              McuGtmTimChannelAllocationConf_{0..7}
          McuGtmTimAllocationConf_6
            8 x McuGtmTimChannelAllocationConf, all with McuGtmTimChannelAllocationConf=GTM_TIM_CHANNEL_NOT_USED:
              McuGtmTimChannelAllocationConf_{0..7}
          McuGtmTimAllocationConf_7
            8 x McuGtmTimChannelAllocationConf, all with McuGtmTimChannelAllocationConf=GTM_TIM_CHANNEL_NOT_USED:
              McuGtmTimChannelAllocationConf_{0..7}
        6 x McuGtmTomAllocationConf:
          McuGtmTomAllocationConf_0
            16 x McuGtmTomChannelAllocationConf, all with McuGtmTomChannelAllocationConf=GTM_TOM_CHANNEL_NOT_USED:
              McuGtmTomChannelAllocationConf_0
              McuGtmTomChannelAllocationConf_1
              McuGtmTomChannelAllocationConf_{10..15}
              McuGtmTomChannelAllocationConf_{2..9}
          McuGtmTomAllocationConf_1
            16 x McuGtmTomChannelAllocationConf, all with McuGtmTomChannelAllocationConf=GTM_TOM_CHANNEL_NOT_USED:
              McuGtmTomChannelAllocationConf_0
              McuGtmTomChannelAllocationConf_1
              McuGtmTomChannelAllocationConf_{10..15}
              McuGtmTomChannelAllocationConf_{2..9}
          McuGtmTomAllocationConf_2
            16 x McuGtmTomChannelAllocationConf, all with McuGtmTomChannelAllocationConf=GTM_TOM_CHANNEL_NOT_USED:
              McuGtmTomChannelAllocationConf_0
              McuGtmTomChannelAllocationConf_1
              McuGtmTomChannelAllocationConf_{10..15}
              McuGtmTomChannelAllocationConf_{2..9}
          McuGtmTomAllocationConf_3
            16 x McuGtmTomChannelAllocationConf, all with McuGtmTomChannelAllocationConf=GTM_TOM_CHANNEL_NOT_USED:
              McuGtmTomChannelAllocationConf_0
              McuGtmTomChannelAllocationConf_1
              McuGtmTomChannelAllocationConf_{10..15}
              McuGtmTomChannelAllocationConf_{2..9}
          McuGtmTomAllocationConf_4
            16 x McuGtmTomChannelAllocationConf, all with McuGtmTomChannelAllocationConf=GTM_TOM_CHANNEL_NOT_USED:
              McuGtmTomChannelAllocationConf_0
              McuGtmTomChannelAllocationConf_1
              McuGtmTomChannelAllocationConf_{10..15}
              McuGtmTomChannelAllocationConf_{2..9}
          McuGtmTomAllocationConf_5
            16 x McuGtmTomChannelAllocationConf, all with McuGtmTomChannelAllocationConf=GTM_TOM_CHANNEL_NOT_USED:
              McuGtmTomChannelAllocationConf_0
              McuGtmTomChannelAllocationConf_1
              McuGtmTomChannelAllocationConf_{10..15}
              McuGtmTomChannelAllocationConf_{2..9}
      6 x McuStmAllocationConf, all with McuStmCmp0RegAllocationConf=STM_CMP0_NOT_USED, McuStmCmp1RegAllocationConf=STM_CMP1_NOT_USED:
        McuStmAllocationConf_{0..5}
    McuModuleConfiguration: McuClockSrcFailureNotification=DISABLED, McuNumberOfMcuModes=1, McuRamSectors=0
      GtmGlobalConfiguration_0 (GtmGlobalConfiguration)
        12 x GtmAtomGlobalConf:
          GtmAtomGlobalConf_0
            8 x GtmAtomChannelConf, all with GtmAtomChInternalTriggerEnable=0, GtmAtomChResetCn0OnTriggerEnable=0:
              GtmAtomChannelConf_{0..7}
            GtmAtomGroupConf
              GtmAtomActionTimeBaseUnitConf: GtmAtomActionTimeBaseSelection=ATOM_ACT_TB_TBU_TS0, GtmAtomActionTimeBaseValue=1
          GtmAtomGlobalConf_1
            8 x GtmAtomChannelConf, all with GtmAtomChInternalTriggerEnable=0, GtmAtomChResetCn0OnTriggerEnable=0:
              GtmAtomChannelConf_{0..7}
            GtmAtomGroupConf
              GtmAtomActionTimeBaseUnitConf: GtmAtomActionTimeBaseSelection=ATOM_ACT_TB_TBU_TS0, GtmAtomActionTimeBaseValue=1
          GtmAtomGlobalConf_10
            8 x GtmAtomChannelConf, all with GtmAtomChInternalTriggerEnable=0, GtmAtomChResetCn0OnTriggerEnable=0:
              GtmAtomChannelConf_{0..7}
            GtmAtomGroupConf
              GtmAtomActionTimeBaseUnitConf: GtmAtomActionTimeBaseSelection=ATOM_ACT_TB_TBU_TS0, GtmAtomActionTimeBaseValue=1
          GtmAtomGlobalConf_11
            8 x GtmAtomChannelConf, all with GtmAtomChInternalTriggerEnable=0, GtmAtomChResetCn0OnTriggerEnable=0:
              GtmAtomChannelConf_{0..7}
            GtmAtomGroupConf
              GtmAtomActionTimeBaseUnitConf: GtmAtomActionTimeBaseSelection=ATOM_ACT_TB_TBU_TS0, GtmAtomActionTimeBaseValue=1
          GtmAtomGlobalConf_2
            8 x GtmAtomChannelConf, all with GtmAtomChInternalTriggerEnable=0, GtmAtomChResetCn0OnTriggerEnable=0:
              GtmAtomChannelConf_{0..7}
            GtmAtomGroupConf
              GtmAtomActionTimeBaseUnitConf: GtmAtomActionTimeBaseSelection=ATOM_ACT_TB_TBU_TS0, GtmAtomActionTimeBaseValue=1
          GtmAtomGlobalConf_3
            8 x GtmAtomChannelConf, all with GtmAtomChInternalTriggerEnable=0, GtmAtomChResetCn0OnTriggerEnable=0:
              GtmAtomChannelConf_{0..7}
            GtmAtomGroupConf
              GtmAtomActionTimeBaseUnitConf: GtmAtomActionTimeBaseSelection=ATOM_ACT_TB_TBU_TS0, GtmAtomActionTimeBaseValue=1
          GtmAtomGlobalConf_4
            8 x GtmAtomChannelConf, all with GtmAtomChInternalTriggerEnable=0, GtmAtomChResetCn0OnTriggerEnable=0:
              GtmAtomChannelConf_{0..7}
            GtmAtomGroupConf
              GtmAtomActionTimeBaseUnitConf: GtmAtomActionTimeBaseSelection=ATOM_ACT_TB_TBU_TS0, GtmAtomActionTimeBaseValue=1
          GtmAtomGlobalConf_5
            8 x GtmAtomChannelConf, all with GtmAtomChInternalTriggerEnable=0, GtmAtomChResetCn0OnTriggerEnable=0:
              GtmAtomChannelConf_{0..7}
            GtmAtomGroupConf
              GtmAtomActionTimeBaseUnitConf: GtmAtomActionTimeBaseSelection=ATOM_ACT_TB_TBU_TS0, GtmAtomActionTimeBaseValue=1
          GtmAtomGlobalConf_6
            8 x GtmAtomChannelConf, all with GtmAtomChInternalTriggerEnable=0, GtmAtomChResetCn0OnTriggerEnable=0:
              GtmAtomChannelConf_{0..7}
            GtmAtomGroupConf
              GtmAtomActionTimeBaseUnitConf: GtmAtomActionTimeBaseSelection=ATOM_ACT_TB_TBU_TS0, GtmAtomActionTimeBaseValue=1
          GtmAtomGlobalConf_7
            8 x GtmAtomChannelConf, all with GtmAtomChInternalTriggerEnable=0, GtmAtomChResetCn0OnTriggerEnable=0:
              GtmAtomChannelConf_{0..7}
            GtmAtomGroupConf
              GtmAtomActionTimeBaseUnitConf: GtmAtomActionTimeBaseSelection=ATOM_ACT_TB_TBU_TS0, GtmAtomActionTimeBaseValue=1
          GtmAtomGlobalConf_8
            8 x GtmAtomChannelConf, all with GtmAtomChInternalTriggerEnable=0, GtmAtomChResetCn0OnTriggerEnable=0:
              GtmAtomChannelConf_{0..7}
            GtmAtomGroupConf
              GtmAtomActionTimeBaseUnitConf: GtmAtomActionTimeBaseSelection=ATOM_ACT_TB_TBU_TS0, GtmAtomActionTimeBaseValue=1
          GtmAtomGlobalConf_9
            8 x GtmAtomChannelConf, all with GtmAtomChInternalTriggerEnable=0, GtmAtomChResetCn0OnTriggerEnable=0:
              GtmAtomChannelConf_{0..7}
            GtmAtomGroupConf
              GtmAtomActionTimeBaseUnitConf: GtmAtomActionTimeBaseSelection=ATOM_ACT_TB_TBU_TS0, GtmAtomActionTimeBaseValue=1
        12 x GtmClusterConf, all with GtmCmuClusterInputClockDividerEnable=CLS_CLK_CFG_ENABLED_WITH_DIV_SEL2:
          GtmClusterConf_0
            GtmClusterConfClockSetting:
              GtmClusterConfClock{0..7}Src = CMU_CONF_CLOCK{0..7}_SEL0
            GtmClusterFixedClockSetting: GtmClusterFixedClockSrc=CMU_FIXED_CLOCK0_SEL0
          GtmClusterConf_1
            GtmClusterConfClockSetting:
              GtmClusterConfClock{0..7}Src = CMU_CONF_CLOCK{0..7}_SEL0
            GtmClusterFixedClockSetting: GtmClusterFixedClockSrc=CMU_FIXED_CLOCK0_SEL0
          GtmClusterConf_10
            GtmClusterConfClockSetting:
              GtmClusterConfClock{0..7}Src = CMU_CONF_CLOCK{0..7}_SEL0
            GtmClusterFixedClockSetting: GtmClusterFixedClockSrc=CMU_FIXED_CLOCK0_SEL0
          GtmClusterConf_11
            GtmClusterConfClockSetting:
              GtmClusterConfClock{0..7}Src = CMU_CONF_CLOCK{0..7}_SEL0
            GtmClusterFixedClockSetting: GtmClusterFixedClockSrc=CMU_FIXED_CLOCK0_SEL0
          GtmClusterConf_2
            GtmClusterConfClockSetting:
              GtmClusterConfClock{0..7}Src = CMU_CONF_CLOCK{0..7}_SEL0
            GtmClusterFixedClockSetting: GtmClusterFixedClockSrc=CMU_FIXED_CLOCK0_SEL0
          GtmClusterConf_3
            GtmClusterConfClockSetting:
              GtmClusterConfClock{0..7}Src = CMU_CONF_CLOCK{0..7}_SEL0
            GtmClusterFixedClockSetting: GtmClusterFixedClockSrc=CMU_FIXED_CLOCK0_SEL0
          GtmClusterConf_4
            GtmClusterConfClockSetting:
              GtmClusterConfClock{0..7}Src = CMU_CONF_CLOCK{0..7}_SEL0
            GtmClusterFixedClockSetting: GtmClusterFixedClockSrc=CMU_FIXED_CLOCK0_SEL0
          GtmClusterConf_5
            GtmClusterConfClockSetting:
              GtmClusterConfClock{0..7}Src = CMU_CONF_CLOCK{0..7}_SEL0
            GtmClusterFixedClockSetting: GtmClusterFixedClockSrc=CMU_FIXED_CLOCK0_SEL0
          GtmClusterConf_6
            GtmClusterConfClockSetting:
              GtmClusterConfClock{0..7}Src = CMU_CONF_CLOCK{0..7}_SEL0
            GtmClusterFixedClockSetting: GtmClusterFixedClockSrc=CMU_FIXED_CLOCK0_SEL0
          GtmClusterConf_7
            GtmClusterConfClockSetting:
              GtmClusterConfClock{0..7}Src = CMU_CONF_CLOCK{0..7}_SEL0
            GtmClusterFixedClockSetting: GtmClusterFixedClockSrc=CMU_FIXED_CLOCK0_SEL0
          GtmClusterConf_8
            GtmClusterConfClockSetting:
              GtmClusterConfClock{0..7}Src = CMU_CONF_CLOCK{0..7}_SEL0
            GtmClusterFixedClockSetting: GtmClusterFixedClockSrc=CMU_FIXED_CLOCK0_SEL0
          GtmClusterConf_9
            GtmClusterConfClockSetting:
              GtmClusterConfClock{0..7}Src = CMU_CONF_CLOCK{0..7}_SEL0
            GtmClusterFixedClockSetting: GtmClusterFixedClockSrc=CMU_FIXED_CLOCK0_SEL0
        4 x GtmTbuChannelConf, all with GtmTbuChClockSourceSelection=CMU_CLOCK0_SEL0, GtmTbuChMode=FREE_RUNNING_COUNTER_SEL0, GtmTbuChModuloCntrSel=TBU_CH1_SEL0, GtmTbuChResolutionSel=TBU_CH_LOWER_COUNT_BITS_SEL0, GtmTbuChannelEnable=0:
          GtmTbuChannelConf_{0..3}
        6 x GtmTomGlobalConf:
          GtmTomGlobalConf_0
            16 x GtmTomChannelConf, all with GtmTomChInternalTriggerEnable=0, GtmTomChResetCn0OnTriggerEnable=0:
              GtmTomChannelConf_0
              GtmTomChannelConf_1
              GtmTomChannelConf_{10..15}
              GtmTomChannelConf_{2..9}
            GtmTomGroupConf_0 (GtmTomGroupConf)
              GtmTomActionTimeBaseUnitConf: GtmTomActionTimeBaseSelection=TOM_ACT_TB_TBU_TS0, GtmTomActionTimeBaseValue=1
            GtmTomGroupConf_1 (GtmTomGroupConf)
              GtmTomActionTimeBaseUnitConf: GtmTomActionTimeBaseSelection=TOM_ACT_TB_TBU_TS0, GtmTomActionTimeBaseValue=1
          GtmTomGlobalConf_1
            16 x GtmTomChannelConf, all with GtmTomChInternalTriggerEnable=0, GtmTomChResetCn0OnTriggerEnable=0:
              GtmTomChannelConf_0
              GtmTomChannelConf_1
              GtmTomChannelConf_{10..15}
              GtmTomChannelConf_{2..9}
            GtmTomGroupConf_0 (GtmTomGroupConf)
              GtmTomActionTimeBaseUnitConf: GtmTomActionTimeBaseSelection=TOM_ACT_TB_TBU_TS0, GtmTomActionTimeBaseValue=1
            GtmTomGroupConf_1 (GtmTomGroupConf)
              GtmTomActionTimeBaseUnitConf: GtmTomActionTimeBaseSelection=TOM_ACT_TB_TBU_TS0, GtmTomActionTimeBaseValue=1
          GtmTomGlobalConf_2
            16 x GtmTomChannelConf, all with GtmTomChInternalTriggerEnable=0, GtmTomChResetCn0OnTriggerEnable=0:
              GtmTomChannelConf_0
              GtmTomChannelConf_1
              GtmTomChannelConf_{10..15}
              GtmTomChannelConf_{2..9}
            GtmTomGroupConf_0 (GtmTomGroupConf)
              GtmTomActionTimeBaseUnitConf: GtmTomActionTimeBaseSelection=TOM_ACT_TB_TBU_TS0, GtmTomActionTimeBaseValue=1
            GtmTomGroupConf_1 (GtmTomGroupConf)
              GtmTomActionTimeBaseUnitConf: GtmTomActionTimeBaseSelection=TOM_ACT_TB_TBU_TS0, GtmTomActionTimeBaseValue=1
          GtmTomGlobalConf_3
            16 x GtmTomChannelConf, all with GtmTomChInternalTriggerEnable=0, GtmTomChResetCn0OnTriggerEnable=0:
              GtmTomChannelConf_0
              GtmTomChannelConf_1
              GtmTomChannelConf_{10..15}
              GtmTomChannelConf_{2..9}
            GtmTomGroupConf_0 (GtmTomGroupConf)
              GtmTomActionTimeBaseUnitConf: GtmTomActionTimeBaseSelection=TOM_ACT_TB_TBU_TS0, GtmTomActionTimeBaseValue=1
            GtmTomGroupConf_1 (GtmTomGroupConf)
              GtmTomActionTimeBaseUnitConf: GtmTomActionTimeBaseSelection=TOM_ACT_TB_TBU_TS0, GtmTomActionTimeBaseValue=1
          GtmTomGlobalConf_4
            16 x GtmTomChannelConf, all with GtmTomChInternalTriggerEnable=0, GtmTomChResetCn0OnTriggerEnable=0:
              GtmTomChannelConf_0
              GtmTomChannelConf_1
              GtmTomChannelConf_{10..15}
              GtmTomChannelConf_{2..9}
            GtmTomGroupConf_0 (GtmTomGroupConf)
              GtmTomActionTimeBaseUnitConf: GtmTomActionTimeBaseSelection=TOM_ACT_TB_TBU_TS0, GtmTomActionTimeBaseValue=1
            GtmTomGroupConf_1 (GtmTomGroupConf)
              GtmTomActionTimeBaseUnitConf: GtmTomActionTimeBaseSelection=TOM_ACT_TB_TBU_TS0, GtmTomActionTimeBaseValue=1
          GtmTomGlobalConf_5
            16 x GtmTomChannelConf, all with GtmTomChInternalTriggerEnable=0, GtmTomChResetCn0OnTriggerEnable=0:
              GtmTomChannelConf_0
              GtmTomChannelConf_1
              GtmTomChannelConf_{10..15}
              GtmTomChannelConf_{2..9}
            GtmTomGroupConf_0 (GtmTomGroupConf)
              GtmTomActionTimeBaseUnitConf: GtmTomActionTimeBaseSelection=TOM_ACT_TB_TBU_TS0, GtmTomActionTimeBaseValue=1
            GtmTomGroupConf_1 (GtmTomGroupConf)
              GtmTomActionTimeBaseUnitConf: GtmTomActionTimeBaseSelection=TOM_ACT_TB_TBU_TS0, GtmTomActionTimeBaseValue=1
        12 x GtmTriggerForAdc, all with GtmAdcTrigger0Select=TRIG_0_NO_TRIGGER, GtmAdcTrigger1Select=TRIG_0_NO_TRIGGER, GtmAdcTrigger2Select=TRIG_0_NO_TRIGGER, GtmAdcTrigger3Select=TRIG_0_NO_TRIGGER, GtmAdcTrigger4Select=TRIG_0_NO_TRIGGER:
          GtmTriggerForAdc_0
          GtmTriggerForAdc_1
          GtmTriggerForAdc_10
          GtmTriggerForAdc_11
          GtmTriggerForAdc_{2..9}
        McuGtmClockManagementConf: GtmCmuGlobalClockDenominator=1, GtmCmuGlobalClockNumerator=1
          GtmConfigClockSetting:
            GtmCmuConfigClock0Div = 0
            GtmCmuConfigClock0Enable = 1
            GtmCmuConfigClock1Div = 0
            GtmCmuConfigClock1Enable = 1
            GtmCmuConfigClock2Div = 0
            GtmCmuConfigClock2Enable = 1
            GtmCmuConfigClock3Div = 0
            GtmCmuConfigClock3Enable = 1
            GtmCmuConfigClock4Div = 0
            GtmCmuConfigClock4Enable = 1
            GtmCmuConfigClock5Div = 0
            GtmCmuConfigClock5Enable = 1
            GtmCmuConfigClock6Div = 0
            GtmCmuConfigClock6Enable = 1
            GtmCmuConfigClock7Div = 0
            GtmCmuConfigClock7Enable = 1
          GtmExtClockSetting:
            GtmCmuExtClock0Denominator = 1
            GtmCmuExtClock0Enable = 0
            GtmCmuExtClock0Numerator = 1
            GtmCmuExtClock1Denominator = 1
            GtmCmuExtClock1Enable = 0
            GtmCmuExtClock1Numerator = 1
            GtmCmuExtClock2Denominator = 1
            GtmCmuExtClock2Enable = 0
            GtmCmuExtClock2Numerator = 1
          GtmFixedClockSetting: GtmCmuFixedClockEnable=1, GtmCmuFixedClockSel=CMU_GLOBAL_CLOCK_SEL0
      McuClockSettingConfig_0 (McuClockSettingConfig): McuClockSettingId=0
        McuClockReferencePoint_CAN (McuClockReferencePoint): McuClockRefSelection=MCU_MCAN_FREQUENCY, McuClockReferencePointFrequency=8.0E7
        McuClockReferencePointConfig
          McuClockMonitorConfig:
            McuBackupClockMonEnable = 0
            McuBackupClockRangeMonEnable = 0
            McuPll{0..2}ClockMonEnable = 0
            McuSpbClockMonEnable = 0
          McuExternalClockOutputConfig:
            McuExtClock0Enable = 0
            McuExtClock1Div = 1
            McuExtClock1Enable = 0
            McuExtClock1Inverted = 0
            McuExtClockOutSel0 = FOUT_EXT_CLOCK0_SEL0
            McuExtClockOutSel1 = FOUT_EXT_CLOCK1_SEL0
          McuPeripheralPllSettingConfig:
            McuClockReferencePointFrequency1 = 1.6E8
            McuClockReferencePointFrequency2 = 2.0E8
            McuFreqSource1ClockDivSelect = DIV_FACTOR_2_BYPASSED_SEL1
            McuPerPllK2DivStepDownChangeDelay = 10
            McuPerPllK2DivStepUpChangeDelay = 10
            McuPerPllK3DivStepDownChangeDelay = 10
            McuPerPllK3DivStepUpChangeDelay = 10
            McuPeripheralPllK2Divider = 4
            McuPeripheralPllK3Divider = 1
            McuPeripheralPllNDivider = 39
            McuPeripheralPllPDivider = 0
            McuPll2DivSelect = MCU_K3_DIV_FACTOR_BYPASSED_SEL1
          McuPllDistributionSettingConfig:
            McuAdasFrequency = 3.0E8
            McuAdcFrequency = 1.6E8
            McuAscLinFastFrequency = 0.0
            McuAscLinSlowClockSourceSelection = ASCLINS_CLOCK_SOURCE_DISABLED_SEL0
            McuAscLinSlowFrequency = 0.0
            McuBBBFrequency = 1.5E8
            McuCPU{0..5}Frequency = 3.0E8
            McuClockDistributionInpClockSel = PLL_INPUT_CLOCK_SRC_SELECT_SEL1
            McuConvCtrlPhaseSynchConf = PHASE_SYNCH_CONST_ACTIVE_SEL0
            McuEbuClkEnable = 0
            McuEbuFrequency = 1.6E8
            McuErayClkEnable = 0
            McuErayFrequency = 8.0E7
            McuFSI2Frequency = 3.0E8
            McuFSIFrequency = 1.0E8
            McuGEthFrequency = 1.5E8
            McuGTMFrequency = 2.0E8
            McuHsctFrequency = 4.0E8
            McuHspdm160Frequency = 1.6E8
            McuHspdm320Frequency = 1.6E8
            McuHspdmClkEnable = 0
            McuI2CFrequency = 1.0E8
            McuLowPowerDivValue = LOW_POWER_DIVIDER_DISABLE_SEL0
            McuMCanClockSourceSelection = MCAN_CLOCK_SOURCE_MCANI_SEL1
            McuMCanFrequency = 8.0E7
            McuMcanHFrequency = 1.0E8
            McuMscClockSourceSelection = MSC_CLOCK_SOURCE_DISABLED_SEL0
            McuMscFrequency = 0.0
            McuQspiClockSourceSelection = QSPI_CLOCK_SOURCE_DISABLED_SEL0
            McuQspiFrequency = 1.0E8
            McuReferenceFrequency1 = 1.25E7
            McuReferenceFrequency2 = 6666667.0
            McuSPBFrequency = 1.0E8
            McuSRIFrequency = 3.0E8
            McuSTMFrequency = 1.0E8
          McuSystemPllSettingConfig:
            McuClockReferencePointFrequency0 = 3.0E8
            McuFMPllModAmp = 1.25
            McuFmPllEnable = 0
            McuPllInputSrcSelection = OSC_CLOCK_SRC_SELECT_SEL1
            McuSysPllK2DivStepDownChangeDelay = 10
            McuSysPllK2DivStepUpChangeDelay = 10
            McuSystemPllK2Divider = 1
            McuSystemPllNDivider = 29
            McuSystemPllPDivider = 0
      McuEruGlobalConf: McuEruInputFilterRegVal=0
      McuModeSettingConf_0 (McuModeSettingConf): McuEvrcLPMOnSleepReqEnable=0, McuMode=0
        McuStdbyModeSettingConf:
          McuStdbyModeBlankingFilterDelay = DELAY_0_MS_SEL0
          McuStdbyModeClkSelection = OSC_CLOCK_100KHZ_ONLY_SEL0
          McuStdbyModeESR0TriStateEnable = 0
          McuStdbyModePORSTFilterEnable = 0
          McuStdbyModePortTriStateEnable = 0
          McuStdbyModeRamEnable = MCU_STANDBYRAM_DISABLED_SEL0
          McuStdbyModeWakeupFromEVR = 0
          McuStdbyModeWakeupFromPORST = 1
          McuStdbyModeWakeupFromSCR = 0
          McuStdbyModeESR0Conf: McuStdbyModeESR0EdgeDetection=ESR0_TRIG_RISING_EDGE_SEL1, McuStdbyModeESR0FltEnable=0, McuStdbyModeESR0WakeupEnable=0
          McuStdbyModeESR1Conf: McuStdbyModeESR1EdgeDetection=ESR1_TRIG_RISING_EDGE_SEL1, McuStdbyModeESR1FltEnable=0, McuStdbyModeESR1WakeupEnable=0
          McuStdbyModePinAConf: McuStdbyModePinAEdgeDetection=PINA_TRIG_RISING_EDGE_SEL1, McuStdbyModePinAFltEnable=0, McuStdbyModePinAWakeupEnable=0
          McuStdbyModePinBConf: McuStdbyModePinBEdgeDetection=PINB_TRIG_RISING_EDGE_SEL1, McuStdbyModePinBFltEnable=0, McuStdbyModePinBWakeupEnable=0
          McuStdbyModeWakeupTimerConf:
            McuStdbyModeWakeupTimerClkDiv = WUT_100KHZ_NO_DIV_CLK_SEL0
            McuStdbyModeWakeupTimerEnable = 0
            McuStdbyModeWakeupTimerMode = WUT_AUTO_RELOAD_MODE_SEL0
            McuStdbyModeWakeupTimerValue = 16777215
      McuResetSettingConf:
        McuESR0ResetConf = MCU_ESR0_NO_RESET_SEL0
        McuESR1ResetConf = MCU_ESR1_NO_RESET_SEL0
        McuSMUResetConf = MCU_SMU_NO_RESET_SEL0
        McuSTM0ResetConf = MCU_STM0_NO_RESET_SEL0
        McuSTM0ResetOnApplResetEnable = 1
        McuSTM1ResetConf = MCU_STM1_NO_RESET_SEL0
        McuSTM1ResetOnApplResetEnable = 1
        McuSTM2ResetConf = MCU_STM2_NO_RESET_SEL0
        McuSTM2ResetOnApplResetEnable = 1
        McuSTM3ResetConf = MCU_STM3_NO_RESET_SEL0
        McuSTM3ResetOnApplResetEnable = 1
        McuSTM4ResetConf = MCU_STM4_NO_RESET_SEL0
        McuSTM4ResetOnApplResetEnable = 1
        McuSTM5ResetConf = MCU_STM5_NO_RESET_SEL0
        McuSTM5ResetOnApplResetEnable = 1
        McuSWResetConf = MCU_SW_NO_RESET_SEL0
      McuTrapSettingConf:
        McuCPU0ESR0TrapEnable = 0
        McuCPU0ESR1TrapEnable = 0
        McuCPU0SMUTrapEnable = 0
        McuCPU0Trap2Enable = 0
        McuCPU1ESR0TrapEnable = 0
        McuCPU1ESR1TrapEnable = 0
        McuCPU1SMUTrapEnable = 0
        McuCPU1Trap2Enable = 0
        McuCPU2ESR0TrapEnable = 0
        McuCPU2ESR1TrapEnable = 0
        McuCPU2SMUTrapEnable = 0
        McuCPU2Trap2Enable = 0
        McuCPU3ESR0TrapEnable = 0
        McuCPU3ESR1TrapEnable = 0
        McuCPU3SMUTrapEnable = 0
        McuCPU3Trap2Enable = 0
        McuCPU4ESR0TrapEnable = 0
        McuCPU4ESR1TrapEnable = 0
        McuCPU4SMUTrapEnable = 0
        McuCPU4Trap2Enable = 0
        McuCPU5ESR0TrapEnable = 0
        McuCPU5ESR1TrapEnable = 0
        McuCPU5SMUTrapEnable = 0
        McuCPU5Trap2Enable = 0
    McuPublishedInformation
      21 x McuResetReasonConf:
        MCU_CB0_RESET: McuResetReason=11
        MCU_CB1_RESET: McuResetReason=12
        MCU_CB3_RESET: McuResetReason=13
        MCU_ESR0_RESET: McuResetReason=0
        MCU_ESR1_RESET: McuResetReason=1
        MCU_EVR33_RESET: McuResetReason=15
        MCU_EVRC_RESET: McuResetReason=14
        MCU_LBIST_RESET: McuResetReason=18
        MCU_POWER_ON_RESET: McuResetReason=10
        MCU_RESET_MULTIPLE: McuResetReason=254
        MCU_RESET_UNDEFINED: McuResetReason=255
        MCU_SMU_RESET: McuResetReason=2
        MCU_STBYR_RESET: McuResetReason=17
        MCU_STM0_RESET: McuResetReason=4
        MCU_STM1_RESET: McuResetReason=5
        MCU_STM2_RESET: McuResetReason=6
        MCU_STM3_RESET: McuResetReason=7
        MCU_STM4_RESET: McuResetReason=8
        MCU_STM5_RESET: McuResetReason=9
        MCU_SUPPLY_WDOG_RESET: McuResetReason=16
        MCU_SW_RESET: McuResetReason=3
package /Port
  module config Port: implementation-config-variant=VARIANT-POST-BUILD
    CommonPublishedInformation:
      ArMajorVersion = 4
      ArMinorVersion = 2
      ArPatchVersion = 2
      ModuleId = 124
      Release = _TRICORE_TC397
      SwMajorVersion = 3
      SwMinorVersion = 0
      SwPatchVersion = 0
      VendorId = 17
    PortConfigSet
      17 x PortContainer:
        PortContainer_0: PortNumber=0, PortNumberOfPortPins=13
          13 x PortPin, all with PortPinControllerSelect=DISABLE, PortPinDirection=PORT_PIN_IN, PortPinDirectionChangeable=0, PortPinEmergencyStop=0, PortPinEnableAnalogInputOnly=PORT_PIN_ANALOG_INPUT_DISABLE, PortPinInitialMode=GPIO, PortPinInputPadLevel=PORT_INPUT_LEVEL_CMOS_AUTOMOTIVE, PortPinInputPullResistor=PORT_PIN_IN_PULL_UP, PortPinLevelValue=PORT_PIN_LEVEL_LOW, PortPinMode=PORT_PIN_MODE_ALL, PortPinModeChangeable=0, PortPinOutputPadDriveStrength=PORT_PIN_DEFAULT_DRIVER, PortPinOutputPinDriveMode=PORT_PIN_OUT_PUSHPULL:
            PortPin_0: PortPinId=0, PortPinSymbolicName=PORT_0_PIN_0
            PortPin_1: PortPinId=1, PortPinSymbolicName=PORT_0_PIN_1
            PortPin_{10..12}: PortPinId={10..12}, PortPinSymbolicName=PORT_0_PIN_{10..12}
            PortPin_{2..9}: PortPinId={2..9}, PortPinSymbolicName=PORT_0_PIN_{2..9}
        PortContainer_1: PortNumber=1, PortNumberOfPortPins=5
          5 x PortPin, all with PortPinControllerSelect=DISABLE, PortPinDirection=PORT_PIN_IN, PortPinDirectionChangeable=0, PortPinEmergencyStop=0, PortPinEnableAnalogInputOnly=PORT_PIN_ANALOG_INPUT_DISABLE, PortPinInitialMode=GPIO, PortPinInputPadLevel=PORT_INPUT_LEVEL_CMOS_AUTOMOTIVE, PortPinInputPullResistor=PORT_PIN_IN_PULL_UP, PortPinLevelValue=PORT_PIN_LEVEL_LOW, PortPinMode=PORT_PIN_MODE_ALL, PortPinModeChangeable=0, PortPinOutputPadDriveStrength=PORT_PIN_DEFAULT_DRIVER, PortPinOutputPinDriveMode=PORT_PIN_OUT_PUSHPULL:
            PortPin_0: PortPinId=19, PortPinSymbolicName=PORT_1_PIN_3
            PortPin_1: PortPinId=20, PortPinSymbolicName=PORT_1_PIN_4
            PortPin_2: PortPinId=21, PortPinSymbolicName=PORT_1_PIN_5
            PortPin_3: PortPinId=22, PortPinSymbolicName=PORT_1_PIN_6
            PortPin_4: PortPinId=23, PortPinSymbolicName=PORT_1_PIN_7
        PortContainer_10: PortNumber=21, PortNumberOfPortPins=8
          3 x PortLVDS, all with PortLVDSMode=LVDSH, PortLVDSPadSupply=V3_3, PortLVDSRxEnController=PORT_CONTROLLED, PortLVDSRxPathEnable=0, PortLVDSRxTerminationMode=INTERNAL_TERMINATION, PortLVDSTxEnController=PORT_CONTROLLED, PortLVDSTxPathEnable=0, PortLVDSTxPowerDownPullDown=DISABLE:
            PortLVDS_0: PortLVDSPinPair=Pin_0_Pin_1
            PortLVDS_1: PortLVDSPinPair=Pin_2_Pin_3
            PortLVDS_2: PortLVDSPinPair=Pin_4_Pin_5
          8 x PortPin, all with PortPinControllerSelect=DISABLE, PortPinDirection=PORT_PIN_IN, PortPinDirectionChangeable=0, PortPinEmergencyStop=0, PortPinEnableAnalogInputOnly=PORT_PIN_ANALOG_INPUT_DISABLE, PortPinInitialMode=GPIO, PortPinInputPadLevel=PORT_INPUT_LEVEL_CMOS_AUTOMOTIVE, PortPinInputPullResistor=PORT_PIN_IN_PULL_UP, PortPinLevelValue=PORT_PIN_LEVEL_LOW, PortPinMode=PORT_PIN_MODE_ALL, PortPinModeChangeable=0, PortPinOutputPadDriveStrength=PORT_PIN_DEFAULT_DRIVER, PortPinOutputPinDriveMode=PORT_PIN_OUT_PUSHPULL:
            PortPin_0: PortPinId=336, PortPinSymbolicName=PORT_21_PIN_0
            PortPin_1: PortPinId=337, PortPinSymbolicName=PORT_21_PIN_1
            PortPin_2: PortPinId=338, PortPinSymbolicName=PORT_21_PIN_2
            PortPin_3: PortPinId=339, PortPinSymbolicName=PORT_21_PIN_3
            PortPin_4: PortPinId=340, PortPinSymbolicName=PORT_21_PIN_4
            PortPin_5: PortPinId=341, PortPinSymbolicName=PORT_21_PIN_5
            PortPin_6: PortPinId=342, PortPinSymbolicName=PORT_21_PIN_6
            PortPin_7: PortPinId=343, PortPinSymbolicName=PORT_21_PIN_7
        PortContainer_11: PortNumber=22, PortNumberOfPortPins=12
          PortLVDS_0 (PortLVDS):
            PortLVDSMode = LVDSH
            PortLVDSPadSupply = V3_3
            PortLVDSPinPair = Pin_0_Pin_1
            PortLVDSRxEnController = PORT_CONTROLLED
            PortLVDSRxPathEnable = 0
            PortLVDSRxTerminationMode = INTERNAL_TERMINATION
            PortLVDSTxEnController = PORT_CONTROLLED
            PortLVDSTxPathEnable = 0
            PortLVDSTxPowerDownPullDown = DISABLE
          PortLVDS_1 (PortLVDS):
            PortLVDSMode = LVDSH
            PortLVDSPadSupply = V3_3
            PortLVDSPinPair = Pin_2_Pin_3
            PortLVDSRxEnController = PORT_CONTROLLED
            PortLVDSRxPathEnable = 0
            PortLVDSRxTerminationMode = INTERNAL_TERMINATION
            PortLVDSTxEnController = PORT_CONTROLLED
            PortLVDSTxPathEnable = 0
            PortLVDSTxPowerDownPullDown = DISABLE
          12 x PortPin, all with PortPinControllerSelect=DISABLE, PortPinDirection=PORT_PIN_IN, PortPinDirectionChangeable=0, PortPinEmergencyStop=0, PortPinEnableAnalogInputOnly=PORT_PIN_ANALOG_INPUT_DISABLE, PortPinInitialMode=GPIO, PortPinInputPadLevel=PORT_INPUT_LEVEL_CMOS_AUTOMOTIVE, PortPinInputPullResistor=PORT_PIN_IN_PULL_UP, PortPinLevelValue=PORT_PIN_LEVEL_LOW, PortPinMode=PORT_PIN_MODE_ALL, PortPinModeChangeable=0, PortPinOutputPadDriveStrength=PORT_PIN_DEFAULT_DRIVER, PortPinOutputPinDriveMode=PORT_PIN_OUT_PUSHPULL:
            PortPin_0: PortPinId=352, PortPinSymbolicName=PORT_22_PIN_0
            PortPin_1: PortPinId=353, PortPinSymbolicName=PORT_22_PIN_1
            PortPin_10: PortPinId=362, PortPinSymbolicName=PORT_22_PIN_10
            PortPin_11: PortPinId=363, PortPinSymbolicName=PORT_22_PIN_11
            PortPin_2: PortPinId=354, PortPinSymbolicName=PORT_22_PIN_2
            PortPin_3: PortPinId=355, PortPinSymbolicName=PORT_22_PIN_3
            PortPin_4: PortPinId=356, PortPinSymbolicName=PORT_22_PIN_4
            PortPin_5: PortPinId=357, PortPinSymbolicName=PORT_22_PIN_5
            PortPin_6: PortPinId=358, PortPinSymbolicName=PORT_22_PIN_6
            PortPin_7: PortPinId=359, PortPinSymbolicName=PORT_22_PIN_7
            PortPin_8: PortPinId=360, PortPinSymbolicName=PORT_22_PIN_8
            PortPin_9: PortPinId=361, PortPinSymbolicName=PORT_22_PIN_9
        PortContainer_12: PortNumber=23, PortNumberOfPortPins=8
          8 x PortPin, all with PortPinControllerSelect=DISABLE, PortPinDirectionChangeable=0, PortPinEmergencyStop=0, PortPinEnableAnalogInputOnly=PORT_PIN_ANALOG_INPUT_DISABLE, PortPinInitialMode=GPIO, PortPinInputPadLevel=PORT_INPUT_LEVEL_CMOS_AUTOMOTIVE, PortPinInputPullResistor=PORT_PIN_IN_PULL_UP, PortPinLevelValue=PORT_PIN_LEVEL_LOW, PortPinMode=PORT_PIN_MODE_ALL, PortPinModeChangeable=0, PortPinOutputPadDriveStrength=PORT_PIN_DEFAULT_DRIVER, PortPinOutputPinDriveMode=PORT_PIN_OUT_PUSHPULL:
            PortPin_0: PortPinDirection=PORT_PIN_IN, PortPinId=368, PortPinSymbolicName=PORT_23_PIN_0
            PortPin_1: PortPinDirection=PORT_PIN_IN, PortPinId=369, PortPinSymbolicName=PORT_23_PIN_1
            PortPin_2: PortPinDirection=PORT_PIN_IN, PortPinId=370, PortPinSymbolicName=PORT_23_PIN_2
            PortPin_3: PortPinDirection=PORT_PIN_IN, PortPinId=371, PortPinSymbolicName=PORT_23_PIN_3
            PortPin_5: PortPinDirection=PORT_PIN_IN, PortPinId=373, PortPinSymbolicName=PORT_23_PIN_5
            PortPin_6: PortPinDirection=PORT_PIN_IN, PortPinId=374, PortPinSymbolicName=PORT_23_PIN_6
            PortPin_7: PortPinDirection=PORT_PIN_IN, PortPinId=375, PortPinSymbolicName=PORT_23_PIN_7
            Tick0: PortPinDirection=PORT_PIN_OUT, PortPinId=372, PortPinSymbolicName=PORT_23_PIN_4
        PortContainer_13: PortNumber=32, PortNumberOfPortPins=8
          8 x PortPin, all with PortPinControllerSelect=DISABLE, PortPinDirection=PORT_PIN_IN, PortPinDirectionChangeable=0, PortPinEmergencyStop=0, PortPinEnableAnalogInputOnly=PORT_PIN_ANALOG_INPUT_DISABLE, PortPinInitialMode=GPIO, PortPinInputPadLevel=PORT_INPUT_LEVEL_CMOS_AUTOMOTIVE, PortPinInputPullResistor=PORT_PIN_IN_PULL_UP, PortPinLevelValue=PORT_PIN_LEVEL_LOW, PortPinMode=PORT_PIN_MODE_ALL, PortPinModeChangeable=0, PortPinOutputPadDriveStrength=PORT_PIN_DEFAULT_DRIVER, PortPinOutputPinDriveMode=PORT_PIN_OUT_PUSHPULL:
            PortPin_0: PortPinId=512, PortPinSymbolicName=PORT_32_PIN_0
            PortPin_1: PortPinId=513, PortPinSymbolicName=PORT_32_PIN_1
            PortPin_2: PortPinId=514, PortPinSymbolicName=PORT_32_PIN_2
            PortPin_3: PortPinId=515, PortPinSymbolicName=PORT_32_PIN_3
            PortPin_4: PortPinId=516, PortPinSymbolicName=PORT_32_PIN_4
            PortPin_5: PortPinId=517, PortPinSymbolicName=PORT_32_PIN_5
            PortPin_6: PortPinId=518, PortPinSymbolicName=PORT_32_PIN_6
            PortPin_7: PortPinId=519, PortPinSymbolicName=PORT_32_PIN_7
        PortContainer_14: PortNumber=33, PortNumberOfPortPins=16
          16 x PortPin, all with PortPinControllerSelect=DISABLE, PortPinDirection=PORT_PIN_IN, PortPinDirectionChangeable=0, PortPinEmergencyStop=0, PortPinEnableAnalogInputOnly=PORT_PIN_ANALOG_INPUT_DISABLE, PortPinInitialMode=GPIO, PortPinInputPadLevel=PORT_INPUT_LEVEL_CMOS_AUTOMOTIVE, PortPinInputPullResistor=PORT_PIN_IN_PULL_UP, PortPinLevelValue=PORT_PIN_LEVEL_LOW, PortPinMode=PORT_PIN_MODE_ALL, PortPinModeChangeable=0, PortPinOutputPadDriveStrength=PORT_PIN_DEFAULT_DRIVER, PortPinOutputPinDriveMode=PORT_PIN_OUT_PUSHPULL:
            PortPin_0: PortPinId=528, PortPinSymbolicName=PORT_33_PIN_0
            PortPin_1: PortPinId=529, PortPinSymbolicName=PORT_33_PIN_1
            PortPin_10: PortPinId=538, PortPinSymbolicName=PORT_33_PIN_10
            PortPin_11: PortPinId=539, PortPinSymbolicName=PORT_33_PIN_11
            PortPin_12: PortPinId=540, PortPinSymbolicName=PORT_33_PIN_12
            PortPin_13: PortPinId=541, PortPinSymbolicName=PORT_33_PIN_13
            PortPin_14: PortPinId=542, PortPinSymbolicName=PORT_33_PIN_14
            PortPin_15: PortPinId=543, PortPinSymbolicName=PORT_33_PIN_15
            PortPin_2: PortPinId=530, PortPinSymbolicName=PORT_33_PIN_2
            PortPin_3: PortPinId=531, PortPinSymbolicName=PORT_33_PIN_3
            PortPin_4: PortPinId=532, PortPinSymbolicName=PORT_33_PIN_4
            PortPin_5: PortPinId=533, PortPinSymbolicName=PORT_33_PIN_5
            PortPin_6: PortPinId=534, PortPinSymbolicName=PORT_33_PIN_6
            PortPin_7: PortPinId=535, PortPinSymbolicName=PORT_33_PIN_7
            PortPin_8: PortPinId=536, PortPinSymbolicName=PORT_33_PIN_8
            PortPin_9: PortPinId=537, PortPinSymbolicName=PORT_33_PIN_9
        PortContainer_15: PortNumber=34, PortNumberOfPortPins=5
          5 x PortPin, all with PortPinControllerSelect=DISABLE, PortPinDirection=PORT_PIN_IN, PortPinDirectionChangeable=0, PortPinEmergencyStop=0, PortPinEnableAnalogInputOnly=PORT_PIN_ANALOG_INPUT_DISABLE, PortPinInitialMode=GPIO, PortPinInputPadLevel=PORT_INPUT_LEVEL_CMOS_AUTOMOTIVE, PortPinInputPullResistor=PORT_PIN_IN_PULL_UP, PortPinLevelValue=PORT_PIN_LEVEL_LOW, PortPinMode=PORT_PIN_MODE_ALL, PortPinModeChangeable=0, PortPinOutputPadDriveStrength=PORT_PIN_DEFAULT_DRIVER, PortPinOutputPinDriveMode=PORT_PIN_OUT_PUSHPULL:
            PortPin_0: PortPinId=545, PortPinSymbolicName=PORT_34_PIN_1
            PortPin_1: PortPinId=546, PortPinSymbolicName=PORT_34_PIN_2
            PortPin_2: PortPinId=547, PortPinSymbolicName=PORT_34_PIN_3
            PortPin_3: PortPinId=548, PortPinSymbolicName=PORT_34_PIN_4
            PortPin_4: PortPinId=549, PortPinSymbolicName=PORT_34_PIN_5
        PortContainer_16: PortNumber=40, PortNumberOfPortPins=15
          15 x PortPin, all with PortPinControllerSelect=DISABLE, PortPinDirection=PORT_PIN_IN, PortPinDirectionChangeable=0, PortPinEmergencyStop=0, PortPinEnableAnalogInputOnly=PORT_PIN_ANALOG_INPUT_DISABLE, PortPinInitialMode=GPIO, PortPinInputPadLevel=PORT_INPUT_LEVEL_CMOS_AUTOMOTIVE, PortPinInputPullResistor=PORT_PIN_IN_PULL_UP, PortPinLevelValue=PORT_PIN_LEVEL_LOW, PortPinModeChangeable=0, PortPinOutputPadDriveStrength=PORT_PIN_DEFAULT_DRIVER, PortPinOutputPinDriveMode=PORT_PIN_OUT_PUSHPULL:
            PortPin_0: PortPinId=640, PortPinSymbolicName=PORT_40_PIN_0
            PortPin_1: PortPinId=641, PortPinSymbolicName=PORT_40_PIN_1
            PortPin_10: PortPinId=650, PortPinSymbolicName=PORT_40_PIN_10
            PortPin_11: PortPinId=651, PortPinSymbolicName=PORT_40_PIN_11
            PortPin_12: PortPinId=652, PortPinSymbolicName=PORT_40_PIN_12
            PortPin_13: PortPinId=653, PortPinSymbolicName=PORT_40_PIN_13
            PortPin_14: PortPinId=654, PortPinSymbolicName=PORT_40_PIN_14
            PortPin_2: PortPinId=642, PortPinSymbolicName=PORT_40_PIN_2
            PortPin_3: PortPinId=643, PortPinSymbolicName=PORT_40_PIN_3
            PortPin_4: PortPinId=644, PortPinSymbolicName=PORT_40_PIN_4
            PortPin_5: PortPinId=645, PortPinSymbolicName=PORT_40_PIN_5
            PortPin_6: PortPinId=646, PortPinSymbolicName=PORT_40_PIN_6
            PortPin_7: PortPinId=647, PortPinSymbolicName=PORT_40_PIN_7
            PortPin_8: PortPinId=648, PortPinSymbolicName=PORT_40_PIN_8
            PortPin_9: PortPinId=649, PortPinSymbolicName=PORT_40_PIN_9
        PortContainer_2: PortNumber=2, PortNumberOfPortPins=12
          12 x PortPin, all with PortPinControllerSelect=DISABLE, PortPinDirection=PORT_PIN_IN, PortPinDirectionChangeable=0, PortPinEmergencyStop=0, PortPinEnableAnalogInputOnly=PORT_PIN_ANALOG_INPUT_DISABLE, PortPinInitialMode=GPIO, PortPinInputPadLevel=PORT_INPUT_LEVEL_CMOS_AUTOMOTIVE, PortPinInputPullResistor=PORT_PIN_IN_PULL_UP, PortPinLevelValue=PORT_PIN_LEVEL_LOW, PortPinMode=PORT_PIN_MODE_ALL, PortPinModeChangeable=0, PortPinOutputPadDriveStrength=PORT_PIN_DEFAULT_DRIVER, PortPinOutputPinDriveMode=PORT_PIN_OUT_PUSHPULL:
            PortPin_0: PortPinId=32, PortPinSymbolicName=PORT_2_PIN_0
            PortPin_1: PortPinId=33, PortPinSymbolicName=PORT_2_PIN_1
            PortPin_10: PortPinId=42, PortPinSymbolicName=PORT_2_PIN_10
            PortPin_11: PortPinId=43, PortPinSymbolicName=PORT_2_PIN_11
            PortPin_2: PortPinId=34, PortPinSymbolicName=PORT_2_PIN_2
            PortPin_3: PortPinId=35, PortPinSymbolicName=PORT_2_PIN_3
            PortPin_4: PortPinId=36, PortPinSymbolicName=PORT_2_PIN_4
            PortPin_5: PortPinId=37, PortPinSymbolicName=PORT_2_PIN_5
            PortPin_6: PortPinId=38, PortPinSymbolicName=PORT_2_PIN_6
            PortPin_7: PortPinId=39, PortPinSymbolicName=PORT_2_PIN_7
            PortPin_8: PortPinId=40, PortPinSymbolicName=PORT_2_PIN_8
            PortPin_9: PortPinId=41, PortPinSymbolicName=PORT_2_PIN_9
        PortContainer_3: PortNumber=10, PortNumberOfPortPins=9
          9 x PortPin, all with PortPinControllerSelect=DISABLE, PortPinDirection=PORT_PIN_IN, PortPinDirectionChangeable=0, PortPinEmergencyStop=0, PortPinEnableAnalogInputOnly=PORT_PIN_ANALOG_INPUT_DISABLE, PortPinInitialMode=GPIO, PortPinInputPadLevel=PORT_INPUT_LEVEL_CMOS_AUTOMOTIVE, PortPinInputPullResistor=PORT_PIN_IN_PULL_UP, PortPinLevelValue=PORT_PIN_LEVEL_LOW, PortPinMode=PORT_PIN_MODE_ALL, PortPinModeChangeable=0, PortPinOutputPadDriveStrength=PORT_PIN_DEFAULT_DRIVER, PortPinOutputPinDriveMode=PORT_PIN_OUT_PUSHPULL:
            PortPin_0: PortPinId=160, PortPinSymbolicName=PORT_10_PIN_0
            PortPin_1: PortPinId=161, PortPinSymbolicName=PORT_10_PIN_1
            PortPin_2: PortPinId=162, PortPinSymbolicName=PORT_10_PIN_2
            PortPin_3: PortPinId=163, PortPinSymbolicName=PORT_10_PIN_3
            PortPin_4: PortPinId=164, PortPinSymbolicName=PORT_10_PIN_4
            PortPin_5: PortPinId=165, PortPinSymbolicName=PORT_10_PIN_5
            PortPin_6: PortPinId=166, PortPinSymbolicName=PORT_10_PIN_6
            PortPin_7: PortPinId=167, PortPinSymbolicName=PORT_10_PIN_7
            PortPin_8: PortPinId=168, PortPinSymbolicName=PORT_10_PIN_8
        PortContainer_4: PortNumber=11, PortNumberOfPortPins=16
          16 x PortPin, all with PortPinControllerSelect=DISABLE, PortPinDirection=PORT_PIN_IN, PortPinDirectionChangeable=0, PortPinEmergencyStop=0, PortPinEnableAnalogInputOnly=PORT_PIN_ANALOG_INPUT_DISABLE, PortPinInitialMode=GPIO, PortPinInputPadLevel=PORT_INPUT_LEVEL_CMOS_AUTOMOTIVE, PortPinInputPullResistor=PORT_PIN_IN_PULL_UP, PortPinLevelValue=PORT_PIN_LEVEL_LOW, PortPinMode=PORT_PIN_MODE_ALL, PortPinModeChangeable=0, PortPinOutputPadDriveStrength=PORT_PIN_DEFAULT_DRIVER, PortPinOutputPinDriveMode=PORT_PIN_OUT_PUSHPULL:
            PortPin_0: PortPinId=176, PortPinSymbolicName=PORT_11_PIN_0
            PortPin_1: PortPinId=177, PortPinSymbolicName=PORT_11_PIN_1
            PortPin_10: PortPinId=186, PortPinSymbolicName=PORT_11_PIN_10
            PortPin_11: PortPinId=187, PortPinSymbolicName=PORT_11_PIN_11
            PortPin_12: PortPinId=188, PortPinSymbolicName=PORT_11_PIN_12
            PortPin_13: PortPinId=189, PortPinSymbolicName=PORT_11_PIN_13
            PortPin_14: PortPinId=190, PortPinSymbolicName=PORT_11_PIN_14
            PortPin_15: PortPinId=191, PortPinSymbolicName=PORT_11_PIN_15
            PortPin_2: PortPinId=178, PortPinSymbolicName=PORT_11_PIN_2
            PortPin_3: PortPinId=179, PortPinSymbolicName=PORT_11_PIN_3
            PortPin_4: PortPinId=180, PortPinSymbolicName=PORT_11_PIN_4
            PortPin_5: PortPinId=181, PortPinSymbolicName=PORT_11_PIN_5
            PortPin_6: PortPinId=182, PortPinSymbolicName=PORT_11_PIN_6
            PortPin_7: PortPinId=183, PortPinSymbolicName=PORT_11_PIN_7
            PortPin_8: PortPinId=184, PortPinSymbolicName=PORT_11_PIN_8
            PortPin_9: PortPinId=185, PortPinSymbolicName=PORT_11_PIN_9
        PortContainer_5: PortNumber=12, PortNumberOfPortPins=2
          PortPin_0 (PortPin):
            PortPinControllerSelect = DISABLE
            PortPinDirection = PORT_PIN_IN
            PortPinDirectionChangeable = 0
            PortPinEmergencyStop = 0
            PortPinEnableAnalogInputOnly = PORT_PIN_ANALOG_INPUT_DISABLE
            PortPinId = 192
            PortPinInitialMode = GPIO
            PortPinInputPadLevel = PORT_INPUT_LEVEL_CMOS_AUTOMOTIVE
            PortPinInputPullResistor = PORT_PIN_IN_PULL_UP
            PortPinLevelValue = PORT_PIN_LEVEL_LOW
            PortPinMode = PORT_PIN_MODE_ALL
            PortPinModeChangeable = 0
            PortPinOutputPadDriveStrength = PORT_PIN_DEFAULT_DRIVER
            PortPinOutputPinDriveMode = PORT_PIN_OUT_PUSHPULL
            PortPinSymbolicName = PORT_12_PIN_0
          PortPin_1 (PortPin):
            PortPinControllerSelect = DISABLE
            PortPinDirection = PORT_PIN_IN
            PortPinDirectionChangeable = 0
            PortPinEmergencyStop = 0
            PortPinEnableAnalogInputOnly = PORT_PIN_ANALOG_INPUT_DISABLE
            PortPinId = 193
            PortPinInitialMode = GPIO
            PortPinInputPadLevel = PORT_INPUT_LEVEL_CMOS_AUTOMOTIVE
            PortPinInputPullResistor = PORT_PIN_IN_PULL_UP
            PortPinLevelValue = PORT_PIN_LEVEL_LOW
            PortPinMode = PORT_PIN_MODE_ALL
            PortPinModeChangeable = 0
            PortPinOutputPadDriveStrength = PORT_PIN_DEFAULT_DRIVER
            PortPinOutputPinDriveMode = PORT_PIN_OUT_PUSHPULL
            PortPinSymbolicName = PORT_12_PIN_1
        PortContainer_6: PortNumber=13, PortNumberOfPortPins=4
          PortLVDS_0 (PortLVDS):
            PortLVDSMode = LVDSH
            PortLVDSPadSupply = V3_3
            PortLVDSPinPair = Pin_0_Pin_1
            PortLVDSRxEnController = PORT_CONTROLLED
            PortLVDSRxPathEnable = 0
            PortLVDSRxTerminationMode = INTERNAL_TERMINATION
            PortLVDSTxEnController = PORT_CONTROLLED
            PortLVDSTxPathEnable = 0
            PortLVDSTxPowerDownPullDown = DISABLE
          PortLVDS_1 (PortLVDS):
            PortLVDSMode = LVDSH
            PortLVDSPadSupply = V3_3
            PortLVDSPinPair = Pin_2_Pin_3
            PortLVDSRxEnController = PORT_CONTROLLED
            PortLVDSRxPathEnable = 0
            PortLVDSRxTerminationMode = INTERNAL_TERMINATION
            PortLVDSTxEnController = PORT_CONTROLLED
            PortLVDSTxPathEnable = 0
            PortLVDSTxPowerDownPullDown = DISABLE
          4 x PortPin, all with PortPinControllerSelect=DISABLE, PortPinDirection=PORT_PIN_OUT, PortPinDirectionChangeable=0, PortPinEmergencyStop=0, PortPinEnableAnalogInputOnly=PORT_PIN_ANALOG_INPUT_DISABLE, PortPinInitialMode=GPIO, PortPinInputPadLevel=PORT_INPUT_LEVEL_CMOS_AUTOMOTIVE, PortPinInputPullResistor=PORT_PIN_IN_PULL_UP, PortPinLevelValue=PORT_PIN_LEVEL_HIGH, PortPinMode=PORT_PIN_MODE_ALL, PortPinModeChangeable=0, PortPinOutputPadDriveStrength=PORT_PIN_DEFAULT_DRIVER, PortPinOutputPinDriveMode=PORT_PIN_OUT_PUSHPULL:
            LED0: PortPinId=208, PortPinSymbolicName=PORT_13_PIN_0
            LED1: PortPinId=209, PortPinSymbolicName=PORT_13_PIN_1
            LED2: PortPinId=210, PortPinSymbolicName=PORT_13_PIN_2
            LED3: PortPinId=211, PortPinSymbolicName=PORT_13_PIN_3
        PortContainer_7: PortNumber=14, PortNumberOfPortPins=11
          PortLVDS_0 (PortLVDS):
            PortLVDSMode = LVDSH
            PortLVDSPadSupply = V3_3
            PortLVDSPinPair = Pin_10_Pin_9
            PortLVDSRxEnController = PORT_CONTROLLED
            PortLVDSRxPathEnable = 0
            PortLVDSRxTerminationMode = INTERNAL_TERMINATION
            PortLVDSTxEnController = PORT_CONTROLLED
            PortLVDSTxPathEnable = 0
            PortLVDSTxPowerDownPullDown = DISABLE
          11 x PortPin, all with PortPinControllerSelect=DISABLE, PortPinDirection=PORT_PIN_IN, PortPinDirectionChangeable=0, PortPinEmergencyStop=0, PortPinEnableAnalogInputOnly=PORT_PIN_ANALOG_INPUT_DISABLE, PortPinInitialMode=GPIO, PortPinInputPadLevel=PORT_INPUT_LEVEL_CMOS_AUTOMOTIVE, PortPinInputPullResistor=PORT_PIN_IN_PULL_UP, PortPinLevelValue=PORT_PIN_LEVEL_LOW, PortPinMode=PORT_PIN_MODE_ALL, PortPinModeChangeable=0, PortPinOutputPadDriveStrength=PORT_PIN_DEFAULT_DRIVER, PortPinOutputPinDriveMode=PORT_PIN_OUT_PUSHPULL:
            PortPin_0: PortPinId=224, PortPinSymbolicName=PORT_14_PIN_0
            PortPin_1: PortPinId=225, PortPinSymbolicName=PORT_14_PIN_1
            PortPin_10: PortPinId=234, PortPinSymbolicName=PORT_14_PIN_10
            PortPin_2: PortPinId=226, PortPinSymbolicName=PORT_14_PIN_2
            PortPin_3: PortPinId=227, PortPinSymbolicName=PORT_14_PIN_3
            PortPin_4: PortPinId=228, PortPinSymbolicName=PORT_14_PIN_4
            PortPin_5: PortPinId=229, PortPinSymbolicName=PORT_14_PIN_5
            PortPin_6: PortPinId=230, PortPinSymbolicName=PORT_14_PIN_6
            PortPin_7: PortPinId=231, PortPinSymbolicName=PORT_14_PIN_7
            PortPin_8: PortPinId=232, PortPinSymbolicName=PORT_14_PIN_8
            PortPin_9: PortPinId=233, PortPinSymbolicName=PORT_14_PIN_9
        PortContainer_8: PortNumber=15, PortNumberOfPortPins=9
          9 x PortPin, all with PortPinControllerSelect=DISABLE, PortPinDirection=PORT_PIN_IN, PortPinDirectionChangeable=0, PortPinEmergencyStop=0, PortPinEnableAnalogInputOnly=PORT_PIN_ANALOG_INPUT_DISABLE, PortPinInitialMode=GPIO, PortPinInputPadLevel=PORT_INPUT_LEVEL_CMOS_AUTOMOTIVE, PortPinInputPullResistor=PORT_PIN_IN_PULL_UP, PortPinLevelValue=PORT_PIN_LEVEL_LOW, PortPinMode=PORT_PIN_MODE_ALL, PortPinModeChangeable=0, PortPinOutputPadDriveStrength=PORT_PIN_DEFAULT_DRIVER, PortPinOutputPinDriveMode=PORT_PIN_OUT_PUSHPULL:
            PortPin_0: PortPinId=240, PortPinSymbolicName=PORT_15_PIN_0
            PortPin_1: PortPinId=241, PortPinSymbolicName=PORT_15_PIN_1
            PortPin_2: PortPinId=242, PortPinSymbolicName=PORT_15_PIN_2
            PortPin_3: PortPinId=243, PortPinSymbolicName=PORT_15_PIN_3
            PortPin_4: PortPinId=244, PortPinSymbolicName=PORT_15_PIN_4
            PortPin_5: PortPinId=245, PortPinSymbolicName=PORT_15_PIN_5
            PortPin_6: PortPinId=246, PortPinSymbolicName=PORT_15_PIN_6
            PortPin_7: PortPinId=247, PortPinSymbolicName=PORT_15_PIN_7
            PortPin_8: PortPinId=248, PortPinSymbolicName=PORT_15_PIN_8
        PortContainer_9: PortNumber=20, PortNumberOfPortPins=13
          13 x PortPin, all with PortPinControllerSelect=DISABLE, PortPinDirection=PORT_PIN_IN, PortPinDirectionChangeable=0, PortPinEmergencyStop=0, PortPinEnableAnalogInputOnly=PORT_PIN_ANALOG_INPUT_DISABLE, PortPinInitialMode=GPIO, PortPinInputPadLevel=PORT_INPUT_LEVEL_CMOS_AUTOMOTIVE, PortPinInputPullResistor=PORT_PIN_IN_PULL_UP, PortPinLevelValue=PORT_PIN_LEVEL_LOW, PortPinMode=PORT_PIN_MODE_ALL, PortPinModeChangeable=0, PortPinOutputPadDriveStrength=PORT_PIN_DEFAULT_DRIVER, PortPinOutputPinDriveMode=PORT_PIN_OUT_PUSHPULL:
            PortPin_0: PortPinId=320, PortPinSymbolicName=PORT_20_PIN_0
            PortPin_1: PortPinId=321, PortPinSymbolicName=PORT_20_PIN_1
            PortPin_10: PortPinId=332, PortPinSymbolicName=PORT_20_PIN_12
            PortPin_11: PortPinId=333, PortPinSymbolicName=PORT_20_PIN_13
            PortPin_12: PortPinId=334, PortPinSymbolicName=PORT_20_PIN_14
            PortPin_2: PortPinId=322, PortPinSymbolicName=PORT_20_PIN_2
            PortPin_3: PortPinId=323, PortPinSymbolicName=PORT_20_PIN_3
            PortPin_4: PortPinId=326, PortPinSymbolicName=PORT_20_PIN_6
            PortPin_5: PortPinId=327, PortPinSymbolicName=PORT_20_PIN_7
            PortPin_6: PortPinId=328, PortPinSymbolicName=PORT_20_PIN_8
            PortPin_7: PortPinId=329, PortPinSymbolicName=PORT_20_PIN_9
            PortPin_8: PortPinId=330, PortPinSymbolicName=PORT_20_PIN_10
            PortPin_9: PortPinId=331, PortPinSymbolicName=PORT_20_PIN_11
    PortGeneral:
      PortDevErrorDetect = 0
      PortInitApiMode = PORT_MCAL_SUPERVISOR
      PortInitCheckApi = 0
      PortSafetyEnable = 0
      PortSetPinDirectionApi = 0
      PortSetPinModeApi = 0
      PortVersionInfoApi = 0
