AUTOSAR XML (schema 4-2-1)
package /COM/VECTOR/CFG/WORKFLOW/SYSDESC/SYNC
  flat map FLATMAP
    6 x flat instance descriptor:
      Core{0..5}Swc: upstream-reference=EcuSwComposition.Core{0..5}Swc, ecu-extract-reference=COMPOSITIONTYPE.Core{0..5}Swc
