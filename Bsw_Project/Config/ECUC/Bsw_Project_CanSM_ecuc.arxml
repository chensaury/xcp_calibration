AUTOSAR XML (schema 4-2-1)
package /ActiveEcuC
  module config CanSM: implementation-config-variant=VARIANT-PRE-COMPILE, module-description=CanSM_Impl
    CanSMConfiguration: CanSMModeRequestRepetitionMax=10, CanSMModeRequestRepetitionTime=0.1
      CHNL_0fb271d2 (CanSMManagerNetwork):
        CanSMBorCounterL1ToL2 = 5
        CanSMBorTimeL1 = 1
        CanSMBorTimeL2 = 3
        CanSMBorTimeTxEnsured = 5
        CanSMBorTxConfirmationPolling = false
        CanSMComMNetworkHandleRef = CN_CAN00_a2de9a4f
        CT_CAN00_ec7a8ac3 (CanSMController): CanSMControllerId=CT_CAN00_617059cf
    CanSMGeneral: CanSMDevErrorDetect=false, CanSMMainFunctionTimePeriod=0.01, CanSMVersionInfoApi=false, CanSMBorCheckLevel=false, CanSMSetBaudrateApi=false
      CanSMGeneration: CanSMOutOfBoundsWriteSanitizer=false, CanSMOutOfBoundsReadSanitizer=false
