AUTOSAR XML (schema 4-2-1)
package /ActiveEcuC
  module config PduR: implementation-config-variant=VARIANT-PRE-COMPILE, module-description=PduR_Impl
    PduRGeneral:
      PduRDevErrorDetect = true
      PduRVersionInfoApi = false
      PduRMetaDataSupport = false
      PduRPduCallback = false
      PduRSwitching = false
      PduRSafeBswChecks = false
      PduREnableDeferredTransmission = false
      PduREnableDeferredReception = false
      PduRSupportMulticore = false
      PduRGeneration:
        PduROutOfBoundsWriteProtectionStrategy = NONE
        PduROutOfBoundsWriteSanitizer = false
        PduROutOfBoundsReadSanitizer = false
        PduRNumericalDataTypeMinimizationStrategy = WITH_CAST
        PduRReduceConstantData2Define = false
        PduRBoolDataInArrayOfStructStrategy = BITMASKING
        PduRDeduplicateIndirectedData = true
        PduRDataDeduplicationStrategy = WITH_CAST
        PduRReduceBoolDataByNegationThreshold = 2
        PduRReduceBoolDataByNumericalComparisonThreshold = 2
        PduRReduceBoolDataByNumericalRelationThreshold = 2
        PduRReduceBoolDataByNumericalOperandStrategy = WITH_ANY_VALUE
        PduRReduceNumericalDataByOffsetThreshold = 2
        PduRReduceNumericalDataByArraySubtractionThreshold = 2
        PduRReduceDataByStreaming = false
        PduRShortSymbols = false
        PduRInterfacesForDeactivatedData = false
        PduRReferringKeysInComments = false
    PduRRoutingTables: PduRConfigurationId=0
      PduRRoutingTable
        4 x PduRRoutingPath, all with PduRRoutingPathCommunicationType=COMMUNICATION_INTERFACE, PduRLockRef=PduRLock_PduRExclusiveArea:
          ACP_327_oCAN00_296526c1_Rx
            PduRSrcPdu_41385bd0 (PduRSrcPdu): PduRSourcePduHandleId=1, PduRSrcPduDirection=RECEIVE, PduRSrcPduRef=ACP_327_oCAN00_296526c1_Rx, PduRSrcPduPduRBswModulesRef=CanIf
            ACP_327_oCAN00_296526c1_Rx_41385bd0_Rx (PduRDestPdu):
              PduRDestPduHandleId = 1
              PduRDestPduDirection = RECEIVE
              PduRDestPduRoutingType = API_FORWARDING
              PduRDestPduDataProcessing = IMMEDIATE
              PduRPduLengthHandlingStrategy = UNUSED
              PduRTransmissionConfirmation = false
              PduRDestPduRef = ACP_327_oCAN00_ffa62305_Rx
              PduRDestPduPduRBswModulesRef = Com
          ACP_32E_oCAN00_c2ae66cc_Rx
            ACP_32E_oCAN00_c2ae66cc_Rx_d3bab334_Rx (PduRDestPdu):
              PduRDestPduHandleId = 0
              PduRDestPduDirection = RECEIVE
              PduRDestPduRoutingType = API_FORWARDING
              PduRDestPduDataProcessing = IMMEDIATE
              PduRPduLengthHandlingStrategy = UNUSED
              PduRTransmissionConfirmation = false
              PduRDestPduRef = ACP_32E_oCAN00_11d3b5e8_Rx
              PduRDestPduPduRBswModulesRef = Com
            PduRSrcPdu_d3bab334 (PduRSrcPdu): PduRSourcePduHandleId=0, PduRSrcPduDirection=RECEIVE, PduRSrcPduRef=ACP_32E_oCAN00_c2ae66cc_Rx, PduRSrcPduPduRBswModulesRef=CanIf
          B_RLS_oCAN00_8929dfa4_Rx
            B_RLS_oCAN00_8929dfa4_Rx_9f7da87b_Rx (PduRDestPdu):
              PduRDestPduHandleId = 2
              PduRDestPduDirection = RECEIVE
              PduRDestPduRoutingType = API_FORWARDING
              PduRDestPduDataProcessing = IMMEDIATE
              PduRPduLengthHandlingStrategy = UNUSED
              PduRTransmissionConfirmation = false
              PduRDestPduRef = B_RLS_oCAN00_6419d093_Rx
              PduRDestPduPduRBswModulesRef = Com
            PduRSrcPdu_9f7da87b (PduRSrcPdu): PduRSourcePduHandleId=2, PduRSrcPduDirection=RECEIVE, PduRSrcPduRef=B_RLS_oCAN00_8929dfa4_Rx, PduRSrcPduPduRBswModulesRef=CanIf
          ITMS_350_oCAN00_8869cfa0_Tx
            ITMS_350_oCAN00_93beae7b_Tx (PduRDestPdu):
              PduRDestPduHandleId = 0
              PduRDestPduDirection = TRANSMIT
              PduRDestPduRoutingType = API_FORWARDING
              PduRDestPduDataProcessing = IMMEDIATE
              PduRPduLengthHandlingStrategy = UNUSED
              PduRDestPduDataProvision = PDUR_DIRECT
              PduRTransmissionConfirmation = true
              PduRDestPduRef = ITMS_350_oCAN00_93beae7b_Tx
              PduRDestPduPduRBswModulesRef = CanIf
            PduRSrcPdu_26004724 (PduRSrcPdu): PduRSourcePduHandleId=0, PduRSrcPduDirection=TRANSMIT, PduRSrcPduRef=ITMS_350_oCAN00_8869cfa0_Tx, PduRSrcPduPduRBswModulesRef=Com
      PduRLock_PduRExclusiveArea (PduRLock)
        PduRExclusiveArea: PduRExclusiveAreaId=0
    CanIf (PduRBswModules):
      PduRCancelReceive = false
      PduRCancelTransmit = false
      PduRChangeParameterRequestApi = false
      PduRCommunicationInterface = true
      PduRLowerModule = true
      PduRTransportProtocol = false
      PduRTriggertransmit = false
      PduRTxConfirmation = true
      PduRUpperModule = false
      PduRUseTag = false
      PduRBswModuleRef = CanIf
    Com (PduRBswModules):
      PduRCancelReceive = false
      PduRCancelTransmit = false
      PduRChangeParameterRequestApi = false
      PduRCommunicationInterface = true
      PduRLowerModule = false
      PduRTransportProtocol = false
      PduRTriggertransmit = false
      PduRTxConfirmation = true
      PduRUpperModule = true
      PduRUseTag = false
      PduRBswModuleRef = Com
