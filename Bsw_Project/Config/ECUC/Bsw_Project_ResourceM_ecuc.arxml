AUTOSAR XML (schema 4-2-1)
package /ResourceM
  module config ResourceM: implementation-config-variant=VARIANT-PRE-COMPILE
    ResourceMGeneral: ResourceMSubDerivative=TC397x
    ResourceMMcalConfig_0 (ResourceMMcalConfig): ResourceMMasterCore=CORE0
      ResourceMMcalCore_0 (ResourceMMcalCore): ResourceMCoreID=CORE0
