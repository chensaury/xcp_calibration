AUTOSAR XML (schema 4-2-1)
package /Dio
  module config Dio: implementation-config-variant=VARIANT-LINK-TIME, module-description=Dio_Impl
    CommonPublishedInformation:
      ArMajorVersion = 4
      ArMinorVersion = 2
      ArPatchVersion = 2
      ModuleId = 120
      Release = _TRICORE_TC397
      SwMajorVersion = 3
      SwMinorVersion = 0
      SwPatchVersion = 0
      VendorId = 17
    DioConfig
      DioPort_13 (DioPort): DioPortId=13
        4 x DioChannel:
          LED{0..3}: DioChannelId={0..3}
      DioPort_23 (DioPort): DioPortId=23
        Tick0 (DioChannel): DioChannelId=4
    DioGeneral: DioDevErrorDetect=false, DioFlipChannelApi=false, DioSafetyEnable=false, DioVersionInfoApi=false
