AUTOSAR XML (schema 4-2-1)
package /ActiveEcuC
  module config Rte: implementation-config-variant=VARIANT-PRE-COMPILE, module-description=Rte_Impl
    RteInitializationBehavior: RteInitializationStrategy=RTE_INITIALIZATION_STRATEGY_AT_DATA_DECLARATION, RteSectionInitializationPolicy=INIT
    RteGeneration:
      RteGenerationMode = COMPATIBILITY_MODE
      RteIocInteractionReturnValue = RTE_IOC
      RteValueRangeCheckEnabled = false
      RteCalibrationSupport = NONE
      RteCodeVendorId = 30
      RteDevErrorDetect = false
      RteDevErrorDetectUninit = false
      RteMeasurementSupport = false
      RteOptimizationMode = MEMORY
      RteVfbTraceEnabled = false
    RteBswGeneral: RteSchMVersionInfoApi=false, RteUseComShadowSignalApi=false
    RteOsInteraction
      15 x RteUsedOsActivation, all with RteExpectedActivationOffset=0, RteExpectedTickDuration=0:
        Rte_Al_TE_Core{0..5}Swc_Core{0..5}Runnable: RteActivationOsAlarmRef=Rte_Al_TE_Core{0..5}Swc_Core{0..5}Runnable, RteActivationOsTaskRef=APP_Task_Core{0..5}
        Rte_Al_TE2_SchM_Core0_0_10ms: RteActivationOsAlarmRef=Rte_Al_TE2_SchM_Core0_0_10ms, RteActivationOsTaskRef=SchM_Core0
        Rte_Al_TE2_SchM_Core0_0_1ms: RteActivationOsAlarmRef=Rte_Al_TE2_SchM_Core0_0_1ms, RteActivationOsTaskRef=SchM_Core0
        Rte_Al_TE2_SchM_Core0_0_20ms: RteActivationOsAlarmRef=Rte_Al_TE2_SchM_Core0_0_20ms, RteActivationOsTaskRef=SchM_Core0
        Rte_Al_TE{1..4}_EcuM_EcuM_MainFunction: RteActivationOsAlarmRef=Rte_Al_TE{1..4}_EcuM_EcuM_MainFunction, RteActivationOsTaskRef=SchM_Core{1..4}
        Rte_Al_TE6_EcuM_EcuM_MainFunction: RteActivationOsAlarmRef=Rte_Al_TE6_EcuM_EcuM_MainFunction, RteActivationOsTaskRef=SchM_Core5
        Rte_Al_TE2_SchM_Core0_0_5ms: RteActivationOsAlarmRef=Rte_Al_TE2_SchM_Core0_0_5ms, RteActivationOsTaskRef=SchM_Core0
    10 x RteBswModuleInstance:
      BswM: RteBswImplementationRef=BswM_Impl, RteBswModuleConfigurationRef=BswM
        BSWM_EXCLUSIVE_AREA_0 (RteBswExclusiveAreaImpl): RteExclusiveAreaImplMechanism=ALL_INTERRUPT_BLOCKING, RteBswExclusiveAreaRef=BSWM_EXCLUSIVE_AREA_0
        BswM_MainFunctionTimingEvent0 (RteBswEventToTaskMapping):
          RteBswImmediateRestart = false
          RteBswPositionInTask = 0
          RteBswEventRef = BswM_MainFunctionTimingEvent0
          RteBswMappedToTaskRef = SchM_Core0
          RteBswUsedOsEventRef = Rte_Ev_Cyclic2_SchM_Core0_0_10ms
          RteBswUsedOsAlarmRef = Rte_Al_TE2_SchM_Core0_0_10ms
      Can: RteBswImplementationRef=Can_Impl, RteBswModuleConfigurationRef=Can
        3 x RteBswEventToTaskMapping, all with RteBswImmediateRestart=false, RteBswMappedToTaskRef=SchM_Core0, RteBswUsedOsEventRef=Rte_Ev_Cyclic2_SchM_Core0_0_10ms, RteBswUsedOsAlarmRef=Rte_Al_TE2_SchM_Core0_0_10ms:
          Can_MainFunction_BusOffTimingEvent0: RteBswPositionInTask=2, RteBswEventRef=Can_MainFunction_BusOffTimingEvent0
          Can_MainFunction_WakeupTimingEvent0: RteBswPositionInTask=4, RteBswEventRef=Can_MainFunction_WakeupTimingEvent0
          Can_MainFunction_ModeTimingEvent0: RteBswPositionInTask=3, RteBswEventRef=Can_MainFunction_ModeTimingEvent0
        8 x RteBswExclusiveAreaImpl:
          CAN_EXCLUSIVE_AREA_{0..5}: RteExclusiveAreaImplMechanism=ALL_INTERRUPT_BLOCKING, RteBswExclusiveAreaRef=CAN_EXCLUSIVE_AREA_{0..5}
          CAN_EXCLUSIVE_AREA_6: RteExclusiveAreaImplMechanism=CUSTOM, RteBswExclusiveAreaRef=CAN_EXCLUSIVE_AREA_6
          CAN_EXCLUSIVE_AREA_7: RteExclusiveAreaImplMechanism=ALL_INTERRUPT_BLOCKING, RteBswExclusiveAreaRef=CAN_EXCLUSIVE_AREA_7
      CanIf: RteBswImplementationRef=CanIf_Impl, RteBswModuleConfigurationRef=CanIf
        8 x RteBswExclusiveAreaImpl:
          CANIF_EXCLUSIVE_AREA_0: RteExclusiveAreaImplMechanism=CUSTOM, RteBswExclusiveAreaRef=CANIF_EXCLUSIVE_AREA_0
          CANIF_EXCLUSIVE_AREA_{1..7}: RteExclusiveAreaImplMechanism=ALL_INTERRUPT_BLOCKING, RteBswExclusiveAreaRef=CANIF_EXCLUSIVE_AREA_{1..7}
      CanSM: RteBswImplementationRef=CanSM_Impl, RteBswModuleConfigurationRef=CanSM
        CanSM_MainFunctionTimingEvent0 (RteBswEventToTaskMapping):
          RteBswImmediateRestart = false
          RteBswPositionInTask = 1
          RteBswEventRef = CanSM_MainFunctionTimingEvent0
          RteBswMappedToTaskRef = SchM_Core0
          RteBswUsedOsEventRef = Rte_Ev_Cyclic2_SchM_Core0_0_10ms
          RteBswUsedOsAlarmRef = Rte_Al_TE2_SchM_Core0_0_10ms
        6 x RteBswExclusiveAreaImpl:
          CANSM_EXCLUSIVE_AREA_1: RteExclusiveAreaImplMechanism=CUSTOM, RteBswExclusiveAreaRef=CANSM_EXCLUSIVE_AREA_1
          CANSM_EXCLUSIVE_AREA_{2..6}: RteExclusiveAreaImplMechanism=ALL_INTERRUPT_BLOCKING, RteBswExclusiveAreaRef=CANSM_EXCLUSIVE_AREA_{2..6}
      Com: RteBswImplementationRef=Com_Impl, RteBswModuleConfigurationRef=Com
        Com_MainFunctionTxTimingEvent0 (RteBswEventToTaskMapping):
          RteBswImmediateRestart = false
          RteBswPositionInTask = 7
          RteBswEventRef = Com_MainFunctionTxTimingEvent0
          RteBswMappedToTaskRef = SchM_Core0
          RteBswUsedOsEventRef = Rte_Ev_Cyclic2_SchM_Core0_0_1ms
          RteBswUsedOsAlarmRef = Rte_Al_TE2_SchM_Core0_0_1ms
        Com_MainFunctionRxTimingEvent0 (RteBswEventToTaskMapping):
          RteBswImmediateRestart = false
          RteBswPositionInTask = 6
          RteBswEventRef = Com_MainFunctionRxTimingEvent0
          RteBswMappedToTaskRef = SchM_Core0
          RteBswUsedOsEventRef = Rte_Ev_Cyclic2_SchM_Core0_0_10ms
          RteBswUsedOsAlarmRef = Rte_Al_TE2_SchM_Core0_0_10ms
        3 x RteBswExclusiveAreaImpl, all with RteExclusiveAreaImplMechanism=ALL_INTERRUPT_BLOCKING:
          COM_EXCLUSIVE_AREA_TX: RteBswExclusiveAreaRef=COM_EXCLUSIVE_AREA_TX
          COM_EXCLUSIVE_AREA_RX: RteBswExclusiveAreaRef=COM_EXCLUSIVE_AREA_RX
          COM_EXCLUSIVE_AREA_BOTH: RteBswExclusiveAreaRef=COM_EXCLUSIVE_AREA_BOTH
      ComM: RteBswImplementationRef=ComM_Impl, RteBswModuleConfigurationRef=ComM
        ComM_MainFunction_0TimingEvent0 (RteBswEventToTaskMapping):
          RteBswImmediateRestart = false
          RteBswPositionInTask = 5
          RteBswEventRef = ComM_MainFunction_0TimingEvent0
          RteBswMappedToTaskRef = SchM_Core0
          RteBswUsedOsEventRef = Rte_Ev_Cyclic2_SchM_Core0_0_20ms
          RteBswUsedOsAlarmRef = Rte_Al_TE2_SchM_Core0_0_20ms
        COMM_EXCLUSIVE_AREA_0 (RteBswExclusiveAreaImpl): RteExclusiveAreaImplMechanism=ALL_INTERRUPT_BLOCKING, RteBswExclusiveAreaRef=COMM_EXCLUSIVE_AREA_0
        COMM_EXCLUSIVE_AREA_1 (RteBswExclusiveAreaImpl): RteExclusiveAreaImplMechanism=CUSTOM, RteBswExclusiveAreaRef=COMM_EXCLUSIVE_AREA_1
      Det: RteBswImplementationRef=Det_Impl, RteBswModuleConfigurationRef=Det
        DET_EXCLUSIVE_AREA_0 (RteBswExclusiveAreaImpl): RteExclusiveAreaImplMechanism=ALL_INTERRUPT_BLOCKING, RteBswExclusiveAreaRef=DET_EXCLUSIVE_AREA_0
      EcuM: RteBswImplementationRef=EcuM_Impl, RteBswModuleConfigurationRef=EcuM
        EcuM_MainFunctionTimingEvent0 (RteBswEventToTaskMapping):
          RteBswImmediateRestart = false
          RteBswPositionInTask = 0
          RteBswEventRef = EcuM_MainFunctionTimingEvent0
          RteBswMappedToTaskRef = SchM_Core1
          RteBswUsedOsAlarmRef = Rte_Al_TE1_EcuM_EcuM_MainFunction
        3 x RteBswExclusiveAreaImpl, all with RteExclusiveAreaImplMechanism=ALL_INTERRUPT_BLOCKING:
          ECUM_EXCLUSIVE_AREA_{0..2}: RteBswExclusiveAreaRef=ECUM_EXCLUSIVE_AREA_{0..2}
        5 x RteBswEventToTaskMapping, all with RteBswImmediateRestart=false:
          EcuM_MainFunctionTimingEvent1: RteBswPositionInTask=0, RteBswEventRef=EcuM_MainFunctionTimingEvent1, RteBswMappedToTaskRef=SchM_Core2, RteBswUsedOsAlarmRef=Rte_Al_TE2_EcuM_EcuM_MainFunction
          EcuM_MainFunctionTimingEvent2: RteBswPositionInTask=0, RteBswEventRef=EcuM_MainFunctionTimingEvent2, RteBswMappedToTaskRef=SchM_Core3, RteBswUsedOsAlarmRef=Rte_Al_TE3_EcuM_EcuM_MainFunction
          EcuM_MainFunctionTimingEvent3: RteBswPositionInTask=0, RteBswEventRef=EcuM_MainFunctionTimingEvent3, RteBswMappedToTaskRef=SchM_Core4, RteBswUsedOsAlarmRef=Rte_Al_TE4_EcuM_EcuM_MainFunction
          EcuM_MainFunctionTimingEvent4: RteBswPositionInTask=10, RteBswEventRef=EcuM_MainFunctionTimingEvent4, RteBswMappedToTaskRef=SchM_Core0, RteBswUsedOsEventRef=Rte_Ev_Cyclic2_SchM_Core0_0_10ms, RteBswUsedOsAlarmRef=Rte_Al_TE2_SchM_Core0_0_10ms
          EcuM_MainFunctionTimingEvent5: RteBswPositionInTask=0, RteBswEventRef=EcuM_MainFunctionTimingEvent5, RteBswMappedToTaskRef=SchM_Core5, RteBswUsedOsAlarmRef=Rte_Al_TE6_EcuM_EcuM_MainFunction
      PduR: RteBswImplementationRef=PduR_Impl, RteBswModuleConfigurationRef=PduR
        PDUR_EXCLUSIVE_AREA_0 (RteBswExclusiveAreaImpl): RteExclusiveAreaImplMechanism=ALL_INTERRUPT_BLOCKING, RteBswExclusiveAreaRef=PDUR_EXCLUSIVE_AREA_0
      Rte: RteBswImplementationRef=Rte_Impl, RteBswModuleConfigurationRef=Rte
        Rte_ComSendSignalProxyPeriodicTimingEvent0 (RteBswEventToTaskMapping): RteBswImmediateRestart=false, RteBswPositionInTask=11, RteBswEventRef=Rte_ComSendSignalProxyPeriodicTimingEvent0, RteBswMappedToTaskRef=SchM_Core0
    4 x RteSwComponentInstance:
      ComM_EcuSwComposition: RteSoftwareComponentInstanceRef=ComM
        13 x RteEventToTaskMapping, all with RteImmediateRestart=false:
          Timer_ComM_MainFunction_0: RtePositionInTask=5, RteEventRef=Timer_ComM_MainFunction_0, RteMappedToTaskRef=SchM_Core0, RteUsedOsEventRef=Rte_Ev_Cyclic2_SchM_Core0_0_20ms, RteUsedOsAlarmRef=Rte_Al_TE2_SchM_Core0_0_20ms
          OpEventGetInhibitionStatus_GetInhibitionStatus_CL_CN_CAN00_a2de9a4f: RteEventRef=OpEventGetInhibitionStatus_GetInhibitionStatus_CL_CN_CAN00_a2de9a4f
          OpEventGetInhibitionStatus_GetInhibitionStatus_CW_CN_CAN00_a2de9a4f: RteEventRef=OpEventGetInhibitionStatus_GetInhibitionStatus_CW_CN_CAN00_a2de9a4f
          OpEventLimitECUToNoComMode_LimitECUToNoComMode_modeLimitation: RteEventRef=OpEventLimitECUToNoComMode_LimitECUToNoComMode_modeLimitation
          OpEventReadInhibitCounter_ReadInhibitCounter_modeLimitation: RteEventRef=OpEventReadInhibitCounter_ReadInhibitCounter_modeLimitation
          OpEventResetInhibitCounter_ResetInhibitCounter_modeLimitation: RteEventRef=OpEventResetInhibitCounter_ResetInhibitCounter_modeLimitation
          OpEventSetECUGroupClassification_SetECUGroupClassification_modeLimitation: RteEventRef=OpEventSetECUGroupClassification_SetECUGroupClassification_modeLimitation
          OpEventLimitChannelToNoComMode_LimitChannelToNoComMode_CL_CN_CAN00_a2de9a4f: RteEventRef=OpEventLimitChannelToNoComMode_LimitChannelToNoComMode_CL_CN_CAN00_a2de9a4f
          OpEventPreventWakeUp_PreventWakeUp_CW_CN_CAN00_a2de9a4f: RteEventRef=OpEventPreventWakeUp_PreventWakeUp_CW_CN_CAN00_a2de9a4f
          OpEventRequestComMode_RequestComMode_UR_CN_CAN00_99a1e90e: RteEventRef=OpEventRequestComMode_RequestComMode_UR_CN_CAN00_99a1e90e
          OpEventGetCurrentComMode_GetCurrentComMode_UR_CN_CAN00_99a1e90e: RteEventRef=OpEventGetCurrentComMode_GetCurrentComMode_UR_CN_CAN00_99a1e90e
          OpEventGetMaxComMode_GetMaxComMode_UR_CN_CAN00_99a1e90e: RteEventRef=OpEventGetMaxComMode_GetMaxComMode_UR_CN_CAN00_99a1e90e
          OpEventGetRequestedComMode_GetRequestedComMode_UR_CN_CAN00_99a1e90e: RteEventRef=OpEventGetRequestedComMode_GetRequestedComMode_UR_CN_CAN00_99a1e90e
      Det_EcuSwComposition: RteSoftwareComponentInstanceRef=Det
        OpEventReportError_ReportError_DetModule (RteEventToTaskMapping): RteImmediateRestart=false, RtePositionInTask=14, RteEventRef=OpEventReportError_ReportError_DetModule, RteMappedToTaskRef=SchM_Core0
      EcuM_EcuSwComposition: RteSoftwareComponentInstanceRef=EcuM
        8 x RteEventToTaskMapping, all with RteImmediateRestart=false:
          Timer_EcuM_MainFunction: RtePositionInTask=10, RteEventRef=Timer_EcuM_MainFunction, RteMappedToTaskRef=SchM_Core0, RteUsedOsEventRef=Rte_Ev_Cyclic2_SchM_Core0_0_10ms, RteUsedOsAlarmRef=Rte_Al_TE2_SchM_Core0_0_10ms
          OpEventSelectShutdownTarget_SelectShutdownTarget_EcuM_ShutdownTarget: RteEventRef=OpEventSelectShutdownTarget_SelectShutdownTarget_EcuM_ShutdownTarget
          OpEventGetShutdownTarget_GetShutdownTarget_EcuM_ShutdownTarget: RteEventRef=OpEventGetShutdownTarget_GetShutdownTarget_EcuM_ShutdownTarget
          OpEventGetLastShutdownTarget_GetLastShutdownTarget_EcuM_ShutdownTarget: RteEventRef=OpEventGetLastShutdownTarget_GetLastShutdownTarget_EcuM_ShutdownTarget
          OpEventSelectShutdownCause_SelectShutdownCause_EcuM_ShutdownTarget: RteEventRef=OpEventSelectShutdownCause_SelectShutdownCause_EcuM_ShutdownTarget
          OpEventGetShutdownCause_GetShutdownCause_EcuM_ShutdownTarget: RteEventRef=OpEventGetShutdownCause_GetShutdownCause_EcuM_ShutdownTarget
          OpEventSelectBootTarget_SelectBootTarget_EcuM_BootTarget: RteEventRef=OpEventSelectBootTarget_SelectBootTarget_EcuM_BootTarget
          OpEventGetBootTarget_GetBootTarget_EcuM_BootTarget: RteEventRef=OpEventGetBootTarget_GetBootTarget_EcuM_BootTarget
      BswM_EcuSwComposition: RteSoftwareComponentInstanceRef=BswM
        Timer_BswM_MainFunction (RteEventToTaskMapping):
          RteImmediateRestart = false
          RtePositionInTask = 0
          RteEventRef = Timer_BswM_MainFunction
          RteMappedToTaskRef = SchM_Core0
          RteUsedOsEventRef = Rte_Ev_Cyclic2_SchM_Core0_0_10ms
          RteUsedOsAlarmRef = Rte_Al_TE2_SchM_Core0_0_10ms
    Dio (RteBswModuleInstance): RteBswImplementationRef=Dio_Impl, RteBswModuleConfigurationRef=Dio
    12 x RteSwComponentInstance:
      Os_OsCore0_swc_EcuSwComposition: RteSoftwareComponentInstanceRef=Os_OsCore0_swc
        OpEventGetElapsedValue_GetElapsedValue_OsService_SystemTimer0 (RteEventToTaskMapping):
          RteImmediateRestart = false
          RtePositionInTask = 13
          RteEventRef = OpEventGetElapsedValue_GetElapsedValue_OsService_SystemTimer0
          RteMappedToTaskRef = SchM_Core0
        OpEventGetCounterValue_GetCounterValue_OsService_SystemTimer0 (RteEventToTaskMapping):
          RteImmediateRestart = false
          RtePositionInTask = 12
          RteEventRef = OpEventGetCounterValue_GetCounterValue_OsService_SystemTimer0
          RteMappedToTaskRef = SchM_Core0
      Os_OsCore1_swc_EcuSwComposition: RteSoftwareComponentInstanceRef=Os_OsCore1_swc
        OpEventGetCounterValue_GetCounterValue_OsService_SystemTimer1 (RteEventToTaskMapping):
          RteImmediateRestart = false
          RtePositionInTask = 1
          RteEventRef = OpEventGetCounterValue_GetCounterValue_OsService_SystemTimer1
          RteMappedToTaskRef = SchM_Core1
        OpEventGetElapsedValue_GetElapsedValue_OsService_SystemTimer1 (RteEventToTaskMapping):
          RteImmediateRestart = false
          RtePositionInTask = 2
          RteEventRef = OpEventGetElapsedValue_GetElapsedValue_OsService_SystemTimer1
          RteMappedToTaskRef = SchM_Core1
      Os_OsCore2_swc_EcuSwComposition: RteSoftwareComponentInstanceRef=Os_OsCore2_swc
        OpEventGetCounterValue_GetCounterValue_OsService_SystemTimer2 (RteEventToTaskMapping):
          RteImmediateRestart = false
          RtePositionInTask = 1
          RteEventRef = OpEventGetCounterValue_GetCounterValue_OsService_SystemTimer2
          RteMappedToTaskRef = SchM_Core2
        OpEventGetElapsedValue_GetElapsedValue_OsService_SystemTimer2 (RteEventToTaskMapping):
          RteImmediateRestart = false
          RtePositionInTask = 2
          RteEventRef = OpEventGetElapsedValue_GetElapsedValue_OsService_SystemTimer2
          RteMappedToTaskRef = SchM_Core2
      Os_OsCore3_swc_EcuSwComposition: RteSoftwareComponentInstanceRef=Os_OsCore3_swc
        OpEventGetCounterValue_GetCounterValue_OsService_SystemTimer3 (RteEventToTaskMapping):
          RteImmediateRestart = false
          RtePositionInTask = 1
          RteEventRef = OpEventGetCounterValue_GetCounterValue_OsService_SystemTimer3
          RteMappedToTaskRef = SchM_Core3
        OpEventGetElapsedValue_GetElapsedValue_OsService_SystemTimer3 (RteEventToTaskMapping):
          RteImmediateRestart = false
          RtePositionInTask = 2
          RteEventRef = OpEventGetElapsedValue_GetElapsedValue_OsService_SystemTimer3
          RteMappedToTaskRef = SchM_Core3
      Os_OsCore4_swc_EcuSwComposition: RteSoftwareComponentInstanceRef=Os_OsCore4_swc
        OpEventGetCounterValue_GetCounterValue_OsService_SystemTimer4 (RteEventToTaskMapping):
          RteImmediateRestart = false
          RtePositionInTask = 1
          RteEventRef = OpEventGetCounterValue_GetCounterValue_OsService_SystemTimer4
          RteMappedToTaskRef = SchM_Core4
        OpEventGetElapsedValue_GetElapsedValue_OsService_SystemTimer4 (RteEventToTaskMapping):
          RteImmediateRestart = false
          RtePositionInTask = 2
          RteEventRef = OpEventGetElapsedValue_GetElapsedValue_OsService_SystemTimer4
          RteMappedToTaskRef = SchM_Core4
      Os_OsCore5_swc_EcuSwComposition: RteSoftwareComponentInstanceRef=Os_OsCore5_swc
        OpEventGetCounterValue_GetCounterValue_OsService_SystemTimer5 (RteEventToTaskMapping):
          RteImmediateRestart = false
          RtePositionInTask = 1
          RteEventRef = OpEventGetCounterValue_GetCounterValue_OsService_SystemTimer5
          RteMappedToTaskRef = SchM_Core5
        OpEventGetElapsedValue_GetElapsedValue_OsService_SystemTimer5 (RteEventToTaskMapping):
          RteImmediateRestart = false
          RtePositionInTask = 2
          RteEventRef = OpEventGetElapsedValue_GetElapsedValue_OsService_SystemTimer5
          RteMappedToTaskRef = SchM_Core5
      Core0Swc_EcuSwComposition: RteSoftwareComponentInstanceRef=Core0Swc
        TMT_Core0Runnable (RteEventToTaskMapping):
          RteImmediateRestart = false
          RtePositionInTask = 0
          RteEventRef = TMT_Core0Runnable
          RteMappedToTaskRef = APP_Task_Core0
          RteUsedOsAlarmRef = Rte_Al_TE_Core0Swc_Core0Runnable
      Core2Swc_EcuSwComposition: RteSoftwareComponentInstanceRef=Core2Swc
        TMT_Core2Runnable (RteEventToTaskMapping):
          RteImmediateRestart = false
          RtePositionInTask = 0
          RteEventRef = TMT_Core2Runnable
          RteMappedToTaskRef = APP_Task_Core2
          RteUsedOsAlarmRef = Rte_Al_TE_Core2Swc_Core2Runnable
      Core5Swc_EcuSwComposition: RteSoftwareComponentInstanceRef=Core5Swc
        TMT_Core5Runnable (RteEventToTaskMapping):
          RteImmediateRestart = false
          RtePositionInTask = 0
          RteEventRef = TMT_Core5Runnable
          RteMappedToTaskRef = APP_Task_Core5
          RteUsedOsAlarmRef = Rte_Al_TE_Core5Swc_Core5Runnable
      Core1Swc_EcuSwComposition: RteSoftwareComponentInstanceRef=Core1Swc
        TMT_Core1Runnable (RteEventToTaskMapping):
          RteImmediateRestart = false
          RtePositionInTask = 0
          RteEventRef = TMT_Core1Runnable
          RteMappedToTaskRef = APP_Task_Core1
          RteUsedOsAlarmRef = Rte_Al_TE_Core1Swc_Core1Runnable
      Core4Swc_EcuSwComposition: RteSoftwareComponentInstanceRef=Core4Swc
        TMT_Core4Runnable (RteEventToTaskMapping):
          RteImmediateRestart = false
          RtePositionInTask = 0
          RteEventRef = TMT_Core4Runnable
          RteMappedToTaskRef = APP_Task_Core4
          RteUsedOsAlarmRef = Rte_Al_TE_Core4Swc_Core4Runnable
      Core3Swc_EcuSwComposition: RteSoftwareComponentInstanceRef=Core3Swc
        TMT_Core3Runnable (RteEventToTaskMapping):
          RteImmediateRestart = false
          RtePositionInTask = 0
          RteEventRef = TMT_Core3Runnable
          RteMappedToTaskRef = APP_Task_Core3
          RteUsedOsAlarmRef = Rte_Al_TE_Core3Swc_Core3Runnable
    6 x RteSwComponentType:
      Core5Swc: RteComponentTypeRef=Core5Swc, RteImplementationRef=Core5Swc_Implementation
        ComponentTypeCalibration (RteComponentTypeCalibration): RteCalibrationSupportEnabled=false
      Core1Swc: RteComponentTypeRef=Core1Swc, RteImplementationRef=Core1Swc_Implementation
        ComponentTypeCalibration (RteComponentTypeCalibration): RteCalibrationSupportEnabled=false
      Core0Swc: RteComponentTypeRef=Core0Swc, RteImplementationRef=Core0Swc_Implementation
        ComponentTypeCalibration (RteComponentTypeCalibration): RteCalibrationSupportEnabled=false
      Core4Swc: RteComponentTypeRef=Core4Swc, RteImplementationRef=Core4Swc_Implementation
        ComponentTypeCalibration (RteComponentTypeCalibration): RteCalibrationSupportEnabled=false
      Core3Swc: RteComponentTypeRef=Core3Swc, RteImplementationRef=Core3Swc_Implementation
        ComponentTypeCalibration (RteComponentTypeCalibration): RteCalibrationSupportEnabled=false
      Core2Swc: RteComponentTypeRef=Core2Swc, RteImplementationRef=Core2Swc_Implementation
        ComponentTypeCalibration (RteComponentTypeCalibration): RteCalibrationSupportEnabled=false
    4 x RteBswModuleInstance:
      Mcu: RteBswImplementationRef=Mcu_Impl, RteBswModuleConfigurationRef=Mcu
        TomTgcReg (RteBswExclusiveAreaImpl): RteExclusiveAreaImplMechanism=ALL_INTERRUPT_BLOCKING, RteBswExclusiveAreaRef=TomTgcReg
        AtomAgcReg (RteBswExclusiveAreaImpl): RteExclusiveAreaImplMechanism=ALL_INTERRUPT_BLOCKING, RteBswExclusiveAreaRef=AtomAgcReg
      McalLib: RteBswImplementationRef=McalLib_Impl, RteBswModuleConfigurationRef=McalLib
        4 x RteBswExclusiveAreaImpl, all with RteExclusiveAreaImplMechanism=ALL_INTERRUPT_BLOCKING:
          PeripheralEndInit: RteBswExclusiveAreaRef=PeripheralEndInit
          SafetyEndInit: RteBswExclusiveAreaRef=SafetyEndInit
          CpuEndInit: RteBswExclusiveAreaRef=CpuEndInit
          StmTimerResolution: RteBswExclusiveAreaRef=StmTimerResolution
      Port: RteBswImplementationRef=Port_Impl, RteBswModuleConfigurationRef=Port
      Xcp: RteBswImplementationRef=Xcp_Impl, RteBswModuleConfigurationRef=Xcp
        Xcp_MainFunctionTimingEvent0 (RteBswEventToTaskMapping):
          RteBswImmediateRestart = false
          RteBswPositionInTask = 9
          RteBswEventRef = Xcp_MainFunctionTimingEvent0
          RteBswMappedToTaskRef = SchM_Core0
          RteBswUsedOsEventRef = Rte_Ev_Cyclic2_SchM_Core0_0_5ms
          RteBswUsedOsAlarmRef = Rte_Al_TE2_SchM_Core0_0_5ms
        CanXcp_MainFunctionTimingEvent0 (RteBswEventToTaskMapping):
          RteBswImmediateRestart = false
          RteBswPositionInTask = 8
          RteBswEventRef = CanXcp_MainFunctionTimingEvent0
          RteBswMappedToTaskRef = SchM_Core0
          RteBswUsedOsEventRef = Rte_Ev_Cyclic2_SchM_Core0_0_5ms
          RteBswUsedOsAlarmRef = Rte_Al_TE2_SchM_Core0_0_5ms
        8 x RteBswExclusiveAreaImpl, all with RteExclusiveAreaImplMechanism=ALL_INTERRUPT_BLOCKING:
          XCP_EXCLUSIVE_AREA_{0..2}: RteBswExclusiveAreaRef=XCP_EXCLUSIVE_AREA_{0..2}
          CANXCP_EXCLUSIVE_AREA_0: RteBswExclusiveAreaRef=CANXCP_EXCLUSIVE_AREA_0
          FRXCP_EXCLUSIVE_AREA_{0..2}: RteBswExclusiveAreaRef=FRXCP_EXCLUSIVE_AREA_{0..2}
          TCPIPXCP_EXCLUSIVE_AREA_0: RteBswExclusiveAreaRef=TCPIPXCP_EXCLUSIVE_AREA_0
