AUTOSAR XML (schema 4-2-1)
package /ActiveEcuC
  module config Os: implementation-config-variant=VARIANT-PRE-COMPILE, module-description=Os_Impl
    OsPublishedInformation: OsKernelVersion=7, OsPlatformName=TriCoreAurix
      TC39x (OsDerivativeInformation):
        OsMpuAlignment = 8
        OsStackAlignment = 8
        OsExceptionVectorTableAlignment = 32
        OsInterruptVectorTableAlignment = 32
        OsHardwareManuals = User Manual: TC3XX_ts__TargetSpec_rev1v3v0.pdf V1.3.0, 2016-02 Errata Sheet: TC39x AA_Errata_Sheet_rev1v0_2016-06-08.pdf Rel. 1.0, 2016-06-08
        3 x OsHardwareTimer, all with OsHardwareTimerSize=32, OsHardwareTimerUnit=FRT, OsHardwareTimerType=STM:
          STM0: OsHardwareTimerBaseAddress=4026535936, OsHardwareTimerId=0
            STM0_Ch0 (OsHardwareTimerChannel): OsHardwareTimerChannelIntSource=768, OsHardwareTimerChannelOffset=0, OsHardwareTimerChannelId=0
            STM0_Ch1 (OsHardwareTimerChannel): OsHardwareTimerChannelIntSource=772, OsHardwareTimerChannelOffset=1, OsHardwareTimerChannelId=1
          STM2: OsHardwareTimerBaseAddress=4026536448, OsHardwareTimerId=2
            STM2_Ch0 (OsHardwareTimerChannel): OsHardwareTimerChannelIntSource=784, OsHardwareTimerChannelOffset=0, OsHardwareTimerChannelId=0
            STM2_Ch1 (OsHardwareTimerChannel): OsHardwareTimerChannelIntSource=788, OsHardwareTimerChannelOffset=1, OsHardwareTimerChannelId=1
          STM1: OsHardwareTimerBaseAddress=4026536192, OsHardwareTimerId=1
            STM1_Ch0 (OsHardwareTimerChannel): OsHardwareTimerChannelIntSource=776, OsHardwareTimerChannelOffset=0, OsHardwareTimerChannelId=0
            STM1_Ch1 (OsHardwareTimerChannel): OsHardwareTimerChannelIntSource=780, OsHardwareTimerChannelOffset=1, OsHardwareTimerChannelId=1
        AURIXTC3XX_IR (OsSystemIntCtrl): OsSystemIntCtrlMaxPrios=255, OsSystemIntCtrlPrioOrder=ASC, OsSystemIntCtrlMaxSources=8192, OsSystemIntCtrlBaseAddress=4026757120
        DMA (OsInterruptSupportedType): OsInterruptSupportedTypeSeparateSources=false
        STM4 (OsHardwareTimer): OsHardwareTimerSize=32, OsHardwareTimerUnit=FRT, OsHardwareTimerBaseAddress=4026536960, OsHardwareTimerId=4, OsHardwareTimerType=STM
          STM4_Ch0 (OsHardwareTimerChannel): OsHardwareTimerChannelIntSource=800, OsHardwareTimerChannelOffset=0, OsHardwareTimerChannelId=0
          STM4_Ch1 (OsHardwareTimerChannel): OsHardwareTimerChannelIntSource=804, OsHardwareTimerChannelOffset=1, OsHardwareTimerChannelId=1
        STM3 (OsHardwareTimer): OsHardwareTimerSize=32, OsHardwareTimerUnit=FRT, OsHardwareTimerBaseAddress=4026536704, OsHardwareTimerId=3, OsHardwareTimerType=STM
          STM3_Ch0 (OsHardwareTimerChannel): OsHardwareTimerChannelIntSource=792, OsHardwareTimerChannelOffset=0, OsHardwareTimerChannelId=0
          STM3_Ch1 (OsHardwareTimerChannel): OsHardwareTimerChannelIntSource=796, OsHardwareTimerChannelOffset=1, OsHardwareTimerChannelId=1
        DEFAULT (OsInterruptSupportedType): OsInterruptSupportedTypeSeparateSources=false
        STM5 (OsHardwareTimer): OsHardwareTimerSize=32, OsHardwareTimerUnit=FRT, OsHardwareTimerBaseAddress=4026537216, OsHardwareTimerId=5, OsHardwareTimerType=STM
          STM5_Ch0 (OsHardwareTimerChannel): OsHardwareTimerChannelIntSource=808, OsHardwareTimerChannelOffset=0, OsHardwareTimerChannelId=0
          STM5_Ch1 (OsHardwareTimerChannel): OsHardwareTimerChannelIntSource=812, OsHardwareTimerChannelOffset=1, OsHardwareTimerChannelId=1
        GPT (OsHardwareTimer): OsHardwareTimerSize=16, OsHardwareTimerUnit=PIT, OsHardwareTimerBaseAddress=4026537984, OsHardwareTimerId=0, OsHardwareTimerType=PIT
          GPT_Ch0 (OsHardwareTimerChannel): OsHardwareTimerChannelIntSource=744, OsHardwareTimerChannelOffset=0, OsHardwareTimerChannelId=0
          GPT_Ch1 (OsHardwareTimerChannel): OsHardwareTimerChannelIntSource=756, OsHardwareTimerChannelOffset=1, OsHardwareTimerChannelId=1
        5 x OsPhysicalCore, all with OsPhysicalCoreType=TC1.6.2P, OsPhysicalCoreExceptionSources=8, OsPhysicalCorePrivelegedHwAccess=true:
          Core0: OsPhysicalCoreId=0, OsPhysicalCoreDefaultEntrySymbol=_start_tc0, OsPhysicalCoreMasterStartAllowed=true, OsPhysicalCoreIsAutostart=true, OsPhysicalCoreStackProtectionUnit=OsPhysicalCore0DataMpu
            OsPhysicalCore0DataMpu (OsPhysicalCoreMpu): OsPhysicalCoreMpuId=0, OsPhysicalCoreMpuMaxRegions=18, OsPhysicalCoreMpuType=DATA
            OsPhysicalCore0CodeMpu (OsPhysicalCoreMpu): OsPhysicalCoreMpuId=1, OsPhysicalCoreMpuMaxRegions=10, OsPhysicalCoreMpuType=CODE
          Core1: OsPhysicalCoreId=1, OsPhysicalCoreDefaultEntrySymbol=_start_tc1, OsPhysicalCoreMasterStartAllowed=false, OsPhysicalCoreIsAutostart=false, OsPhysicalCoreStackProtectionUnit=OsPhysicalCore1DataMpu
            OsPhysicalCore1DataMpu (OsPhysicalCoreMpu): OsPhysicalCoreMpuId=0, OsPhysicalCoreMpuMaxRegions=18, OsPhysicalCoreMpuType=DATA
            OsPhysicalCore1CodeMpu (OsPhysicalCoreMpu): OsPhysicalCoreMpuId=1, OsPhysicalCoreMpuMaxRegions=10, OsPhysicalCoreMpuType=CODE
          Core2: OsPhysicalCoreId=2, OsPhysicalCoreDefaultEntrySymbol=_start_tc2, OsPhysicalCoreMasterStartAllowed=false, OsPhysicalCoreIsAutostart=false, OsPhysicalCoreStackProtectionUnit=OsPhysicalCore2DataMpu
            OsPhysicalCore2DataMpu (OsPhysicalCoreMpu): OsPhysicalCoreMpuId=0, OsPhysicalCoreMpuMaxRegions=18, OsPhysicalCoreMpuType=DATA
            OsPhysicalCore2CodeMpu (OsPhysicalCoreMpu): OsPhysicalCoreMpuId=1, OsPhysicalCoreMpuMaxRegions=10, OsPhysicalCoreMpuType=CODE
          Core3: OsPhysicalCoreId=3, OsPhysicalCoreDefaultEntrySymbol=_start_tc3, OsPhysicalCoreMasterStartAllowed=false, OsPhysicalCoreIsAutostart=false, OsPhysicalCoreStackProtectionUnit=OsPhysicalCore3DataMpu
            OsPhysicalCore3CodeMpu (OsPhysicalCoreMpu): OsPhysicalCoreMpuId=1, OsPhysicalCoreMpuMaxRegions=10, OsPhysicalCoreMpuType=CODE
            OsPhysicalCore3DataMpu (OsPhysicalCoreMpu): OsPhysicalCoreMpuId=0, OsPhysicalCoreMpuMaxRegions=18, OsPhysicalCoreMpuType=DATA
          Core4: OsPhysicalCoreId=4, OsPhysicalCoreDefaultEntrySymbol=_start_tc4, OsPhysicalCoreMasterStartAllowed=false, OsPhysicalCoreIsAutostart=false, OsPhysicalCoreStackProtectionUnit=OsPhysicalCore4DataMpu
            OsPhysicalCore4DataMpu (OsPhysicalCoreMpu): OsPhysicalCoreMpuId=0, OsPhysicalCoreMpuMaxRegions=18, OsPhysicalCoreMpuType=DATA
            OsPhysicalCore4CodeMpu (OsPhysicalCoreMpu): OsPhysicalCoreMpuId=1, OsPhysicalCoreMpuMaxRegions=10, OsPhysicalCoreMpuType=CODE
        OsMemoryRegionSpecifics
          18 x OsMemoryRegionAccess:
            PS{2..4}_R: OsMemoryRegionAccessRights=R, OsMemoryRegionAccessType=PROTECTION_SET{2..4}
            PS0_W: OsMemoryRegionAccessRights=W, OsMemoryRegionAccessType=PROTECTION_SET0
            PS5_R: OsMemoryRegionAccessRights=R, OsMemoryRegionAccessType=PROTECTION_SET5
            PS0_R: OsMemoryRegionAccessRights=R, OsMemoryRegionAccessType=PROTECTION_SET0
            PS1_R: OsMemoryRegionAccessRights=R, OsMemoryRegionAccessType=PROTECTION_SET1
            PS4_X: OsMemoryRegionAccessRights=X, OsMemoryRegionAccessType=PROTECTION_SET4
            PS5_W: OsMemoryRegionAccessRights=W, OsMemoryRegionAccessType=PROTECTION_SET5
            PS5_X: OsMemoryRegionAccessRights=X, OsMemoryRegionAccessType=PROTECTION_SET5
            PS0_X: OsMemoryRegionAccessRights=X, OsMemoryRegionAccessType=PROTECTION_SET0
            PS1_W: OsMemoryRegionAccessRights=W, OsMemoryRegionAccessType=PROTECTION_SET1
            PS1_X: OsMemoryRegionAccessRights=X, OsMemoryRegionAccessType=PROTECTION_SET1
            PS2_W: OsMemoryRegionAccessRights=W, OsMemoryRegionAccessType=PROTECTION_SET2
            PS2_X: OsMemoryRegionAccessRights=X, OsMemoryRegionAccessType=PROTECTION_SET2
            PS3_W: OsMemoryRegionAccessRights=W, OsMemoryRegionAccessType=PROTECTION_SET3
            PS3_X: OsMemoryRegionAccessRights=X, OsMemoryRegionAccessType=PROTECTION_SET3
            PS4_W: OsMemoryRegionAccessRights=W, OsMemoryRegionAccessType=PROTECTION_SET4
        Core5 (OsPhysicalCore):
          OsPhysicalCoreId = 6
          OsPhysicalCoreDefaultEntrySymbol = _start_tc5
          OsPhysicalCoreType = TC1.6.2P
          OsPhysicalCoreExceptionSources = 8
          OsPhysicalCoreMasterStartAllowed = false
          OsPhysicalCorePrivelegedHwAccess = true
          OsPhysicalCoreIsAutostart = false
          OsPhysicalCoreStackProtectionUnit = OsPhysicalCore5DataMpu
          OsPhysicalCore5DataMpu (OsPhysicalCoreMpu): OsPhysicalCoreMpuId=0, OsPhysicalCoreMpuMaxRegions=18, OsPhysicalCoreMpuType=DATA
          OsPhysicalCore5CodeMpu (OsPhysicalCoreMpu): OsPhysicalCoreMpuId=1, OsPhysicalCoreMpuMaxRegions=10, OsPhysicalCoreMpuType=CODE
    OS_APPMODE_ANY (OsAppMode)
    OSDEFAULTAPPMODE (OsAppMode)
    OsOS:
      OsStackMonitoring = true
      OsStatus = EXTENDED
      OsUseGetServiceId = false
      OsUseParameterAccess = false
      OsUseResScheduler = true
      OsForcibleTermination = false
      OsGenerateCalloutStubs = true
      OsGenerateMemMap = COMPLETE
      OsGenerateMemMapForNearAddressing = true
      OsGenerateMemMapForThreads = false
      OsServiceProtection = false
      OsStackUsageMeasurement = false
      OsUseXSignalAsyncApiCalls = true
      OsFpuUsage = NONE
      OsScalabilityClass = SC1
      OsNumberOfCores = 6
      OsMasterCore = OsCore0
      OsSystemTimer = SystemTimer0
      OsHardwareInitCore = OsCore0
      OsStackSummary
        48 x OsStack, all with OsStackSize=1024:
          OsCore0_Error: OsStackType=CORE_ERROR_STACK, OsStackCore=OsCore0, OsStackUser=OsCore0
          OsCore0_Init: OsStackType=CORE_INIT_STACK, OsStackCore=OsCore0, OsStackUser=OsCore0
          OsCore0_Kernel: OsStackType=CORE_KERNEL_STACK, OsStackCore=OsCore0, OsStackUser=OsCore0
          OsCore0_Isr_Core: OsStackType=ISR_SHARED_CORE_STACK, OsStackCore=OsCore0, OsStackUser=CounterIsr_SystemTimer0, OsStackUser=CanIsr_0, OsStackUser=XSignalIsr_OsCore0
          OsCore0_Task_Prio4294967295: OsStackType=TASK_SHARED_PRIORITY_STACK, OsStackCore=OsCore0, OsStackUser=IdleTask_OsCore0
          OsCore1_Error: OsStackType=CORE_ERROR_STACK, OsStackCore=OsCore1, OsStackUser=OsCore1
          OsCore1_Init: OsStackType=CORE_INIT_STACK, OsStackCore=OsCore1, OsStackUser=OsCore1
          OsCore1_Kernel: OsStackType=CORE_KERNEL_STACK, OsStackCore=OsCore1, OsStackUser=OsCore1
          OsCore1_Task_Prio4294967295: OsStackType=TASK_SHARED_PRIORITY_STACK, OsStackCore=OsCore1, OsStackUser=IdleTask_OsCore1
          OsCore2_Error: OsStackType=CORE_ERROR_STACK, OsStackCore=OsCore2, OsStackUser=OsCore2
          OsCore2_Init: OsStackType=CORE_INIT_STACK, OsStackCore=OsCore2, OsStackUser=OsCore2
          OsCore2_Kernel: OsStackType=CORE_KERNEL_STACK, OsStackCore=OsCore2, OsStackUser=OsCore2
          OsCore2_Task_Prio4294967295: OsStackType=TASK_SHARED_PRIORITY_STACK, OsStackCore=OsCore2, OsStackUser=IdleTask_OsCore2
          OsCore3_Error: OsStackType=CORE_ERROR_STACK, OsStackCore=OsCore3, OsStackUser=OsCore3
          OsCore3_Init: OsStackType=CORE_INIT_STACK, OsStackCore=OsCore3, OsStackUser=OsCore3
          OsCore3_Kernel: OsStackType=CORE_KERNEL_STACK, OsStackCore=OsCore3, OsStackUser=OsCore3
          OsCore3_Task_Prio4294967295: OsStackType=TASK_SHARED_PRIORITY_STACK, OsStackCore=OsCore3, OsStackUser=IdleTask_OsCore3
          OsCore4_Error: OsStackType=CORE_ERROR_STACK, OsStackCore=OsCore4, OsStackUser=OsCore4
          OsCore4_Init: OsStackType=CORE_INIT_STACK, OsStackCore=OsCore4, OsStackUser=OsCore4
          OsCore4_Kernel: OsStackType=CORE_KERNEL_STACK, OsStackCore=OsCore4, OsStackUser=OsCore4
          OsCore4_Task_Prio4294967295: OsStackType=TASK_SHARED_PRIORITY_STACK, OsStackCore=OsCore4, OsStackUser=IdleTask_OsCore4
          OsCore5_Error: OsStackType=CORE_ERROR_STACK, OsStackCore=OsCore5, OsStackUser=OsCore5
          OsCore5_Init: OsStackType=CORE_INIT_STACK, OsStackCore=OsCore5, OsStackUser=OsCore5
          OsCore5_Kernel: OsStackType=CORE_KERNEL_STACK, OsStackCore=OsCore5, OsStackUser=OsCore5
          OsCore5_Task_Prio4294967295: OsStackType=TASK_SHARED_PRIORITY_STACK, OsStackCore=OsCore5, OsStackUser=IdleTask_OsCore5
          OsCore{1..5}_Isr_Core: OsStackType=ISR_SHARED_CORE_STACK, OsStackCore=OsCore{1..5}, OsStackUser=CounterIsr_SystemTimer{1..5}, OsStackUser=XSignalIsr_OsCore{1..5}
          OsCore0_Task_Prio100: OsStackType=TASK_SHARED_PRIORITY_STACK, OsStackCore=OsCore0, OsStackUser=Init_Core0
          SchM_Core0: OsStackType=TASK_SHARED_PRIORITY_STACK, OsStackCore=OsCore0, OsStackUser=Os/SchM_Core0
          OsCore0_Task_Prio50: OsStackType=TASK_SHARED_PRIORITY_STACK, OsStackCore=OsCore0, OsStackUser=APP_Task_Core0
          OsCore1_Task_Prio100: OsStackType=TASK_SHARED_PRIORITY_STACK, OsStackCore=OsCore1, OsStackUser=Init_Core1
          OsCore1_Task_Prio20: OsStackType=TASK_SHARED_PRIORITY_STACK, OsStackCore=OsCore1, OsStackUser=SchM_Core1
          OsCore1_Task_Prio50: OsStackType=TASK_SHARED_PRIORITY_STACK, OsStackCore=OsCore1, OsStackUser=APP_Task_Core1
          OsCore2_Task_Prio100: OsStackType=TASK_SHARED_PRIORITY_STACK, OsStackCore=OsCore2, OsStackUser=Init_Core2
          OsCore2_Task_Prio20: OsStackType=TASK_SHARED_PRIORITY_STACK, OsStackCore=OsCore2, OsStackUser=SchM_Core2
          OsCore2_Task_Prio50: OsStackType=TASK_SHARED_PRIORITY_STACK, OsStackCore=OsCore2, OsStackUser=APP_Task_Core2
          OsCore3_Task_Prio100: OsStackType=TASK_SHARED_PRIORITY_STACK, OsStackCore=OsCore3, OsStackUser=Init_Core3
          OsCore3_Task_Prio20: OsStackType=TASK_SHARED_PRIORITY_STACK, OsStackCore=OsCore3, OsStackUser=SchM_Core3
          OsCore3_Task_Prio50: OsStackType=TASK_SHARED_PRIORITY_STACK, OsStackCore=OsCore3, OsStackUser=APP_Task_Core3
          OsCore4_Task_Prio100: OsStackType=TASK_SHARED_PRIORITY_STACK, OsStackCore=OsCore4, OsStackUser=Init_Core4
          OsCore4_Task_Prio20: OsStackType=TASK_SHARED_PRIORITY_STACK, OsStackCore=OsCore4, OsStackUser=SchM_Core4
          OsCore4_Task_Prio50: OsStackType=TASK_SHARED_PRIORITY_STACK, OsStackCore=OsCore4, OsStackUser=APP_Task_Core4
          OsCore5_Task_Prio100: OsStackType=TASK_SHARED_PRIORITY_STACK, OsStackCore=OsCore5, OsStackUser=Init_Core5
          OsCore5_Task_Prio20: OsStackType=TASK_SHARED_PRIORITY_STACK, OsStackCore=OsCore5, OsStackUser=SchM_Core5
          OsCore5_Task_Prio50: OsStackType=TASK_SHARED_PRIORITY_STACK, OsStackCore=OsCore5, OsStackUser=APP_Task_Core5
      OsHooks: OsErrorHook=true, OsPostTaskHook=false, OsPreTaskHook=false, OsShutdownHook=false, OsStartupHook=false
    OsCore0 (OsCore):
      OsCoreIsAutostart = true
      OsCoreIsAutosar = true
      OsCoreEntrySymbol = _start_tc0
      OsCorePhysicalCoreRef = Core0
      OsCoreIdleTask = IdleTask_OsCore0
      OsCoreSystemApplication = SystemApplication_OsCore0
      OsCoreResScheduler = RES_SCHEDULER_OsCore0
      OsCoreEcucCoreRef = EcucCoreDefinition
      OsCoreStacks:
        OsCoreKernelStackSize = 1024
        OsCoreStartupStackSize = 1024
        OsCoreShutdownStackSize = 1024
        OsCoreErrorStackSize = 1024
        OsCoreProtectionStackSize = 1024
        OsCoreInitStackSize = 1024
      5 x OsCoreXSignalChannel, all with OsCoreXSignalChannelSize=1:
        XSignalChl_OsCore4: OsCoreXSignalChannelReceiverIsr=XSignalIsr_OsCore4
        XSignalChl_OsCore3: OsCoreXSignalChannelReceiverIsr=XSignalIsr_OsCore3
        XSignalChl_OsCore2: OsCoreXSignalChannelReceiverIsr=XSignalIsr_OsCore2
        XSignalChl_OsCore1: OsCoreXSignalChannelReceiverIsr=XSignalIsr_OsCore1
        XSignalChl_OsCore5: OsCoreXSignalChannelReceiverIsr=XSignalIsr_OsCore5
    IdleTask_OsCore0 (OsTask):
      OsTaskActivation = 1
      OsTaskPriority = 4294967295
      OsTaskSchedule = FULL
      OsTaskStackSharing = false
      OsTaskStackSize = 1024
      OsTaskType = AUTO
      OsTaskUsesFpu = false
      OsTaskAccessingApplication = SystemApplication_OsCore0
      OsTaskResourceRef = RES_SCHEDULER_OsCore0
      OsTaskAccessingApplication = SystemApplication_OsCore{1..5}
      OsTaskAutostart: OsTaskAppModeRef=OS_APPMODE_ANY
    SystemApplication_OsCore0 (OsApplication):
      OsTrusted = true
      OsTrustedApplicationDelayTimingViolationCall = false
      OsTrustedApplicationWithProtection = false
      OsApplicationIsPrivileged = true
      OsAppUseTrustedFunctionStubs = false
      OsAppTaskRef = IdleTask_OsCore0
      OsApplicationCoreRef = EcucCoreDefinition
      OsAppEcucPartitionRef = EcucPartition
      OsAppIsrRef = CounterIsr_SystemTimer0
      OsAppCounterRef = SystemTimer0
      OsAppTaskRef = Init_Core0
      OsAppTaskRef = Os/SchM_Core0
      OsAppTaskRef = APP_Task_Core0
      OsAppAlarmRef = Rte_Al_TE_Core0Swc_Core0Runnable
      OsAppAlarmRef = Rte_Al_TE2_SchM_Core0_0_10ms
      OsAppAlarmRef = Rte_Al_TE2_SchM_Core0_0_1ms
      OsAppAlarmRef = Rte_Al_TE2_SchM_Core0_0_20ms
      OsAppIsrRef = CanIsr_0
      OsAppIsrRef = XSignalIsr_OsCore0
      OsAppAlarmRef = Rte_Al_TE2_SchM_Core0_0_5ms
      OsApplicationHooks: OsAppErrorHook=false, OsAppShutdownHook=false, OsAppStartupHook=false
    RES_SCHEDULER_OsCore0 (OsResource): OsResourceProperty=STANDARD, OsResourceAccessingApplication=SystemApplication_OsCore0
    5 x OsCore, all with OsCoreIsAutostart=false, OsCoreIsAutosar=true:
      OsCore1: OsCoreEntrySymbol=_start_tc1, OsCorePhysicalCoreRef=Core1, OsCoreEcucCoreRef=EcucCoreDefinition_001, OsCoreIdleTask=IdleTask_OsCore1, OsCoreSystemApplication=SystemApplication_OsCore1, OsCoreResScheduler=RES_SCHEDULER_OsCore1
        OsCoreStacks:
          OsCoreKernelStackSize = 1024
          OsCoreStartupStackSize = 1024
          OsCoreShutdownStackSize = 1024
          OsCoreErrorStackSize = 1024
          OsCoreProtectionStackSize = 1024
          OsCoreInitStackSize = 1024
        5 x OsCoreXSignalChannel, all with OsCoreXSignalChannelSize=1:
          XSignalChl_OsCore4: OsCoreXSignalChannelReceiverIsr=XSignalIsr_OsCore4
          XSignalChl_OsCore3: OsCoreXSignalChannelReceiverIsr=XSignalIsr_OsCore3
          XSignalChl_OsCore2: OsCoreXSignalChannelReceiverIsr=XSignalIsr_OsCore2
          XSignalChl_OsCore0: OsCoreXSignalChannelReceiverIsr=XSignalIsr_OsCore0
          XSignalChl_OsCore5: OsCoreXSignalChannelReceiverIsr=XSignalIsr_OsCore5
      OsCore2: OsCoreEntrySymbol=_start_tc2, OsCorePhysicalCoreRef=Core2, OsCoreEcucCoreRef=EcucCoreDefinition_002, OsCoreIdleTask=IdleTask_OsCore2, OsCoreSystemApplication=SystemApplication_OsCore2, OsCoreResScheduler=RES_SCHEDULER_OsCore2
        OsCoreStacks:
          OsCoreKernelStackSize = 1024
          OsCoreStartupStackSize = 1024
          OsCoreShutdownStackSize = 1024
          OsCoreErrorStackSize = 1024
          OsCoreProtectionStackSize = 1024
          OsCoreInitStackSize = 1024
        5 x OsCoreXSignalChannel, all with OsCoreXSignalChannelSize=1:
          XSignalChl_OsCore4: OsCoreXSignalChannelReceiverIsr=XSignalIsr_OsCore4
          XSignalChl_OsCore3: OsCoreXSignalChannelReceiverIsr=XSignalIsr_OsCore3
          XSignalChl_OsCore1: OsCoreXSignalChannelReceiverIsr=XSignalIsr_OsCore1
          XSignalChl_OsCore0: OsCoreXSignalChannelReceiverIsr=XSignalIsr_OsCore0
          XSignalChl_OsCore5: OsCoreXSignalChannelReceiverIsr=XSignalIsr_OsCore5
      OsCore3: OsCoreEntrySymbol=_start_tc3, OsCorePhysicalCoreRef=Core3, OsCoreEcucCoreRef=EcucCoreDefinition_003, OsCoreIdleTask=IdleTask_OsCore3, OsCoreSystemApplication=SystemApplication_OsCore3, OsCoreResScheduler=RES_SCHEDULER_OsCore3
        OsCoreStacks:
          OsCoreKernelStackSize = 1024
          OsCoreStartupStackSize = 1024
          OsCoreShutdownStackSize = 1024
          OsCoreErrorStackSize = 1024
          OsCoreProtectionStackSize = 1024
          OsCoreInitStackSize = 1024
        5 x OsCoreXSignalChannel, all with OsCoreXSignalChannelSize=1:
          XSignalChl_OsCore4: OsCoreXSignalChannelReceiverIsr=XSignalIsr_OsCore4
          XSignalChl_OsCore2: OsCoreXSignalChannelReceiverIsr=XSignalIsr_OsCore2
          XSignalChl_OsCore1: OsCoreXSignalChannelReceiverIsr=XSignalIsr_OsCore1
          XSignalChl_OsCore0: OsCoreXSignalChannelReceiverIsr=XSignalIsr_OsCore0
          XSignalChl_OsCore5: OsCoreXSignalChannelReceiverIsr=XSignalIsr_OsCore5
      OsCore4: OsCoreEntrySymbol=_start_tc4, OsCorePhysicalCoreRef=Core4, OsCoreEcucCoreRef=EcucCoreDefinition_004, OsCoreIdleTask=IdleTask_OsCore4, OsCoreSystemApplication=SystemApplication_OsCore4, OsCoreResScheduler=RES_SCHEDULER_OsCore4
        OsCoreStacks:
          OsCoreKernelStackSize = 1024
          OsCoreStartupStackSize = 1024
          OsCoreShutdownStackSize = 1024
          OsCoreErrorStackSize = 1024
          OsCoreProtectionStackSize = 1024
          OsCoreInitStackSize = 1024
        5 x OsCoreXSignalChannel, all with OsCoreXSignalChannelSize=1:
          XSignalChl_OsCore3: OsCoreXSignalChannelReceiverIsr=XSignalIsr_OsCore3
          XSignalChl_OsCore2: OsCoreXSignalChannelReceiverIsr=XSignalIsr_OsCore2
          XSignalChl_OsCore1: OsCoreXSignalChannelReceiverIsr=XSignalIsr_OsCore1
          XSignalChl_OsCore0: OsCoreXSignalChannelReceiverIsr=XSignalIsr_OsCore0
          XSignalChl_OsCore5: OsCoreXSignalChannelReceiverIsr=XSignalIsr_OsCore5
      OsCore5: OsCoreEntrySymbol=_start_tc5, OsCorePhysicalCoreRef=Core5, OsCoreEcucCoreRef=EcucCoreDefinition_005, OsCoreIdleTask=IdleTask_OsCore5, OsCoreSystemApplication=SystemApplication_OsCore5, OsCoreResScheduler=RES_SCHEDULER_OsCore5
        OsCoreStacks:
          OsCoreKernelStackSize = 1024
          OsCoreStartupStackSize = 1024
          OsCoreShutdownStackSize = 1024
          OsCoreErrorStackSize = 1024
          OsCoreProtectionStackSize = 1024
          OsCoreInitStackSize = 1024
        5 x OsCoreXSignalChannel, all with OsCoreXSignalChannelSize=1:
          XSignalChl_OsCore4: OsCoreXSignalChannelReceiverIsr=XSignalIsr_OsCore4
          XSignalChl_OsCore3: OsCoreXSignalChannelReceiverIsr=XSignalIsr_OsCore3
          XSignalChl_OsCore2: OsCoreXSignalChannelReceiverIsr=XSignalIsr_OsCore2
          XSignalChl_OsCore1: OsCoreXSignalChannelReceiverIsr=XSignalIsr_OsCore1
          XSignalChl_OsCore0: OsCoreXSignalChannelReceiverIsr=XSignalIsr_OsCore0
    IdleTask_OsCore1 (OsTask):
      OsTaskActivation = 1
      OsTaskPriority = 4294967295
      OsTaskSchedule = FULL
      OsTaskStackSharing = false
      OsTaskStackSize = 1024
      OsTaskType = AUTO
      OsTaskUsesFpu = false
      OsTaskAccessingApplication = SystemApplication_OsCore0
      OsTaskAccessingApplication = SystemApplication_OsCore1
      OsTaskResourceRef = RES_SCHEDULER_OsCore1
      OsTaskAccessingApplication = SystemApplication_OsCore{2..5}
      OsTaskAutostart: OsTaskAppModeRef=OS_APPMODE_ANY
    SystemApplication_OsCore1 (OsApplication):
      OsTrusted = true
      OsTrustedApplicationDelayTimingViolationCall = false
      OsTrustedApplicationWithProtection = false
      OsApplicationIsPrivileged = true
      OsAppUseTrustedFunctionStubs = false
      OsApplicationCoreRef = EcucCoreDefinition_001
      OsAppTaskRef = IdleTask_OsCore1
      OsAppEcucPartitionRef = EcucPartition_001
      OsAppIsrRef = CounterIsr_SystemTimer1
      OsAppCounterRef = SystemTimer1
      OsAppTaskRef = Init_Core1
      OsAppTaskRef = SchM_Core1
      OsAppTaskRef = APP_Task_Core1
      OsAppAlarmRef = Rte_Al_TE_Core1Swc_Core1Runnable
      OsAppAlarmRef = Rte_Al_TE1_EcuM_EcuM_MainFunction
      OsAppIsrRef = XSignalIsr_OsCore1
      OsApplicationHooks: OsAppErrorHook=false, OsAppShutdownHook=false, OsAppStartupHook=false
    RES_SCHEDULER_OsCore1 (OsResource): OsResourceProperty=STANDARD, OsResourceAccessingApplication=SystemApplication_OsCore1
    IdleTask_OsCore2 (OsTask):
      OsTaskActivation = 1
      OsTaskPriority = 4294967295
      OsTaskSchedule = FULL
      OsTaskStackSharing = false
      OsTaskStackSize = 1024
      OsTaskType = AUTO
      OsTaskUsesFpu = false
      OsTaskAccessingApplication = SystemApplication_OsCore{0..2}
      OsTaskResourceRef = RES_SCHEDULER_OsCore2
      OsTaskAccessingApplication = SystemApplication_OsCore{3..5}
      OsTaskAutostart: OsTaskAppModeRef=OS_APPMODE_ANY
    SystemApplication_OsCore2 (OsApplication):
      OsTrusted = true
      OsTrustedApplicationDelayTimingViolationCall = false
      OsTrustedApplicationWithProtection = false
      OsApplicationIsPrivileged = true
      OsAppUseTrustedFunctionStubs = false
      OsApplicationCoreRef = EcucCoreDefinition_002
      OsAppTaskRef = IdleTask_OsCore2
      OsAppEcucPartitionRef = EcucPartition_002
      OsAppIsrRef = CounterIsr_SystemTimer2
      OsAppCounterRef = SystemTimer2
      OsAppTaskRef = Init_Core2
      OsAppTaskRef = SchM_Core2
      OsAppTaskRef = APP_Task_Core2
      OsAppAlarmRef = Rte_Al_TE_Core2Swc_Core2Runnable
      OsAppAlarmRef = Rte_Al_TE2_EcuM_EcuM_MainFunction
      OsAppIsrRef = XSignalIsr_OsCore2
      OsApplicationHooks: OsAppErrorHook=false, OsAppShutdownHook=false, OsAppStartupHook=false
    RES_SCHEDULER_OsCore2 (OsResource): OsResourceProperty=STANDARD, OsResourceAccessingApplication=SystemApplication_OsCore2
    IdleTask_OsCore3 (OsTask):
      OsTaskActivation = 1
      OsTaskPriority = 4294967295
      OsTaskSchedule = FULL
      OsTaskStackSharing = false
      OsTaskStackSize = 1024
      OsTaskType = AUTO
      OsTaskUsesFpu = false
      OsTaskAccessingApplication = SystemApplication_OsCore{0..3}
      OsTaskResourceRef = RES_SCHEDULER_OsCore3
      OsTaskAccessingApplication = SystemApplication_OsCore4
      OsTaskAccessingApplication = SystemApplication_OsCore5
      OsTaskAutostart: OsTaskAppModeRef=OS_APPMODE_ANY
    SystemApplication_OsCore3 (OsApplication):
      OsTrusted = true
      OsTrustedApplicationDelayTimingViolationCall = false
      OsTrustedApplicationWithProtection = false
      OsApplicationIsPrivileged = true
      OsAppUseTrustedFunctionStubs = false
      OsApplicationCoreRef = EcucCoreDefinition_003
      OsAppTaskRef = IdleTask_OsCore3
      OsAppEcucPartitionRef = EcucPartition_003
      OsAppIsrRef = CounterIsr_SystemTimer3
      OsAppCounterRef = SystemTimer3
      OsAppTaskRef = Init_Core3
      OsAppTaskRef = SchM_Core3
      OsAppTaskRef = APP_Task_Core3
      OsAppAlarmRef = Rte_Al_TE_Core3Swc_Core3Runnable
      OsAppAlarmRef = Rte_Al_TE3_EcuM_EcuM_MainFunction
      OsAppIsrRef = XSignalIsr_OsCore3
      OsApplicationHooks: OsAppErrorHook=false, OsAppShutdownHook=false, OsAppStartupHook=false
    RES_SCHEDULER_OsCore3 (OsResource): OsResourceProperty=STANDARD, OsResourceAccessingApplication=SystemApplication_OsCore3
    IdleTask_OsCore4 (OsTask):
      OsTaskActivation = 1
      OsTaskPriority = 4294967295
      OsTaskSchedule = FULL
      OsTaskStackSharing = false
      OsTaskStackSize = 1024
      OsTaskType = AUTO
      OsTaskUsesFpu = false
      OsTaskAccessingApplication = SystemApplication_OsCore{0..4}
      OsTaskResourceRef = RES_SCHEDULER_OsCore4
      OsTaskAccessingApplication = SystemApplication_OsCore5
      OsTaskAutostart: OsTaskAppModeRef=OS_APPMODE_ANY
    SystemApplication_OsCore4 (OsApplication):
      OsTrusted = true
      OsTrustedApplicationDelayTimingViolationCall = false
      OsTrustedApplicationWithProtection = false
      OsApplicationIsPrivileged = true
      OsAppUseTrustedFunctionStubs = false
      OsApplicationCoreRef = EcucCoreDefinition_004
      OsAppTaskRef = IdleTask_OsCore4
      OsAppEcucPartitionRef = EcucPartition_004
      OsAppIsrRef = CounterIsr_SystemTimer4
      OsAppCounterRef = SystemTimer4
      OsAppTaskRef = Init_Core4
      OsAppTaskRef = SchM_Core4
      OsAppTaskRef = APP_Task_Core4
      OsAppAlarmRef = Rte_Al_TE_Core4Swc_Core4Runnable
      OsAppAlarmRef = Rte_Al_TE4_EcuM_EcuM_MainFunction
      OsAppIsrRef = XSignalIsr_OsCore4
      OsApplicationHooks: OsAppErrorHook=false, OsAppShutdownHook=false, OsAppStartupHook=false
    RES_SCHEDULER_OsCore4 (OsResource): OsResourceProperty=STANDARD, OsResourceAccessingApplication=SystemApplication_OsCore4
    IdleTask_OsCore5 (OsTask):
      OsTaskActivation = 1
      OsTaskPriority = 4294967295
      OsTaskSchedule = FULL
      OsTaskStackSharing = false
      OsTaskStackSize = 1024
      OsTaskType = AUTO
      OsTaskUsesFpu = false
      OsTaskAccessingApplication = SystemApplication_OsCore{0..5}
      OsTaskResourceRef = RES_SCHEDULER_OsCore5
      OsTaskAutostart: OsTaskAppModeRef=OS_APPMODE_ANY
    SystemApplication_OsCore5 (OsApplication):
      OsTrusted = true
      OsTrustedApplicationDelayTimingViolationCall = false
      OsTrustedApplicationWithProtection = false
      OsApplicationIsPrivileged = true
      OsAppUseTrustedFunctionStubs = false
      OsApplicationCoreRef = EcucCoreDefinition_005
      OsAppTaskRef = IdleTask_OsCore5
      OsAppEcucPartitionRef = EcucPartition_005
      OsAppIsrRef = CounterIsr_SystemTimer5
      OsAppCounterRef = SystemTimer5
      OsAppTaskRef = Init_Core5
      OsAppTaskRef = SchM_Core5
      OsAppTaskRef = APP_Task_Core5
      OsAppAlarmRef = Rte_Al_TE_Core5Swc_Core5Runnable
      OsAppAlarmRef = Rte_Al_TE6_EcuM_EcuM_MainFunction
      OsAppIsrRef = XSignalIsr_OsCore5
      OsApplicationHooks: OsAppErrorHook=false, OsAppShutdownHook=false, OsAppStartupHook=false
    RES_SCHEDULER_OsCore5 (OsResource): OsResourceProperty=STANDARD, OsResourceAccessingApplication=SystemApplication_OsCore5
    SystemTimer0 (OsCounter):
      OsCounterMaxAllowedValue = 1073741823
      OsCounterMinCycle = 1
      OsCounterTicksPerBase = 1
      OsCounterType = HARDWARE
      OsSecondsPerTick = 1E-8
      OsCounterAccessingApplication = SystemApplication_OsCore{0..5}
      OsDriver: OsDriverHighResolution=true, OsDriverHardwareTimerChannelRef=STM0_Ch0, OsDriverIsrRef=CounterIsr_SystemTimer0
    CounterIsr_SystemTimer0 (OsIsr):
      OsIsrCategory = CATEGORY_2
      OsIsrInterruptType = EXTERNAL
      OsIsrInterruptSource = 768
      OsIsrInterruptPriority = 12
      OsIsrStackSize = 1024
      OsIsrEnableNesting = false
      OsIsrUsesFpu = false
      OsIsrInitialEnableInterruptSource = false
      OsIsrSpecialFunctionName = Os_TimerHrtIsr
      OsIsrInterruptMapping = DEFAULT
    SystemTimer1 (OsCounter):
      OsCounterMaxAllowedValue = 1073741823
      OsCounterMinCycle = 1
      OsCounterTicksPerBase = 1
      OsCounterType = HARDWARE
      OsSecondsPerTick = 1E-8
      OsCounterAccessingApplication = SystemApplication_OsCore{0..5}
      OsDriver: OsDriverHighResolution=true, OsDriverHardwareTimerChannelRef=STM1_Ch0, OsDriverIsrRef=CounterIsr_SystemTimer1
    CounterIsr_SystemTimer1 (OsIsr):
      OsIsrCategory = CATEGORY_2
      OsIsrInterruptType = EXTERNAL
      OsIsrInterruptSource = 776
      OsIsrInterruptPriority = 20
      OsIsrStackSize = 1024
      OsIsrEnableNesting = false
      OsIsrUsesFpu = false
      OsIsrInitialEnableInterruptSource = false
      OsIsrSpecialFunctionName = Os_TimerHrtIsr
      OsIsrInterruptMapping = DEFAULT
    SystemTimer2 (OsCounter):
      OsCounterMaxAllowedValue = 1073741823
      OsCounterMinCycle = 1
      OsCounterTicksPerBase = 1
      OsCounterType = HARDWARE
      OsSecondsPerTick = 1E-8
      OsCounterAccessingApplication = SystemApplication_OsCore{0..5}
      OsDriver: OsDriverHighResolution=true, OsDriverHardwareTimerChannelRef=STM2_Ch0, OsDriverIsrRef=CounterIsr_SystemTimer2
    CounterIsr_SystemTimer2 (OsIsr):
      OsIsrCategory = CATEGORY_2
      OsIsrInterruptType = EXTERNAL
      OsIsrInterruptSource = 784
      OsIsrInterruptPriority = 20
      OsIsrStackSize = 1024
      OsIsrEnableNesting = false
      OsIsrUsesFpu = false
      OsIsrInitialEnableInterruptSource = false
      OsIsrSpecialFunctionName = Os_TimerHrtIsr
      OsIsrInterruptMapping = DEFAULT
    SystemTimer3 (OsCounter):
      OsCounterMaxAllowedValue = 1073741823
      OsCounterMinCycle = 1
      OsCounterTicksPerBase = 1
      OsCounterType = HARDWARE
      OsSecondsPerTick = 1E-8
      OsCounterAccessingApplication = SystemApplication_OsCore{0..5}
      OsDriver: OsDriverHighResolution=true, OsDriverHardwareTimerChannelRef=STM3_Ch0, OsDriverIsrRef=CounterIsr_SystemTimer3
    CounterIsr_SystemTimer3 (OsIsr):
      OsIsrCategory = CATEGORY_2
      OsIsrInterruptType = EXTERNAL
      OsIsrInterruptSource = 792
      OsIsrInterruptPriority = 20
      OsIsrStackSize = 1024
      OsIsrEnableNesting = false
      OsIsrUsesFpu = false
      OsIsrInitialEnableInterruptSource = false
      OsIsrSpecialFunctionName = Os_TimerHrtIsr
      OsIsrInterruptMapping = DEFAULT
    SystemTimer4 (OsCounter):
      OsCounterMaxAllowedValue = 1073741823
      OsCounterMinCycle = 1
      OsCounterTicksPerBase = 1
      OsCounterType = HARDWARE
      OsSecondsPerTick = 1E-8
      OsCounterAccessingApplication = SystemApplication_OsCore{0..5}
      OsDriver: OsDriverHighResolution=true, OsDriverHardwareTimerChannelRef=STM4_Ch0, OsDriverIsrRef=CounterIsr_SystemTimer4
    CounterIsr_SystemTimer4 (OsIsr):
      OsIsrCategory = CATEGORY_2
      OsIsrInterruptType = EXTERNAL
      OsIsrInterruptSource = 800
      OsIsrInterruptPriority = 20
      OsIsrStackSize = 1024
      OsIsrEnableNesting = false
      OsIsrUsesFpu = false
      OsIsrInitialEnableInterruptSource = false
      OsIsrSpecialFunctionName = Os_TimerHrtIsr
      OsIsrInterruptMapping = DEFAULT
    SystemTimer5 (OsCounter):
      OsCounterMaxAllowedValue = 1073741823
      OsCounterMinCycle = 1
      OsCounterTicksPerBase = 1
      OsCounterType = HARDWARE
      OsSecondsPerTick = 1E-8
      OsCounterAccessingApplication = SystemApplication_OsCore{0..5}
      OsDriver: OsDriverHighResolution=true, OsDriverHardwareTimerChannelRef=STM5_Ch0, OsDriverIsrRef=CounterIsr_SystemTimer5
    CounterIsr_SystemTimer5 (OsIsr):
      OsIsrCategory = CATEGORY_2
      OsIsrInterruptType = EXTERNAL
      OsIsrInterruptSource = 808
      OsIsrInterruptPriority = 20
      OsIsrStackSize = 1024
      OsIsrEnableNesting = false
      OsIsrUsesFpu = false
      OsIsrInitialEnableInterruptSource = false
      OsIsrSpecialFunctionName = Os_TimerHrtIsr
      OsIsrInterruptMapping = DEFAULT
    18 x OsTask, all with OsTaskActivation=1, OsTaskStackSharing=false, OsTaskStackSize=1024, OsTaskType=AUTO, OsTaskUsesFpu=false, OsTaskAccessingApplication=SystemApplication_OsCore0, OsTaskAccessingApplication=SystemApplication_OsCore1, OsTaskAccessingApplication=SystemApplication_OsCore2, OsTaskAccessingApplication=SystemApplication_OsCore3, OsTaskAccessingApplication=SystemApplication_OsCore4, OsTaskAccessingApplication=SystemApplication_OsCore5:
      Init_Core0: OsTaskPriority=100, OsTaskSchedule=NON, OsTaskResourceRef=RES_SCHEDULER_OsCore0
        OsTaskAutostart: OsTaskAppModeRef=OS_APPMODE_ANY
      SchM_Core0: OsTaskPriority=20, OsTaskSchedule=FULL, OsTaskResourceRef=RES_SCHEDULER_OsCore0, OsTaskEventRef=Rte_Ev_Cyclic2_SchM_Core0_0_10ms, OsTaskEventRef=Rte_Ev_Cyclic2_SchM_Core0_0_1ms, OsTaskEventRef=Rte_Ev_Cyclic2_SchM_Core0_0_20ms, OsTaskEventRef=Rte_Ev_Cyclic2_SchM_Core0_0_5ms
      APP_Task_Core0: OsTaskPriority=50, OsTaskSchedule=FULL, OsTaskResourceRef=RES_SCHEDULER_OsCore0
      Init_Core1: OsTaskPriority=100, OsTaskSchedule=NON, OsTaskResourceRef=RES_SCHEDULER_OsCore1
        OsTaskAutostart: OsTaskAppModeRef=OS_APPMODE_ANY
      SchM_Core1: OsTaskPriority=20, OsTaskSchedule=FULL, OsTaskResourceRef=RES_SCHEDULER_OsCore1
      APP_Task_Core1: OsTaskPriority=50, OsTaskSchedule=FULL, OsTaskResourceRef=RES_SCHEDULER_OsCore1
      Init_Core2: OsTaskPriority=100, OsTaskSchedule=NON, OsTaskResourceRef=RES_SCHEDULER_OsCore2
        OsTaskAutostart: OsTaskAppModeRef=OS_APPMODE_ANY
      SchM_Core2: OsTaskPriority=20, OsTaskSchedule=FULL, OsTaskResourceRef=RES_SCHEDULER_OsCore2
      APP_Task_Core2: OsTaskPriority=50, OsTaskSchedule=FULL, OsTaskResourceRef=RES_SCHEDULER_OsCore2
      Init_Core3: OsTaskPriority=100, OsTaskSchedule=NON, OsTaskResourceRef=RES_SCHEDULER_OsCore3
        OsTaskAutostart: OsTaskAppModeRef=OS_APPMODE_ANY
      SchM_Core3: OsTaskPriority=20, OsTaskSchedule=FULL, OsTaskResourceRef=RES_SCHEDULER_OsCore3
      APP_Task_Core3: OsTaskPriority=50, OsTaskSchedule=FULL, OsTaskResourceRef=RES_SCHEDULER_OsCore3
      Init_Core4: OsTaskPriority=100, OsTaskSchedule=NON, OsTaskResourceRef=RES_SCHEDULER_OsCore4
        OsTaskAutostart: OsTaskAppModeRef=OS_APPMODE_ANY
      SchM_Core4: OsTaskPriority=20, OsTaskSchedule=FULL, OsTaskResourceRef=RES_SCHEDULER_OsCore4
      APP_Task_Core4: OsTaskPriority=50, OsTaskSchedule=FULL, OsTaskResourceRef=RES_SCHEDULER_OsCore4
      Init_Core5: OsTaskPriority=100, OsTaskSchedule=NON, OsTaskResourceRef=RES_SCHEDULER_OsCore5
        OsTaskAutostart: OsTaskAppModeRef=OS_APPMODE_ANY
      SchM_Core5: OsTaskPriority=20, OsTaskSchedule=FULL, OsTaskResourceRef=RES_SCHEDULER_OsCore5
      APP_Task_Core5: OsTaskPriority=50, OsTaskSchedule=FULL, OsTaskResourceRef=RES_SCHEDULER_OsCore5
    14 x OsAlarm, all with OsAlarmAccessingApplication=SystemApplication_OsCore1, OsAlarmAccessingApplication=SystemApplication_OsCore2, OsAlarmAccessingApplication=SystemApplication_OsCore3, OsAlarmAccessingApplication=SystemApplication_OsCore4, OsAlarmAccessingApplication=SystemApplication_OsCore5, OsAlarmAccessingApplication=SystemApplication_OsCore0:
      Rte_Al_TE_Core0Swc_Core0Runnable: OsAlarmCounterRef=SystemTimer0
        OsAlarmAction
          OsAlarmActivateTask: OsAlarmActivateTaskRef=APP_Task_Core0
      Rte_Al_TE_Core1Swc_Core1Runnable: OsAlarmCounterRef=SystemTimer1
        OsAlarmAction
          OsAlarmActivateTask: OsAlarmActivateTaskRef=APP_Task_Core1
      Rte_Al_TE_Core2Swc_Core2Runnable: OsAlarmCounterRef=SystemTimer2
        OsAlarmAction
          OsAlarmActivateTask: OsAlarmActivateTaskRef=APP_Task_Core2
      Rte_Al_TE_Core3Swc_Core3Runnable: OsAlarmCounterRef=SystemTimer3
        OsAlarmAction
          OsAlarmActivateTask: OsAlarmActivateTaskRef=APP_Task_Core3
      Rte_Al_TE_Core4Swc_Core4Runnable: OsAlarmCounterRef=SystemTimer4
        OsAlarmAction
          OsAlarmActivateTask: OsAlarmActivateTaskRef=APP_Task_Core4
      Rte_Al_TE_Core5Swc_Core5Runnable: OsAlarmCounterRef=SystemTimer5
        OsAlarmAction
          OsAlarmActivateTask: OsAlarmActivateTaskRef=APP_Task_Core5
      Rte_Al_TE2_SchM_Core0_0_10ms: OsAlarmCounterRef=SystemTimer0
        OsAlarmAction
          OsAlarmSetEvent: OsAlarmSetEventRef=Rte_Ev_Cyclic2_SchM_Core0_0_10ms, OsAlarmSetEventTaskRef=Os/SchM_Core0
      Rte_Al_TE2_SchM_Core0_0_1ms: OsAlarmCounterRef=SystemTimer0
        OsAlarmAction
          OsAlarmSetEvent: OsAlarmSetEventRef=Rte_Ev_Cyclic2_SchM_Core0_0_1ms, OsAlarmSetEventTaskRef=Os/SchM_Core0
      Rte_Al_TE2_SchM_Core0_0_20ms: OsAlarmCounterRef=SystemTimer0
        OsAlarmAction
          OsAlarmSetEvent: OsAlarmSetEventRef=Rte_Ev_Cyclic2_SchM_Core0_0_20ms, OsAlarmSetEventTaskRef=Os/SchM_Core0
      Rte_Al_TE1_EcuM_EcuM_MainFunction: OsAlarmCounterRef=SystemTimer1
        OsAlarmAction
          OsAlarmActivateTask: OsAlarmActivateTaskRef=SchM_Core1
      Rte_Al_TE2_EcuM_EcuM_MainFunction: OsAlarmCounterRef=SystemTimer2
        OsAlarmAction
          OsAlarmActivateTask: OsAlarmActivateTaskRef=SchM_Core2
      Rte_Al_TE3_EcuM_EcuM_MainFunction: OsAlarmCounterRef=SystemTimer3
        OsAlarmAction
          OsAlarmActivateTask: OsAlarmActivateTaskRef=SchM_Core3
      Rte_Al_TE4_EcuM_EcuM_MainFunction: OsAlarmCounterRef=SystemTimer4
        OsAlarmAction
          OsAlarmActivateTask: OsAlarmActivateTaskRef=SchM_Core4
      Rte_Al_TE6_EcuM_EcuM_MainFunction: OsAlarmCounterRef=SystemTimer5
        OsAlarmAction
          OsAlarmActivateTask: OsAlarmActivateTaskRef=SchM_Core5
    3 x OsEvent:
      Rte_Ev_Cyclic2_SchM_Core0_0_10ms
      Rte_Ev_Cyclic2_SchM_Core0_0_1ms
      Rte_Ev_Cyclic2_SchM_Core0_0_20ms
    7 x OsIsr, all with OsIsrCategory=CATEGORY_2, OsIsrInterruptType=EXTERNAL, OsIsrStackSize=1024, OsIsrEnableNesting=false, OsIsrUsesFpu=false, OsIsrInterruptMapping=DEFAULT:
      CanIsr_0: OsIsrInterruptSource=1456, OsIsrInterruptPriority=37, OsIsrInitialEnableInterruptSource=true  # /ActiveEcuC/Can PLAIN_TEXT Can messages event (for a specific controllers)
        OsIsrXSignalReceiver: OsIsrXSignalReceiverProvidedApis=ShutdownAllCores
      XSignalIsr_OsCore4: OsIsrInterruptSource=2576, OsIsrInterruptPriority=18, OsIsrInitialEnableInterruptSource=false, OsIsrSpecialFunctionName=Os_XSigRecvIsrHandler
        OsIsrXSignalReceiver:
          OsIsrXSignalReceiverProvidedApis = ShutdownAllCores
          OsIsrXSignalReceiverProvidedApis = ActivateTask
          OsIsrXSignalReceiverProvidedApis = CancelAlarm
          OsIsrXSignalReceiverProvidedApis = ChainTask
          OsIsrXSignalReceiverProvidedApis = ControlIdle
          OsIsrXSignalReceiverProvidedApis = GetAlarm
          OsIsrXSignalReceiverProvidedApis = GetApplicationState
          OsIsrXSignalReceiverProvidedApis = GetCounterValue
          OsIsrXSignalReceiverProvidedApis = GetElapsedValue
          OsIsrXSignalReceiverProvidedApis = GetErrorHookStackUsage
          OsIsrXSignalReceiverProvidedApis = GetEvent
          OsIsrXSignalReceiverProvidedApis = GetISRStackUsage
          OsIsrXSignalReceiverProvidedApis = GetKernelStackUsage
          OsIsrXSignalReceiverProvidedApis = GetProtectionHookStackUsage
          OsIsrXSignalReceiverProvidedApis = GetScheduleTableStatus
          OsIsrXSignalReceiverProvidedApis = GetShutdownHookStackUsage
          OsIsrXSignalReceiverProvidedApis = GetStartupHookStackUsage
          OsIsrXSignalReceiverProvidedApis = GetTaskStackUsage
          OsIsrXSignalReceiverProvidedApis = GetTaskState
          OsIsrXSignalReceiverProvidedApis = HookCallCallback
          OsIsrXSignalReceiverProvidedApis = NextScheduleTable
          OsIsrXSignalReceiverProvidedApis = SetAbsAlarm
          OsIsrXSignalReceiverProvidedApis = SetEvent
          OsIsrXSignalReceiverProvidedApis = SetRelAlarm
          OsIsrXSignalReceiverProvidedApis = StartScheduleTableAbs
          OsIsrXSignalReceiverProvidedApis = StartScheduleTableRel
          OsIsrXSignalReceiverProvidedApis = StopScheduleTable
          OsIsrXSignalReceiverProvidedApis = TerminateApplication
      XSignalIsr_OsCore3: OsIsrInterruptSource=2544, OsIsrInterruptPriority=18, OsIsrInitialEnableInterruptSource=false, OsIsrSpecialFunctionName=Os_XSigRecvIsrHandler
        OsIsrXSignalReceiver:
          OsIsrXSignalReceiverProvidedApis = ShutdownAllCores
          OsIsrXSignalReceiverProvidedApis = ActivateTask
          OsIsrXSignalReceiverProvidedApis = CancelAlarm
          OsIsrXSignalReceiverProvidedApis = ChainTask
          OsIsrXSignalReceiverProvidedApis = ControlIdle
          OsIsrXSignalReceiverProvidedApis = GetAlarm
          OsIsrXSignalReceiverProvidedApis = GetApplicationState
          OsIsrXSignalReceiverProvidedApis = GetCounterValue
          OsIsrXSignalReceiverProvidedApis = GetElapsedValue
          OsIsrXSignalReceiverProvidedApis = GetErrorHookStackUsage
          OsIsrXSignalReceiverProvidedApis = GetEvent
          OsIsrXSignalReceiverProvidedApis = GetISRStackUsage
          OsIsrXSignalReceiverProvidedApis = GetKernelStackUsage
          OsIsrXSignalReceiverProvidedApis = GetProtectionHookStackUsage
          OsIsrXSignalReceiverProvidedApis = GetScheduleTableStatus
          OsIsrXSignalReceiverProvidedApis = GetShutdownHookStackUsage
          OsIsrXSignalReceiverProvidedApis = GetStartupHookStackUsage
          OsIsrXSignalReceiverProvidedApis = GetTaskStackUsage
          OsIsrXSignalReceiverProvidedApis = GetTaskState
          OsIsrXSignalReceiverProvidedApis = HookCallCallback
          OsIsrXSignalReceiverProvidedApis = NextScheduleTable
          OsIsrXSignalReceiverProvidedApis = SetAbsAlarm
          OsIsrXSignalReceiverProvidedApis = SetEvent
          OsIsrXSignalReceiverProvidedApis = SetRelAlarm
          OsIsrXSignalReceiverProvidedApis = StartScheduleTableAbs
          OsIsrXSignalReceiverProvidedApis = StartScheduleTableRel
          OsIsrXSignalReceiverProvidedApis = StopScheduleTable
          OsIsrXSignalReceiverProvidedApis = TerminateApplication
      XSignalIsr_OsCore2: OsIsrInterruptSource=2512, OsIsrInterruptPriority=18, OsIsrInitialEnableInterruptSource=false, OsIsrSpecialFunctionName=Os_XSigRecvIsrHandler
        OsIsrXSignalReceiver:
          OsIsrXSignalReceiverProvidedApis = ShutdownAllCores
          OsIsrXSignalReceiverProvidedApis = ActivateTask
          OsIsrXSignalReceiverProvidedApis = CancelAlarm
          OsIsrXSignalReceiverProvidedApis = ChainTask
          OsIsrXSignalReceiverProvidedApis = ControlIdle
          OsIsrXSignalReceiverProvidedApis = GetAlarm
          OsIsrXSignalReceiverProvidedApis = GetApplicationState
          OsIsrXSignalReceiverProvidedApis = GetCounterValue
          OsIsrXSignalReceiverProvidedApis = GetElapsedValue
          OsIsrXSignalReceiverProvidedApis = GetErrorHookStackUsage
          OsIsrXSignalReceiverProvidedApis = GetEvent
          OsIsrXSignalReceiverProvidedApis = GetISRStackUsage
          OsIsrXSignalReceiverProvidedApis = GetKernelStackUsage
          OsIsrXSignalReceiverProvidedApis = GetProtectionHookStackUsage
          OsIsrXSignalReceiverProvidedApis = GetScheduleTableStatus
          OsIsrXSignalReceiverProvidedApis = GetShutdownHookStackUsage
          OsIsrXSignalReceiverProvidedApis = GetStartupHookStackUsage
          OsIsrXSignalReceiverProvidedApis = GetTaskStackUsage
          OsIsrXSignalReceiverProvidedApis = GetTaskState
          OsIsrXSignalReceiverProvidedApis = HookCallCallback
          OsIsrXSignalReceiverProvidedApis = NextScheduleTable
          OsIsrXSignalReceiverProvidedApis = SetAbsAlarm
          OsIsrXSignalReceiverProvidedApis = SetEvent
          OsIsrXSignalReceiverProvidedApis = SetRelAlarm
          OsIsrXSignalReceiverProvidedApis = StartScheduleTableAbs
          OsIsrXSignalReceiverProvidedApis = StartScheduleTableRel
          OsIsrXSignalReceiverProvidedApis = StopScheduleTable
          OsIsrXSignalReceiverProvidedApis = TerminateApplication
      XSignalIsr_OsCore1: OsIsrInterruptSource=2880, OsIsrInterruptPriority=18, OsIsrInitialEnableInterruptSource=false, OsIsrSpecialFunctionName=Os_XSigRecvIsrHandler
        OsIsrXSignalReceiver:
          OsIsrXSignalReceiverProvidedApis = ShutdownAllCores
          OsIsrXSignalReceiverProvidedApis = ActivateTask
          OsIsrXSignalReceiverProvidedApis = CancelAlarm
          OsIsrXSignalReceiverProvidedApis = ChainTask
          OsIsrXSignalReceiverProvidedApis = ControlIdle
          OsIsrXSignalReceiverProvidedApis = GetAlarm
          OsIsrXSignalReceiverProvidedApis = GetApplicationState
          OsIsrXSignalReceiverProvidedApis = GetCounterValue
          OsIsrXSignalReceiverProvidedApis = GetElapsedValue
          OsIsrXSignalReceiverProvidedApis = GetErrorHookStackUsage
          OsIsrXSignalReceiverProvidedApis = GetEvent
          OsIsrXSignalReceiverProvidedApis = GetISRStackUsage
          OsIsrXSignalReceiverProvidedApis = GetKernelStackUsage
          OsIsrXSignalReceiverProvidedApis = GetProtectionHookStackUsage
          OsIsrXSignalReceiverProvidedApis = GetScheduleTableStatus
          OsIsrXSignalReceiverProvidedApis = GetShutdownHookStackUsage
          OsIsrXSignalReceiverProvidedApis = GetStartupHookStackUsage
          OsIsrXSignalReceiverProvidedApis = GetTaskStackUsage
          OsIsrXSignalReceiverProvidedApis = GetTaskState
          OsIsrXSignalReceiverProvidedApis = HookCallCallback
          OsIsrXSignalReceiverProvidedApis = NextScheduleTable
          OsIsrXSignalReceiverProvidedApis = SetAbsAlarm
          OsIsrXSignalReceiverProvidedApis = SetEvent
          OsIsrXSignalReceiverProvidedApis = SetRelAlarm
          OsIsrXSignalReceiverProvidedApis = StartScheduleTableAbs
          OsIsrXSignalReceiverProvidedApis = StartScheduleTableRel
          OsIsrXSignalReceiverProvidedApis = StopScheduleTable
          OsIsrXSignalReceiverProvidedApis = TerminateApplication
      XSignalIsr_OsCore5: OsIsrInterruptSource=2608, OsIsrInterruptPriority=18, OsIsrInitialEnableInterruptSource=false, OsIsrSpecialFunctionName=Os_XSigRecvIsrHandler
        OsIsrXSignalReceiver:
          OsIsrXSignalReceiverProvidedApis = ShutdownAllCores
          OsIsrXSignalReceiverProvidedApis = ActivateTask
          OsIsrXSignalReceiverProvidedApis = CancelAlarm
          OsIsrXSignalReceiverProvidedApis = ChainTask
          OsIsrXSignalReceiverProvidedApis = ControlIdle
          OsIsrXSignalReceiverProvidedApis = GetAlarm
          OsIsrXSignalReceiverProvidedApis = GetApplicationState
          OsIsrXSignalReceiverProvidedApis = GetCounterValue
          OsIsrXSignalReceiverProvidedApis = GetElapsedValue
          OsIsrXSignalReceiverProvidedApis = GetErrorHookStackUsage
          OsIsrXSignalReceiverProvidedApis = GetEvent
          OsIsrXSignalReceiverProvidedApis = GetISRStackUsage
          OsIsrXSignalReceiverProvidedApis = GetKernelStackUsage
          OsIsrXSignalReceiverProvidedApis = GetProtectionHookStackUsage
          OsIsrXSignalReceiverProvidedApis = GetScheduleTableStatus
          OsIsrXSignalReceiverProvidedApis = GetShutdownHookStackUsage
          OsIsrXSignalReceiverProvidedApis = GetStartupHookStackUsage
          OsIsrXSignalReceiverProvidedApis = GetTaskStackUsage
          OsIsrXSignalReceiverProvidedApis = GetTaskState
          OsIsrXSignalReceiverProvidedApis = HookCallCallback
          OsIsrXSignalReceiverProvidedApis = NextScheduleTable
          OsIsrXSignalReceiverProvidedApis = SetAbsAlarm
          OsIsrXSignalReceiverProvidedApis = SetEvent
          OsIsrXSignalReceiverProvidedApis = SetRelAlarm
          OsIsrXSignalReceiverProvidedApis = StartScheduleTableAbs
          OsIsrXSignalReceiverProvidedApis = StartScheduleTableRel
          OsIsrXSignalReceiverProvidedApis = StopScheduleTable
          OsIsrXSignalReceiverProvidedApis = TerminateApplication
      XSignalIsr_OsCore0: OsIsrInterruptSource=2448, OsIsrInterruptPriority=18, OsIsrInitialEnableInterruptSource=false, OsIsrSpecialFunctionName=Os_XSigRecvIsrHandler
        OsIsrXSignalReceiver:
          OsIsrXSignalReceiverProvidedApis = ShutdownAllCores
          OsIsrXSignalReceiverProvidedApis = ActivateTask
          OsIsrXSignalReceiverProvidedApis = CancelAlarm
          OsIsrXSignalReceiverProvidedApis = ChainTask
          OsIsrXSignalReceiverProvidedApis = ControlIdle
          OsIsrXSignalReceiverProvidedApis = GetAlarm
          OsIsrXSignalReceiverProvidedApis = GetApplicationState
          OsIsrXSignalReceiverProvidedApis = GetCounterValue
          OsIsrXSignalReceiverProvidedApis = GetElapsedValue
          OsIsrXSignalReceiverProvidedApis = GetErrorHookStackUsage
          OsIsrXSignalReceiverProvidedApis = GetEvent
          OsIsrXSignalReceiverProvidedApis = GetISRStackUsage
          OsIsrXSignalReceiverProvidedApis = GetKernelStackUsage
          OsIsrXSignalReceiverProvidedApis = GetProtectionHookStackUsage
          OsIsrXSignalReceiverProvidedApis = GetScheduleTableStatus
          OsIsrXSignalReceiverProvidedApis = GetShutdownHookStackUsage
          OsIsrXSignalReceiverProvidedApis = GetStartupHookStackUsage
          OsIsrXSignalReceiverProvidedApis = GetTaskStackUsage
          OsIsrXSignalReceiverProvidedApis = GetTaskState
          OsIsrXSignalReceiverProvidedApis = HookCallCallback
          OsIsrXSignalReceiverProvidedApis = NextScheduleTable
          OsIsrXSignalReceiverProvidedApis = SetAbsAlarm
          OsIsrXSignalReceiverProvidedApis = SetEvent
          OsIsrXSignalReceiverProvidedApis = SetRelAlarm
          OsIsrXSignalReceiverProvidedApis = StartScheduleTableAbs
          OsIsrXSignalReceiverProvidedApis = StartScheduleTableRel
          OsIsrXSignalReceiverProvidedApis = StopScheduleTable
          OsIsrXSignalReceiverProvidedApis = TerminateApplication
    Rte_Al_TE2_SchM_Core0_0_5ms (OsAlarm):
      OsAlarmCounterRef = SystemTimer0
      OsAlarmAccessingApplication = SystemApplication_OsCore{1..5}
      OsAlarmAccessingApplication = SystemApplication_OsCore0
      OsAlarmAction
        OsAlarmSetEvent: OsAlarmSetEventRef=Rte_Ev_Cyclic2_SchM_Core0_0_5ms, OsAlarmSetEventTaskRef=Os/SchM_Core0
    Rte_Ev_Cyclic2_SchM_Core0_0_5ms (OsEvent)
