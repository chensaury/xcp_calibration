AUTOSAR XML (schema 4-2-1)
package /InitialEcuC
  ecuc value collection InitialEcuC: ecuc-values=[Can, CanIf, CanSM, Com, ComM, EcuC, EcuM, PduR, Xcp]
  module config Can
    CanConfigSet
      CT_CAN00_617059cf (CanController):
        CanControllerActivation = true
        CanControllerDefaultBaudrate = CanControllerBaudrateConfig
        CanControllerSystemRef = CT_CAN00
        CanWakeupSourceRef = EcuMCommonConfiguration/CN_CAN00_a2de9a4f
        CanControllerBaudrateConfig
      CN_CAN00_a2de9a4f_Tx (CanHardwareObject): CanHandleType=BASIC, CanIdValue=0, CanObjectType=TRANSMIT, CanControllerRef=CanConfigSet/CT_CAN00_617059cf
      CN_CAN00_e847a2b9_Rx (CanHardwareObject): CanHandleType=BASIC, CanIdType=STANDARD, CanIdValue=0, CanObjectType=RECEIVE, CanControllerRef=CanConfigSet/CT_CAN00_617059cf
    CanGeneral: CanIndex=0
  module config CanIf
    CanIfCtrlDrvCfg_7d254554 (CanIfCtrlDrvCfg): CanIfCtrlDrvInitHohConfigRef=CanIfInitHohCfg, CanIfCtrlDrvNameRef=CanGeneral
      CT_CAN00_617059cf (CanIfCtrlCfg): CanIfCtrlCanCtrlRef=CanConfigSet/CT_CAN00_617059cf
    CanIfInitCfg
      CHNL_0fb271d2 (CanIfBufferCfg): CanIfBufferSize=0, CanIfBufferHthRef=CanIfInitHohCfg/CN_CAN00_a2de9a4f_Tx
      CanIfInitHohCfg: CanIfInitRefCfgSet=CanConfigSet
        CN_CAN00_e847a2b9_Rx (CanIfHrhCfg): CanIfHrhCanCtrlIdRef=CanIfCtrlDrvCfg_7d254554/CT_CAN00_617059cf, CanIfHrhIdSymRef=CanConfigSet/CN_CAN00_e847a2b9_Rx
        CN_CAN00_a2de9a4f_Tx (CanIfHthCfg): CanIfHthCanCtrlIdRef=CanIfCtrlDrvCfg_7d254554/CT_CAN00_617059cf, CanIfHthIdSymRef=CanConfigSet/CN_CAN00_a2de9a4f_Tx
      4 x CanIfRxPduCfg, all with CanIfRxPduCanIdType=STANDARD_CAN, CanIfRxPduDlc=8, CanIfRxPduHrhIdRef=CanIfInitHohCfg/CN_CAN00_e847a2b9_Rx:
        ACP_327_oCAN00_721e8970_Rx: CanIfRxPduCanId=807, CanIfRxPduUserRxIndicationName=PduR_CanIfRxIndication, CanIfRxPduUserRxIndicationUL=PDUR, CanIfRxPduRef=EcucPduCollection/ACP_327_oCAN00_296526c1_Rx
        ACP_32E_oCAN00_cb06c350_Rx: CanIfRxPduCanId=814, CanIfRxPduUserRxIndicationName=PduR_CanIfRxIndication, CanIfRxPduUserRxIndicationUL=PDUR, CanIfRxPduRef=EcucPduCollection/ACP_32E_oCAN00_c2ae66cc_Rx
        B_RLS_oCAN00_c4f7769e_Rx: CanIfRxPduCanId=998, CanIfRxPduUserRxIndicationName=PduR_CanIfRxIndication, CanIfRxPduUserRxIndicationUL=PDUR, CanIfRxPduRef=EcucPduCollection/B_RLS_oCAN00_8929dfa4_Rx
        XCP_S_oCAN00_d18922f7_Rx: CanIfRxPduCanId=1791, CanIfRxPduUserRxIndicationName=Xcp_CanIfRxIndication, CanIfRxPduUserRxIndicationUL=XCP, CanIfRxPduRef=EcucPduCollection/XCP_S_oCAN00_aa3b84ab_Rx
      ITMS_350_oCAN00_9748bb1c_Tx (CanIfTxPduCfg):
        CanIfTxPduCanId = 848
        CanIfTxPduCanIdType = STANDARD_CAN
        CanIfTxPduDlc = 8
        CanIfTxPduUserTxConfirmationName = PduR_CanIfTxConfirmation
        CanIfTxPduUserTxConfirmationUL = PDUR
        CanIfTxPduBufferRef = CanIfInitCfg/CHNL_0fb271d2
        CanIfTxPduRef = EcucPduCollection/ITMS_350_oCAN00_93beae7b_Tx
      XCP_R_oCAN00_267e057e_Tx (CanIfTxPduCfg):
        CanIfTxPduCanId = 1790
        CanIfTxPduCanIdType = STANDARD_CAN
        CanIfTxPduDlc = 8
        CanIfTxPduUserTxConfirmationName = Xcp_CanIfTxConfirmation
        CanIfTxPduUserTxConfirmationUL = XCP
        CanIfTxPduBufferRef = CanIfInitCfg/CHNL_0fb271d2
        CanIfTxPduRef = EcucPduCollection/XCP_R_oCAN00_31486e7f_Tx
    CanIfPrivateCfg: CanIfPrivateSoftwareFilterType=LINEAR
    CanIfPublicCfg: CanIfPublicPnSupport=false
  module config CanSM
    CanSMConfiguration
      CHNL_0fb271d2 (CanSMManagerNetwork): CanSMComMNetworkHandleRef=ComMConfigSet/CN_CAN00_a2de9a4f
        CT_CAN00_ec7a8ac3 (CanSMController): CanSMControllerId=CanIfCtrlDrvCfg_7d254554/CT_CAN00_617059cf
  module config Com
    ComConfig
      4 x ComIPdu, all with ComIPduType=NORMAL:
        ACP_327_oCAN00_ffa62305_Rx: ComIPduDirection=RECEIVE, ComIPduGroupRef=ITMS_oCAN00_Rx_06702e0c, ComIPduSignalRef=Ecomp_CompIpt_V_oACP_327_oCAN00_c7006e5a_Rx, ComIPduSignalRef=Ecomp_Complpt_A_oACP_327_oCAN00_ea282991_Rx, ComIPduSignalRef=Ecomp_InvSoftwareVer_oACP_327_oCAN00_4030e33b_Rx, ComPduIdRef=EcucPduCollection/ACP_327_oCAN00_ffa62305_Rx
        ACP_32E_oCAN00_11d3b5e8_Rx: ComIPduDirection=RECEIVE, ComIPduGroupRef=ITMS_oCAN00_Rx_06702e0c, ComIPduSignalRef=Comp_error_code1_oACP_32E_oCAN00_b5915ac1_Rx, ComIPduSignalRef=Comp_speed_of_compressor_oACP_32E_oCAN00_c033917a_Rx, ComIPduSignalRef=Comp_work_status_oACP_32E_oCAN00_1667710c_Rx, ComPduIdRef=EcucPduCollection/ACP_32E_oCAN00_11d3b5e8_Rx
        B_RLS_oCAN00_6419d093_Rx: ComIPduDirection=RECEIVE, ComIPduGroupRef=ITMS_oCAN00_Rx_06702e0c, ComIPduSignalRef=B_RLS_DewPoint_oB_RLS_oCAN00_421173c7_Rx, ComIPduSignalRef=B_RLS_Offline_Calibration_Result_oB_RLS_oCAN00_f4cfd300_Rx, ComIPduSignalRef=B_RLS_SolarLeft_oB_RLS_oCAN00_3b2a55ba_Rx, ComIPduSignalRef=B_RLS_SolarRight_oB_RLS_oCAN00_6bd7c4e8_Rx, ComIPduSignalRef=B_RLS_WindshieldTemp_oB_RLS_oCAN00_6dbe9061_Rx, ComIPduSignalRef=B_RLS_relativeHumidity_oB_RLS_oCAN00_e615f445_Rx, ComPduIdRef=EcucPduCollection/B_RLS_oCAN00_6419d093_Rx
        ITMS_350_oCAN00_8869cfa0_Tx: ComIPduDirection=SEND, ComIPduGroupRef=ITMS_oCAN00_Tx_502a898a, ComIPduSignalRef=AC_max_perm_compressor_power_oITMS_350_oCAN00_ef8bdcbc_Tx, ComIPduSignalRef=AllowOperation_Flag_oITMS_350_oCAN00_009f228c_Tx, ComIPduSignalRef=TgtSpd_rpm_oITMS_350_oCAN00_b9dd7dcf_Tx, ComPduIdRef=EcucPduCollection/ITMS_350_oCAN00_8869cfa0_Tx
          ComTxIPdu: ComMinimumDelayTime=0.001, ComTxIPduUnusedAreasDefault=0
            ComTxModeFalse
              ComTxMode: ComTxModeMode=PERIODIC, ComTxModeTimeOffset=0, ComTxModeTimePeriod=0.1
            ComTxModeTrue
              ComTxMode: ComTxModeMode=PERIODIC, ComTxModeTimeOffset=0, ComTxModeTimePeriod=0.1
      ITMS_oCAN00_Rx_06702e0c (ComIPduGroup)
      ITMS_oCAN00_Tx_502a898a (ComIPduGroup)
      15 x ComSignal, all with ComSignalEndianness=BIG_ENDIAN:
        AC_max_perm_compressor_power_oITMS_350_oCAN00_ef8bdcbc_Tx: ComBitPosition=7, ComBitSize=8, ComSignalInitValue=0, ComSignalType=UINT8, ComTransferProperty=PENDING, ComSystemTemplateSystemSignalRef=AC_max_perm_compressor_power
        AllowOperation_Flag_oITMS_350_oCAN00_009f228c_Tx: ComBitPosition=24, ComBitSize=1, ComSignalInitValue=0, ComSignalType=BOOLEAN, ComTransferProperty=PENDING, ComSystemTemplateSystemSignalRef=AllowOperation_Flag
        B_RLS_DewPoint_oB_RLS_oCAN00_421173c7_Rx: ComBitPosition=33, ComBitSize=10, ComSignalInitValue=396, ComSignalType=UINT16, ComTimeout=0, ComSystemTemplateSystemSignalRef=B_RLS_DewPoint
        B_RLS_Offline_Calibration_Result_oB_RLS_oCAN00_f4cfd300_Rx: ComBitPosition=49, ComBitSize=2, ComSignalInitValue=0, ComSignalType=UINT8, ComTimeout=0, ComSystemTemplateSystemSignalRef=B_RLS_Offline_Calibration_Result
        B_RLS_SolarLeft_oB_RLS_oCAN00_3b2a55ba_Rx: ComBitPosition=7, ComBitSize=8, ComSignalInitValue=0, ComSignalType=UINT8, ComTimeout=0, ComSystemTemplateSystemSignalRef=B_RLS_SolarLeft
        B_RLS_SolarRight_oB_RLS_oCAN00_6bd7c4e8_Rx: ComBitPosition=15, ComBitSize=8, ComSignalInitValue=0, ComSignalType=UINT8, ComTimeout=0, ComSystemTemplateSystemSignalRef=B_RLS_SolarRight
        B_RLS_WindshieldTemp_oB_RLS_oCAN00_6dbe9061_Rx: ComBitPosition=31, ComBitSize=8, ComSignalInitValue=80, ComSignalType=UINT8, ComTimeout=0, ComSystemTemplateSystemSignalRef=B_RLS_WindshieldTemp
        B_RLS_relativeHumidity_oB_RLS_oCAN00_e615f445_Rx: ComBitPosition=23, ComBitSize=8, ComSignalInitValue=1, ComSignalType=UINT8, ComTimeout=0, ComSystemTemplateSystemSignalRef=B_RLS_relativeHumidity
        Comp_error_code1_oACP_32E_oCAN00_b5915ac1_Rx: ComBitPosition=39, ComBitSize=8, ComSignalInitValue=0, ComSignalType=UINT8, ComTimeout=0, ComSystemTemplateSystemSignalRef=Comp_error_code1
        Comp_speed_of_compressor_oACP_32E_oCAN00_c033917a_Rx: ComBitPosition=7, ComBitSize=16, ComSignalInitValue=0, ComSignalType=UINT16, ComTimeout=0, ComSystemTemplateSystemSignalRef=Comp_speed_of_compressor
        Comp_work_status_oACP_32E_oCAN00_1667710c_Rx: ComBitPosition=31, ComBitSize=8, ComSignalInitValue=0, ComSignalType=UINT8, ComTimeout=0, ComSystemTemplateSystemSignalRef=Comp_work_status
        Ecomp_CompIpt_V_oACP_327_oCAN00_c7006e5a_Rx: ComBitPosition=23, ComBitSize=16, ComSignalInitValue=0, ComSignalType=UINT16, ComTimeout=0, ComSystemTemplateSystemSignalRef=Ecomp_CompIpt_V
        Ecomp_Complpt_A_oACP_327_oCAN00_ea282991_Rx: ComBitPosition=39, ComBitSize=16, ComSignalInitValue=0, ComSignalType=UINT16, ComTimeout=0, ComSystemTemplateSystemSignalRef=Ecomp_Complpt_A
        Ecomp_InvSoftwareVer_oACP_327_oCAN00_4030e33b_Rx: ComBitPosition=7, ComBitSize=16, ComSignalInitValue=0, ComSignalType=UINT16, ComTimeout=0, ComSystemTemplateSystemSignalRef=Ecomp_InvSoftwareVer
        TgtSpd_rpm_oITMS_350_oCAN00_b9dd7dcf_Tx: ComBitPosition=55, ComBitSize=16, ComSignalInitValue=0, ComSignalType=UINT16, ComTransferProperty=PENDING, ComSystemTemplateSystemSignalRef=TgtSpd_rpm
    ComGeneral
  module config ComM
    ComMConfigSet: ComMPncEnabled=false
      CN_CAN00_a2de9a4f (ComMChannel): ComMBusType=COMM_BUS_TYPE_CAN, ComMChannelId=0
        ComMNetworkManagement: ComMNmVariant=NONE
        CN_CAN00_c6dc0763 (ComMUserPerChannel): ComMUserChannel=CN_CAN00_99a1e90e
      CN_CAN00_99a1e90e (ComMUser): ComMUserIdentifier=0
    ComMGeneral: ComMPncIdCounting=COMM_PNC_ID_COUNT_FROM_NM_MESSAGE, ComMPncSupport=false
  module config EcuC
    EcucPduCollection: PduIdTypeEnum=UINT8, PduLengthTypeEnum=UINT8
      10 x Pdu, all with PduLength=8:
        ACP_327_oCAN00_296526c1_Rx: SysTPduToFrameMappingRef=ACP_327
        ACP_327_oCAN00_ffa62305_Rx
        ACP_32E_oCAN00_11d3b5e8_Rx
        ACP_32E_oCAN00_c2ae66cc_Rx: SysTPduToFrameMappingRef=ACP_32E
        B_RLS_oCAN00_6419d093_Rx
        B_RLS_oCAN00_8929dfa4_Rx: SysTPduToFrameMappingRef=B_RLS
        ITMS_350_oCAN00_8869cfa0_Tx
        ITMS_350_oCAN00_93beae7b_Tx: SysTPduToFrameMappingRef=ITMS_350
        XCP_R_oCAN00_31486e7f_Tx: SysTPduToFrameMappingRef=XCP_R
        XCP_S_oCAN00_aa3b84ab_Rx: SysTPduToFrameMappingRef=XCP_S
  module config EcuM
    EcuMConfiguration
      EcuMCommonConfiguration
        EcuMDriverInitListOne
        EcuMDriverRestartList
        CN_CAN00_a2de9a4f (EcuMWakeupSource): EcuMWakeupSourceId=5, EcuMComMChannelRef=ComMConfigSet/CN_CAN00_a2de9a4f
      EcuMFlexConfiguration: EcuMFlexModuleConfigurationRef=CanConfigSet
  module config PduR
    PduRGeneral
    PduRRoutingTables
      PduRRoutingTable
        4 x PduRRoutingPath:
          ACP_327_oCAN00_296526c1_Rx
            ACP_327_oCAN00_296526c1_Rx_41385bd0_Rx (PduRDestPdu): PduRDestPduRef=EcucPduCollection/ACP_327_oCAN00_ffa62305_Rx
            PduRSrcPdu_41385bd0 (PduRSrcPdu): PduRSrcPduRef=EcucPduCollection/ACP_327_oCAN00_296526c1_Rx
          ACP_32E_oCAN00_c2ae66cc_Rx
            ACP_32E_oCAN00_c2ae66cc_Rx_d3bab334_Rx (PduRDestPdu): PduRDestPduRef=EcucPduCollection/ACP_32E_oCAN00_11d3b5e8_Rx
            PduRSrcPdu_d3bab334 (PduRSrcPdu): PduRSrcPduRef=EcucPduCollection/ACP_32E_oCAN00_c2ae66cc_Rx
          B_RLS_oCAN00_8929dfa4_Rx
            B_RLS_oCAN00_8929dfa4_Rx_9f7da87b_Rx (PduRDestPdu): PduRDestPduRef=EcucPduCollection/B_RLS_oCAN00_6419d093_Rx
            PduRSrcPdu_9f7da87b (PduRSrcPdu): PduRSrcPduRef=EcucPduCollection/B_RLS_oCAN00_8929dfa4_Rx
          ITMS_350_oCAN00_8869cfa0_Tx
            ITMS_350_oCAN00_93beae7b_Tx (PduRDestPdu): PduRDestPduRef=EcucPduCollection/ITMS_350_oCAN00_93beae7b_Tx
            PduRSrcPdu_26004724 (PduRSrcPdu): PduRSrcPduRef=EcucPduCollection/ITMS_350_oCAN00_8869cfa0_Tx
  module config Xcp
    XcpConfig
      XCP_R_oCAN00_31486e7f_Tx (XcpPdu)
        XCP_R_oCAN00_31486e7f_Tx (XcpTxPdu): XcpTxPduRef=EcucPduCollection/XCP_R_oCAN00_31486e7f_Tx
      XCP_S_oCAN00_aa3b84ab_Rx (XcpPdu)
        XCP_S_oCAN00_aa3b84ab_Rx (XcpRxPdu): XcpRxPduRef=EcucPduCollection/XCP_S_oCAN00_aa3b84ab_Rx
    XcpGeneral
