AUTOSAR XML (schema 4-2-1)
package /McalLib
  module config McalLib: implementation-config-variant=VARIANT-PRE-COMPILE, module-description=McalLib_Impl
    CommonPublishedInformation:
      ArMajorVersion = 4
      ArMinorVersion = 2
      ArPatchVersion = 2
      ModuleId = 255
      Release = _TRICORE_TC397
      SwMajorVersion = 3
      SwMinorVersion = 0
      SwPatchVersion = 0
      VendorId = 17
    McalLibGeneral: McalLibSafetyEnable=false
    McalLibPublishedInformation:
      McalLibBackUpClockFreq = 100
      McalLibDsprCore0EndAddr = 1879293951
      McalLibDsprCore0StartAddr = 1879048192
      McalLibDsprCore1EndAddr = 1610858495
      McalLibDsprCore1StartAddr = 1610612736
      McalLibDsprCore2EndAddr = 1342275583
      McalLibDsprCore2StartAddr = 1342177280
      McalLibDsprCore3EndAddr = 1073840127
      McalLibDsprCore3StartAddr = 1073741824
      McalLibDsprCore4EndAddr = 805404671
      McalLibDsprCore4StartAddr = 805306368
      McalLibDsprCore5EndAddr = 268533759
      McalLibDsprCore5StartAddr = 268435456
      McalLibMcalAvailableCores = 6
      McalLibPsprCore0EndAddr = 1880162303
      McalLibPsprCore0StartAddr = 1880096768
      McalLibPsprCore1EndAddr = 1611726847
      McalLibPsprCore1StartAddr = 1611661312
      McalLibPsprCore2EndAddr = 1343291391
      McalLibPsprCore2StartAddr = 1343225856
      McalLibPsprCore3EndAddr = 1074855935
      McalLibPsprCore3StartAddr = 1074790400
      McalLibPsprCore4EndAddr = 806420479
      McalLibPsprCore4StartAddr = 806354944
      McalLibPsprCore5EndAddr = 269549567
      McalLibPsprCore5StartAddr = 269484032
      McalLibSystemClockFreq = 20
