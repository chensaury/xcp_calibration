AUTOSAR XML (schema 00044)
package /ComponentTypes
  application sw component type Core0Swc
    behavior Core0Swc_InternalBehavior
      timing event TMT_Core0Runnable: start-on-event=Core0Runnable, period=0.1
      runnable Core0Runnable
  swc implementation Core0Swc_Implementation: behavior=Core0Swc_InternalBehavior
