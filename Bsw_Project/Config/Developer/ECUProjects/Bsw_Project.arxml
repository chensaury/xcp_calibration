AUTOSAR XML (schema 00044)
package /VehicleProject
  system System
    root-software-compositions:
      root sw composition prototype EcuSwComposition: software-composition=ECU_Composition
package /ECUCompositionTypes
  composition sw component type ECU_Composition
    6 x component:
      Core{0..5}Swc: type=Core{0..5}Swc
package /EndToEndProtections
  end to end protection set EndToEndProtectionSet
